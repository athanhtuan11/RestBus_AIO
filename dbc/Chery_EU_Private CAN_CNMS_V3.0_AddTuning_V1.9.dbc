VERSION ""

NS_ :

BS_:

BU_: RadarFrontCenter RadarFrontSlave DASy MPC3 RadarFrontLeft RadarFrontRight RadarRearLeft RadarRearRight

BO_ 200 VFC_Object12A: 64 MPC3
 SG_ VFC_Obj12A_CRC : 0|16@1+ (1,0) [0|65535] ""  RadarFrontCenter,DASy
 SG_ VFC_Obj12A_AliveCtr : 16|8@1+ (1,0) [0|255] ""  RadarFrontCenter,DASy
 SG_ VFC_Obj12A_ProtBlockCtr : 24|4@1+ (1,0) [0|15] ""  RadarFrontCenter,DASy
 SG_ VFC_Obj12A_ID : 32|8@1+ (1,0) [1|255] ""  RadarFrontCenter,DASy
 SG_ VFC_Obj12A_Type : 60|4@1+ (1,0) [0|15] ""  RadarFrontCenter,DASy
 SG_ VFC_Obj12A_TypeProb : 378|6@1+ (2,0) [0|100] "%"  RadarFrontCenter,DASy
 SG_ VFC_Obj12A_Dx : 48|12@1+ (0.05,0) [0|204.75] "m"  RadarFrontCenter,DASy
 SG_ VFC_Obj12A_Dy : 64|14@1+ (0.01,-80) [-80|80] "m"  RadarFrontCenter,DASy
 SG_ VFC_Obj12A_Vx : 80|11@1+ (0.1,-154) [-154|50] "m/s"  RadarFrontCenter,DASy
 SG_ VFC_Obj12A_Vy : 96|10@1+ (0.1,-50) [-50|50] "m/s"  RadarFrontCenter,DASy
 SG_ VFC_Obj12A_Ax : 112|9@1+ (0.1,-16) [-16|16] "m/s^2"  RadarFrontCenter,DASy
 SG_ VFC_Obj12A_Ay : 128|8@1+ (0.1,-12) [-12|12] "m/s^2"  RadarFrontCenter,DASy
 SG_ VFC_Obj12A_DxStdDev : 144|10@1+ (0.05,0) [0|51.15] "m"  RadarFrontCenter,DASy
 SG_ VFC_Obj12A_DyStdDev : 160|10@1+ (0.02,0) [0|20.46] "m"  RadarFrontCenter,DASy
 SG_ VFC_Obj12A_VxStdDev : 176|10@1+ (0.1,0) [0|102.3] "m/s"  RadarFrontCenter,DASy
 SG_ VFC_Obj12A_VyStdDev : 192|9@1+ (0.1,0) [0|51.1] "m/s"  RadarFrontCenter,DASy
 SG_ VFC_Obj12A_AxStdDev : 40|8@1+ (0.1,0) [0|25.5] "m/s^2"  RadarFrontCenter,DASy
 SG_ VFC_Obj12A_AyStdDev : 136|8@1+ (0.1,0) [0|25.5] "m/s^2"  RadarFrontCenter,DASy
 SG_ VFC_Obj12A_Length : 217|9@1+ (0.05,0) [0|25.55] "m"  RadarFrontCenter,DASy
 SG_ VFC_Obj12A_Width : 294|10@1+ (0.01,0) [0|10.23] "m"  RadarFrontCenter,DASy
 SG_ VFC_Obj12A_Height : 208|9@1+ (0.01,0) [0|5.11] "m"  RadarFrontCenter,DASy
 SG_ VFC_Obj12A_LengthStdDev : 384|7@1+ (0.05,0) [0|5] "m"  RadarFrontCenter,DASy
 SG_ VFC_Obj12A_WidthStdDev : 391|7@1+ (0.01,0) [0|1] "m"  RadarFrontCenter,DASy
 SG_ VFC_Obj12A_HeightStdDev : 201|7@1+ (0.01,0) [0|1] "m"  RadarFrontCenter,DASy
 SG_ VFC_Obj12A_EdgeLeft : 411|13@1+ (0.00025,-1) [-1|1] "unitless"  RadarFrontCenter,DASy
 SG_ VFC_Obj12A_EdgeMid : 398|13@1+ (0.00025,-1) [-1|1] "unitless"  RadarFrontCenter,DASy
 SG_ VFC_Obj12A_EdgeRight : 424|13@1+ (0.00025,-1) [-1|1] "unitless"  RadarFrontCenter,DASy
 SG_ VFC_Obj12A_EdgeTop : 448|12@1+ (0.00025,-0.5) [-0.5|0.5] "unitless"  RadarFrontCenter,DASy
 SG_ VFC_Obj12A_EdgeBottom : 269|12@1+ (0.00025,-0.5) [-0.5|0.5] "unitless"  RadarFrontCenter,DASy
 SG_ VFC_Obj12A_EdgeLeftStdDev : 440|8@1+ (0.0002,0) [0|0.051] "unitless"  RadarFrontCenter,DASy
 SG_ VFC_Obj12A_EdgeMidStdDev : 464|8@1+ (0.0002,0) [0|0.051] "unitless"  RadarFrontCenter,DASy
 SG_ VFC_Obj12A_EdgeRightStdDev : 472|8@1+ (0.0002,0) [0|0.051] "unitless"  RadarFrontCenter,DASy
 SG_ VFC_Obj12A_EdgeTopStdDev : 480|8@1+ (0.0002,0) [0|0.051] "unitless"  RadarFrontCenter,DASy
 SG_ VFC_Obj12A_EdgeBottomStdDev : 488|8@1+ (0.0002,0) [0|0.051] "unitless"  RadarFrontCenter,DASy
 SG_ VFC_Obj12A_NormVx : 304|16@1+ (0.001,-40) [-40|25] "1/s"  RadarFrontCenter,DASy
 SG_ VFC_Obj12A_NormAx : 235|13@1+ (0.002,-10) [-10|6] "1/s^2"  RadarFrontCenter,DASy
 SG_ VFC_Obj12A_NormVyEdgeLeft : 256|13@1+ (0.001,-4) [-4|4] "1/s"  RadarFrontCenter,DASy
 SG_ VFC_Obj12A_NormVyEdgeRight : 281|13@1+ (0.001,-4) [-4|4] "1/s"  RadarFrontCenter,DASy
 SG_ VFC_Obj12A_NormVxStdDev : 368|10@1+ (0.001,0) [0|1.023] "1/s"  RadarFrontCenter,DASy
 SG_ VFC_Obj12A_NormAxStdDev : 328|10@1+ (0.0025,0) [0|2.5575] "1/s^2"  RadarFrontCenter,DASy
 SG_ VFC_Obj12A_NormVyEdgeLeftStdDev : 248|8@1+ (0.001,0) [0|0.255] "1/s"  RadarFrontCenter,DASy
 SG_ VFC_Obj12A_NormVyEdgeRightStdDev : 320|8@1+ (0.001,0) [0|0.255] "1/s"  RadarFrontCenter,DASy
 SG_ VFC_Obj12A_ScaleChange : 338|14@1+ (0.0001,0.5) [0.5|2.1383] "unitless"  RadarFrontCenter,DASy
 SG_ VFC_Obj12A_ScaleChngStdDev : 352|10@1+ (0.0001,0) [0|0.1023] "unitless"  RadarFrontCenter,DASy
 SG_ VFC_Obj12A_HeadingAngle : 226|9@1+ (0.01,-1.57) [-1.57|1.57] "rad"  RadarFrontCenter,DASy
 SG_ VFC_Obj12A_HeadingAngleStdDev : 186|6@1+ (0.01,0) [0|0.5] "rad"  RadarFrontCenter,DASy
 SG_ VFC_Obj12A_HeadOrientation : 460|4@1+ (1,0) [0|15] ""  RadarFrontCenter,DASy
 SG_ VFC_Obj12A_CompletelyInImg : 121|1@1+ (1,0) [0|1] ""  RadarFrontCenter,DASy
 SG_ VFC_Obj12A_ProbMovingLat : 154|6@1+ (2,0) [0|100] "%"  RadarFrontCenter,DASy
 SG_ VFC_Obj12A_ProbMovingLong : 170|6@1+ (2,0) [0|100] "%"  RadarFrontCenter,DASy
 SG_ VFC_Obj12A_ProbExist : 122|6@1+ (2,0) [0|100] "%"  RadarFrontCenter,DASy
 SG_ VFC_Obj12A_MeasSource : 91|5@1+ (1,0) [0|31] ""  RadarFrontCenter,DASy
 SG_ VFC_Obj12A_Reliability : 362|6@1+ (1,0) [0|63] ""  RadarFrontCenter,DASy
 SG_ VFC_Obj12A_Measured : 78|2@1+ (1,0) [0|3] ""  RadarFrontCenter,DASy
 SG_ VFC_Obj12A_VisibleView : 437|3@1+ (1,0) [0|4] ""  RadarFrontCenter,DASy
 SG_ VFC_Obj12A_ClassifiedView : 496|3@1+ (1,0) [0|4] ""  RadarFrontCenter,DASy
 SG_ VFC_Obj12A_DirIndicator : 106|3@1+ (1,0) [0|4] ""  RadarFrontCenter,DASy
 SG_ VFC_Obj12A_BrakeLight : 109|3@1+ (1,0) [0|7] ""  RadarFrontCenter,DASy

BO_ 202 VFC_Object13A: 64 MPC3
 SG_ VFC_Obj13A_CRC : 0|16@1+ (1,0) [0|65535] ""  RadarFrontCenter,DASy
 SG_ VFC_Obj13A_AliveCtr : 16|8@1+ (1,0) [0|255] ""  RadarFrontCenter,DASy
 SG_ VFC_Obj13A_ProtBlockCtr : 24|4@1+ (1,0) [0|15] ""  RadarFrontCenter,DASy
 SG_ VFC_Obj13A_ID : 32|8@1+ (1,0) [1|255] ""  RadarFrontCenter,DASy
 SG_ VFC_Obj13A_Type : 60|4@1+ (1,0) [0|15] ""  RadarFrontCenter,DASy
 SG_ VFC_Obj13A_TypeProb : 378|6@1+ (2,0) [0|100] "%"  RadarFrontCenter,DASy
 SG_ VFC_Obj13A_Dx : 48|12@1+ (0.05,0) [0|204.75] "m"  RadarFrontCenter,DASy
 SG_ VFC_Obj13A_Dy : 64|14@1+ (0.01,-80) [-80|80] "m"  RadarFrontCenter,DASy
 SG_ VFC_Obj13A_Vx : 80|11@1+ (0.1,-154) [-154|50] "m/s"  RadarFrontCenter,DASy
 SG_ VFC_Obj13A_Vy : 96|10@1+ (0.1,-50) [-50|50] "m/s"  RadarFrontCenter,DASy
 SG_ VFC_Obj13A_Ax : 112|9@1+ (0.1,-16) [-16|16] "m/s^2"  RadarFrontCenter,DASy
 SG_ VFC_Obj13A_Ay : 128|8@1+ (0.1,-12) [-12|12] "m/s^2"  RadarFrontCenter,DASy
 SG_ VFC_Obj13A_DxStdDev : 144|10@1+ (0.05,0) [0|51.15] "m"  RadarFrontCenter,DASy
 SG_ VFC_Obj13A_DyStdDev : 160|10@1+ (0.02,0) [0|20.46] "m"  RadarFrontCenter,DASy
 SG_ VFC_Obj13A_VxStdDev : 176|10@1+ (0.1,0) [0|102.3] "m/s"  RadarFrontCenter,DASy
 SG_ VFC_Obj13A_VyStdDev : 192|9@1+ (0.1,0) [0|51.1] "m/s"  RadarFrontCenter,DASy
 SG_ VFC_Obj13A_AxStdDev : 40|8@1+ (0.1,0) [0|25.5] "m/s^2"  RadarFrontCenter,DASy
 SG_ VFC_Obj13A_AyStdDev : 136|8@1+ (0.1,0) [0|25.5] "m/s^2"  RadarFrontCenter,DASy
 SG_ VFC_Obj13A_Length : 217|9@1+ (0.05,0) [0|25.55] "m"  RadarFrontCenter,DASy
 SG_ VFC_Obj13A_Width : 294|10@1+ (0.01,0) [0|10.23] "m"  RadarFrontCenter,DASy
 SG_ VFC_Obj13A_Height : 208|9@1+ (0.01,0) [0|5.11] "m"  RadarFrontCenter,DASy
 SG_ VFC_Obj13A_LengthStdDev : 384|7@1+ (0.05,0) [0|5] "m"  RadarFrontCenter,DASy
 SG_ VFC_Obj13A_WidthStdDev : 391|7@1+ (0.01,0) [0|1] "m"  RadarFrontCenter,DASy
 SG_ VFC_Obj13A_HeightStdDev : 201|7@1+ (0.01,0) [0|1] "m"  RadarFrontCenter,DASy
 SG_ VFC_Obj13A_EdgeLeft : 411|13@1+ (0.00025,-1) [-1|1] "unitless"  RadarFrontCenter,DASy
 SG_ VFC_Obj13A_EdgeMid : 398|13@1+ (0.00025,-1) [-1|1] "unitless"  RadarFrontCenter,DASy
 SG_ VFC_Obj13A_EdgeRight : 424|13@1+ (0.00025,-1) [-1|1] "unitless"  RadarFrontCenter,DASy
 SG_ VFC_Obj13A_EdgeTop : 448|12@1+ (0.00025,-0.5) [-0.5|0.5] "unitless"  RadarFrontCenter,DASy
 SG_ VFC_Obj13A_EdgeBottom : 269|12@1+ (0.00025,-0.5) [-0.5|0.5] "unitless"  RadarFrontCenter,DASy
 SG_ VFC_Obj13A_EdgeLeftStdDev : 440|8@1+ (0.0002,0) [0|0.051] "unitless"  RadarFrontCenter,DASy
 SG_ VFC_Obj13A_EdgeMidStdDev : 464|8@1+ (0.0002,0) [0|0.051] "unitless"  RadarFrontCenter,DASy
 SG_ VFC_Obj13A_EdgeRightStdDev : 472|8@1+ (0.0002,0) [0|0.051] "unitless"  RadarFrontCenter,DASy
 SG_ VFC_Obj13A_EdgeTopStdDev : 480|8@1+ (0.0002,0) [0|0.051] "unitless"  RadarFrontCenter,DASy
 SG_ VFC_Obj13A_EdgeBottomStdDev : 488|8@1+ (0.0002,0) [0|0.051] "unitless"  RadarFrontCenter,DASy
 SG_ VFC_Obj13A_NormVx : 304|16@1+ (0.001,-40) [-40|25] "1/s"  RadarFrontCenter,DASy
 SG_ VFC_Obj13A_NormAx : 235|13@1+ (0.002,-10) [-10|6] "1/s^2"  RadarFrontCenter,DASy
 SG_ VFC_Obj13A_NormVyEdgeLeft : 256|13@1+ (0.001,-4) [-4|4] "1/s"  RadarFrontCenter,DASy
 SG_ VFC_Obj13A_NormVyEdgeRight : 281|13@1+ (0.001,-4) [-4|4] "1/s"  RadarFrontCenter,DASy
 SG_ VFC_Obj13A_NormVxStdDev : 368|10@1+ (0.001,0) [0|1.023] "1/s"  RadarFrontCenter,DASy
 SG_ VFC_Obj13A_NormAxStdDev : 328|10@1+ (0.0025,0) [0|2.5575] "1/s^2"  RadarFrontCenter,DASy
 SG_ VFC_Obj13A_NormVyEdgeLeftStdDev : 248|8@1+ (0.001,0) [0|0.255] "1/s"  RadarFrontCenter,DASy
 SG_ VFC_Obj13A_NormVyEdgeRightStdDev : 320|8@1+ (0.001,0) [0|0.255] "1/s"  RadarFrontCenter,DASy
 SG_ VFC_Obj13A_ScaleChange : 338|14@1+ (0.0001,0.5) [0.5|2.1383] "unitless"  RadarFrontCenter,DASy
 SG_ VFC_Obj13A_ScaleChngStdDev : 352|10@1+ (0.0001,0) [0|0.1023] "unitless"  RadarFrontCenter,DASy
 SG_ VFC_Obj13A_HeadingAngle : 226|9@1+ (0.01,-1.57) [-1.57|1.57] "rad"  RadarFrontCenter,DASy
 SG_ VFC_Obj13A_HeadingAngleStdDev : 186|6@1+ (0.01,0) [0|0.5] "rad"  RadarFrontCenter,DASy
 SG_ VFC_Obj13A_HeadOrientation : 460|4@1+ (1,0) [0|15] ""  RadarFrontCenter,DASy
 SG_ VFC_Obj13A_CompletelyInImg : 121|1@1+ (1,0) [0|1] ""  RadarFrontCenter,DASy
 SG_ VFC_Obj13A_ProbMovingLat : 154|6@1+ (2,0) [0|100] "%"  RadarFrontCenter,DASy
 SG_ VFC_Obj13A_ProbMovingLong : 170|6@1+ (2,0) [0|100] "%"  RadarFrontCenter,DASy
 SG_ VFC_Obj13A_ProbExist : 122|6@1+ (2,0) [0|100] "%"  RadarFrontCenter,DASy
 SG_ VFC_Obj13A_MeasSource : 91|5@1+ (1,0) [0|31] ""  RadarFrontCenter,DASy
 SG_ VFC_Obj13A_Reliability : 362|6@1+ (1,0) [0|63] ""  RadarFrontCenter,DASy
 SG_ VFC_Obj13A_Measured : 78|2@1+ (1,0) [0|3] ""  RadarFrontCenter,DASy
 SG_ VFC_Obj13A_VisibleView : 437|3@1+ (1,0) [0|4] ""  RadarFrontCenter,DASy
 SG_ VFC_Obj13A_ClassifiedView : 496|3@1+ (1,0) [0|4] ""  RadarFrontCenter,DASy
 SG_ VFC_Obj13A_DirIndicator : 106|3@1+ (1,0) [0|4] ""  RadarFrontCenter,DASy
 SG_ VFC_Obj13A_BrakeLight : 109|3@1+ (1,0) [0|7] ""  RadarFrontCenter,DASy

BO_ 204 VFC_Object14A: 64 MPC3
 SG_ VFC_Obj14A_CRC : 0|16@1+ (1,0) [0|65535] ""  RadarFrontCenter,DASy
 SG_ VFC_Obj14A_AliveCtr : 16|8@1+ (1,0) [0|255] ""  RadarFrontCenter,DASy
 SG_ VFC_Obj14A_ProtBlockCtr : 24|4@1+ (1,0) [0|15] ""  RadarFrontCenter,DASy
 SG_ VFC_Obj14A_ID : 32|8@1+ (1,0) [1|255] ""  RadarFrontCenter,DASy
 SG_ VFC_Obj14A_Type : 60|4@1+ (1,0) [0|15] ""  RadarFrontCenter,DASy
 SG_ VFC_Obj14A_TypeProb : 378|6@1+ (2,0) [0|100] "%"  RadarFrontCenter,DASy
 SG_ VFC_Obj14A_Dx : 48|12@1+ (0.05,0) [0|204.75] "m"  RadarFrontCenter,DASy
 SG_ VFC_Obj14A_Dy : 64|14@1+ (0.01,-80) [-80|80] "m"  RadarFrontCenter,DASy
 SG_ VFC_Obj14A_Vx : 80|11@1+ (0.1,-154) [-154|50] "m/s"  RadarFrontCenter,DASy
 SG_ VFC_Obj14A_Vy : 96|10@1+ (0.1,-50) [-50|50] "m/s"  RadarFrontCenter,DASy
 SG_ VFC_Obj14A_Ax : 112|9@1+ (0.1,-16) [-16|16] "m/s^2"  RadarFrontCenter,DASy
 SG_ VFC_Obj14A_Ay : 128|8@1+ (0.1,-12) [-12|12] "m/s^2"  RadarFrontCenter,DASy
 SG_ VFC_Obj14A_DxStdDev : 144|10@1+ (0.05,0) [0|51.15] "m"  RadarFrontCenter,DASy
 SG_ VFC_Obj14A_DyStdDev : 160|10@1+ (0.02,0) [0|20.46] "m"  RadarFrontCenter,DASy
 SG_ VFC_Obj14A_VxStdDev : 176|10@1+ (0.1,0) [0|102.3] "m/s"  RadarFrontCenter,DASy
 SG_ VFC_Obj14A_VyStdDev : 192|9@1+ (0.1,0) [0|51.1] "m/s"  RadarFrontCenter,DASy
 SG_ VFC_Obj14A_AxStdDev : 40|8@1+ (0.1,0) [0|25.5] "m/s^2"  RadarFrontCenter,DASy
 SG_ VFC_Obj14A_AyStdDev : 136|8@1+ (0.1,0) [0|25.5] "m/s^2"  RadarFrontCenter,DASy
 SG_ VFC_Obj14A_Length : 217|9@1+ (0.05,0) [0|25.55] "m"  RadarFrontCenter,DASy
 SG_ VFC_Obj14A_Width : 294|10@1+ (0.01,0) [0|10.23] "m"  RadarFrontCenter,DASy
 SG_ VFC_Obj14A_Height : 208|9@1+ (0.01,0) [0|5.11] "m"  RadarFrontCenter,DASy
 SG_ VFC_Obj14A_LengthStdDev : 384|7@1+ (0.05,0) [0|5] "m"  RadarFrontCenter,DASy
 SG_ VFC_Obj14A_WidthStdDev : 391|7@1+ (0.01,0) [0|1] "m"  RadarFrontCenter,DASy
 SG_ VFC_Obj14A_HeightStdDev : 201|7@1+ (0.01,0) [0|1] "m"  RadarFrontCenter,DASy
 SG_ VFC_Obj14A_EdgeLeft : 411|13@1+ (0.00025,-1) [-1|1] "unitless"  RadarFrontCenter,DASy
 SG_ VFC_Obj14A_EdgeMid : 398|13@1+ (0.00025,-1) [-1|1] "unitless"  RadarFrontCenter,DASy
 SG_ VFC_Obj14A_EdgeRight : 424|13@1+ (0.00025,-1) [-1|1] "unitless"  RadarFrontCenter,DASy
 SG_ VFC_Obj14A_EdgeTop : 448|12@1+ (0.00025,-0.5) [-0.5|0.5] "unitless"  RadarFrontCenter,DASy
 SG_ VFC_Obj14A_EdgeBottom : 269|12@1+ (0.00025,-0.5) [-0.5|0.5] "unitless"  RadarFrontCenter,DASy
 SG_ VFC_Obj14A_EdgeLeftStdDev : 440|8@1+ (0.0002,0) [0|0.051] "unitless"  RadarFrontCenter,DASy
 SG_ VFC_Obj14A_EdgeMidStdDev : 464|8@1+ (0.0002,0) [0|0.051] "unitless"  RadarFrontCenter,DASy
 SG_ VFC_Obj14A_EdgeRightStdDev : 472|8@1+ (0.0002,0) [0|0.051] "unitless"  RadarFrontCenter,DASy
 SG_ VFC_Obj14A_EdgeTopStdDev : 480|8@1+ (0.0002,0) [0|0.051] "unitless"  RadarFrontCenter,DASy
 SG_ VFC_Obj14A_EdgeBottomStdDev : 488|8@1+ (0.0002,0) [0|0.051] "unitless"  RadarFrontCenter,DASy
 SG_ VFC_Obj14A_NormVx : 304|16@1+ (0.001,-40) [-40|25] "1/s"  RadarFrontCenter,DASy
 SG_ VFC_Obj14A_NormAx : 235|13@1+ (0.002,-10) [-10|6] "1/s^2"  RadarFrontCenter,DASy
 SG_ VFC_Obj14A_NormVyEdgeLeft : 256|13@1+ (0.001,-4) [-4|4] "1/s"  RadarFrontCenter,DASy
 SG_ VFC_Obj14A_NormVyEdgeRight : 281|13@1+ (0.001,-4) [-4|4] "1/s"  RadarFrontCenter,DASy
 SG_ VFC_Obj14A_NormVxStdDev : 368|10@1+ (0.001,0) [0|1.023] "1/s"  RadarFrontCenter,DASy
 SG_ VFC_Obj14A_NormAxStdDev : 328|10@1+ (0.0025,0) [0|2.5575] "1/s^2"  RadarFrontCenter,DASy
 SG_ VFC_Obj14A_NormVyEdgeLeftStdDev : 248|8@1+ (0.001,0) [0|0.255] "1/s"  RadarFrontCenter,DASy
 SG_ VFC_Obj14A_NormVyEdgeRightStdDev : 320|8@1+ (0.001,0) [0|0.255] "1/s"  RadarFrontCenter,DASy
 SG_ VFC_Obj14A_ScaleChange : 338|14@1+ (0.0001,0.5) [0.5|2.1383] "unitless"  RadarFrontCenter,DASy
 SG_ VFC_Obj14A_ScaleChngStdDev : 352|10@1+ (0.0001,0) [0|0.1023] "unitless"  RadarFrontCenter,DASy
 SG_ VFC_Obj14A_HeadingAngle : 226|9@1+ (0.01,-1.57) [-1.57|1.57] "rad"  RadarFrontCenter,DASy
 SG_ VFC_Obj14A_HeadingAngleStdDev : 186|6@1+ (0.01,0) [0|0.5] "rad"  RadarFrontCenter,DASy
 SG_ VFC_Obj14A_HeadOrientation : 460|4@1+ (1,0) [0|15] ""  RadarFrontCenter,DASy
 SG_ VFC_Obj14A_CompletelyInImg : 121|1@1+ (1,0) [0|1] ""  RadarFrontCenter,DASy
 SG_ VFC_Obj14A_ProbMovingLat : 154|6@1+ (2,0) [0|100] "%"  RadarFrontCenter,DASy
 SG_ VFC_Obj14A_ProbMovingLong : 170|6@1+ (2,0) [0|100] "%"  RadarFrontCenter,DASy
 SG_ VFC_Obj14A_ProbExist : 122|6@1+ (2,0) [0|100] "%"  RadarFrontCenter,DASy
 SG_ VFC_Obj14A_MeasSource : 91|5@1+ (1,0) [0|31] ""  RadarFrontCenter,DASy
 SG_ VFC_Obj14A_Reliability : 362|6@1+ (1,0) [0|63] ""  RadarFrontCenter,DASy
 SG_ VFC_Obj14A_Measured : 78|2@1+ (1,0) [0|3] ""  RadarFrontCenter,DASy
 SG_ VFC_Obj14A_VisibleView : 437|3@1+ (1,0) [0|4] ""  RadarFrontCenter,DASy
 SG_ VFC_Obj14A_ClassifiedView : 496|3@1+ (1,0) [0|4] ""  RadarFrontCenter,DASy
 SG_ VFC_Obj14A_DirIndicator : 106|3@1+ (1,0) [0|4] ""  RadarFrontCenter,DASy
 SG_ VFC_Obj14A_BrakeLight : 109|3@1+ (1,0) [0|7] ""  RadarFrontCenter,DASy

BO_ 206 VFC_Object15A: 64 MPC3
 SG_ VFC_Obj15A_CRC : 0|16@1+ (1,0) [0|65535] ""  RadarFrontCenter,DASy
 SG_ VFC_Obj15A_AliveCtr : 16|8@1+ (1,0) [0|255] ""  RadarFrontCenter,DASy
 SG_ VFC_Obj15A_ProtBlockCtr : 24|4@1+ (1,0) [0|15] ""  RadarFrontCenter,DASy
 SG_ VFC_Obj15A_ID : 32|8@1+ (1,0) [1|255] ""  RadarFrontCenter,DASy
 SG_ VFC_Obj15A_Type : 60|4@1+ (1,0) [0|15] ""  RadarFrontCenter,DASy
 SG_ VFC_Obj15A_TypeProb : 378|6@1+ (2,0) [0|100] "%"  RadarFrontCenter,DASy
 SG_ VFC_Obj15A_Dx : 48|12@1+ (0.05,0) [0|204.75] "m"  RadarFrontCenter,DASy
 SG_ VFC_Obj15A_Dy : 64|14@1+ (0.01,-80) [-80|80] "m"  RadarFrontCenter,DASy
 SG_ VFC_Obj15A_Vx : 80|11@1+ (0.1,-154) [-154|50] "m/s"  RadarFrontCenter,DASy
 SG_ VFC_Obj15A_Vy : 96|10@1+ (0.1,-50) [-50|50] "m/s"  RadarFrontCenter,DASy
 SG_ VFC_Obj15A_Ax : 112|9@1+ (0.1,-16) [-16|16] "m/s^2"  RadarFrontCenter,DASy
 SG_ VFC_Obj15A_Ay : 128|8@1+ (0.1,-12) [-12|12] "m/s^2"  RadarFrontCenter,DASy
 SG_ VFC_Obj15A_DxStdDev : 144|10@1+ (0.05,0) [0|51.15] "m"  RadarFrontCenter,DASy
 SG_ VFC_Obj15A_DyStdDev : 160|10@1+ (0.02,0) [0|20.46] "m"  RadarFrontCenter,DASy
 SG_ VFC_Obj15A_VxStdDev : 176|10@1+ (0.1,0) [0|102.3] "m/s"  RadarFrontCenter,DASy
 SG_ VFC_Obj15A_VyStdDev : 192|9@1+ (0.1,0) [0|51.1] "m/s"  RadarFrontCenter,DASy
 SG_ VFC_Obj15A_AxStdDev : 40|8@1+ (0.1,0) [0|25.5] "m/s^2"  RadarFrontCenter,DASy
 SG_ VFC_Obj15A_AyStdDev : 136|8@1+ (0.1,0) [0|25.5] "m/s^2"  RadarFrontCenter,DASy
 SG_ VFC_Obj15A_Length : 217|9@1+ (0.05,0) [0|25.55] "m"  RadarFrontCenter,DASy
 SG_ VFC_Obj15A_Width : 294|10@1+ (0.01,0) [0|10.23] "m"  RadarFrontCenter,DASy
 SG_ VFC_Obj15A_Height : 208|9@1+ (0.01,0) [0|5.11] "m"  RadarFrontCenter,DASy
 SG_ VFC_Obj15A_LengthStdDev : 384|7@1+ (0.05,0) [0|5] "m"  RadarFrontCenter,DASy
 SG_ VFC_Obj15A_WidthStdDev : 391|7@1+ (0.01,0) [0|1] "m"  RadarFrontCenter,DASy
 SG_ VFC_Obj15A_HeightStdDev : 201|7@1+ (0.01,0) [0|1] "m"  RadarFrontCenter,DASy
 SG_ VFC_Obj15A_EdgeLeft : 411|13@1+ (0.00025,-1) [-1|1] "unitless"  RadarFrontCenter,DASy
 SG_ VFC_Obj15A_EdgeMid : 398|13@1+ (0.00025,-1) [-1|1] "unitless"  RadarFrontCenter,DASy
 SG_ VFC_Obj15A_EdgeRight : 424|13@1+ (0.00025,-1) [-1|1] "unitless"  RadarFrontCenter,DASy
 SG_ VFC_Obj15A_EdgeTop : 448|12@1+ (0.00025,-0.5) [-0.5|0.5] "unitless"  RadarFrontCenter,DASy
 SG_ VFC_Obj15A_EdgeBottom : 269|12@1+ (0.00025,-0.5) [-0.5|0.5] "unitless"  RadarFrontCenter,DASy
 SG_ VFC_Obj15A_EdgeLeftStdDev : 440|8@1+ (0.0002,0) [0|0.051] "unitless"  RadarFrontCenter,DASy
 SG_ VFC_Obj15A_EdgeMidStdDev : 464|8@1+ (0.0002,0) [0|0.051] "unitless"  RadarFrontCenter,DASy
 SG_ VFC_Obj15A_EdgeRightStdDev : 472|8@1+ (0.0002,0) [0|0.051] "unitless"  RadarFrontCenter,DASy
 SG_ VFC_Obj15A_EdgeTopStdDev : 480|8@1+ (0.0002,0) [0|0.051] "unitless"  RadarFrontCenter,DASy
 SG_ VFC_Obj15A_EdgeBottomStdDev : 488|8@1+ (0.0002,0) [0|0.051] "unitless"  RadarFrontCenter,DASy
 SG_ VFC_Obj15A_NormVx : 304|16@1+ (0.001,-40) [-40|25] "1/s"  RadarFrontCenter,DASy
 SG_ VFC_Obj15A_NormAx : 235|13@1+ (0.002,-10) [-10|6] "1/s^2"  RadarFrontCenter,DASy
 SG_ VFC_Obj15A_NormVyEdgeLeft : 256|13@1+ (0.001,-4) [-4|4] "1/s"  RadarFrontCenter,DASy
 SG_ VFC_Obj15A_NormVyEdgeRight : 281|13@1+ (0.001,-4) [-4|4] "1/s"  RadarFrontCenter,DASy
 SG_ VFC_Obj15A_NormVxStdDev : 368|10@1+ (0.001,0) [0|1.023] "1/s"  RadarFrontCenter,DASy
 SG_ VFC_Obj15A_NormAxStdDev : 328|10@1+ (0.0025,0) [0|2.5575] "1/s^2"  RadarFrontCenter,DASy
 SG_ VFC_Obj15A_NormVyEdgeLeftStdDev : 248|8@1+ (0.001,0) [0|0.255] "1/s"  RadarFrontCenter,DASy
 SG_ VFC_Obj15A_NormVyEdgeRightStdDev : 320|8@1+ (0.001,0) [0|0.255] "1/s"  RadarFrontCenter,DASy
 SG_ VFC_Obj15A_ScaleChange : 338|14@1+ (0.0001,0.5) [0.5|2.1383] "unitless"  RadarFrontCenter,DASy
 SG_ VFC_Obj15A_ScaleChngStdDev : 352|10@1+ (0.0001,0) [0|0.1023] "unitless"  RadarFrontCenter,DASy
 SG_ VFC_Obj15A_HeadingAngle : 226|9@1+ (0.01,-1.57) [-1.57|1.57] "rad"  RadarFrontCenter,DASy
 SG_ VFC_Obj15A_HeadingAngleStdDev : 186|6@1+ (0.01,0) [0|0.5] "rad"  RadarFrontCenter,DASy
 SG_ VFC_Obj15A_HeadOrientation : 460|4@1+ (1,0) [0|15] ""  RadarFrontCenter,DASy
 SG_ VFC_Obj15A_CompletelyInImg : 121|1@1+ (1,0) [0|1] ""  RadarFrontCenter,DASy
 SG_ VFC_Obj15A_ProbMovingLat : 154|6@1+ (2,0) [0|100] "%"  RadarFrontCenter,DASy
 SG_ VFC_Obj15A_ProbMovingLong : 170|6@1+ (2,0) [0|100] "%"  RadarFrontCenter,DASy
 SG_ VFC_Obj15A_ProbExist : 122|6@1+ (2,0) [0|100] "%"  RadarFrontCenter,DASy
 SG_ VFC_Obj15A_MeasSource : 91|5@1+ (1,0) [0|31] ""  RadarFrontCenter,DASy
 SG_ VFC_Obj15A_Reliability : 362|6@1+ (1,0) [0|63] ""  RadarFrontCenter,DASy
 SG_ VFC_Obj15A_Measured : 78|2@1+ (1,0) [0|3] ""  RadarFrontCenter,DASy
 SG_ VFC_Obj15A_VisibleView : 437|3@1+ (1,0) [0|4] ""  RadarFrontCenter,DASy
 SG_ VFC_Obj15A_ClassifiedView : 496|3@1+ (1,0) [0|4] ""  RadarFrontCenter,DASy
 SG_ VFC_Obj15A_DirIndicator : 106|3@1+ (1,0) [0|4] ""  RadarFrontCenter,DASy
 SG_ VFC_Obj15A_BrakeLight : 109|3@1+ (1,0) [0|7] ""  RadarFrontCenter,DASy

BO_ 208 VFC_Object16A: 64 MPC3
 SG_ VFC_Obj16A_CRC : 0|16@1+ (1,0) [0|65535] ""  RadarFrontCenter,DASy
 SG_ VFC_Obj16A_AliveCtr : 16|8@1+ (1,0) [0|255] ""  RadarFrontCenter,DASy
 SG_ VFC_Obj16A_ProtBlockCtr : 24|4@1+ (1,0) [0|15] ""  RadarFrontCenter,DASy
 SG_ VFC_Obj16A_ID : 32|8@1+ (1,0) [1|255] ""  RadarFrontCenter,DASy
 SG_ VFC_Obj16A_Type : 60|4@1+ (1,0) [0|15] ""  RadarFrontCenter,DASy
 SG_ VFC_Obj16A_TypeProb : 378|6@1+ (2,0) [0|100] "%"  RadarFrontCenter,DASy
 SG_ VFC_Obj16A_Dx : 48|12@1+ (0.05,0) [0|204.75] "m"  RadarFrontCenter,DASy
 SG_ VFC_Obj16A_Dy : 64|14@1+ (0.01,-80) [-80|80] "m"  RadarFrontCenter,DASy
 SG_ VFC_Obj16A_Vx : 80|11@1+ (0.1,-154) [-154|50] "m/s"  RadarFrontCenter,DASy
 SG_ VFC_Obj16A_Vy : 96|10@1+ (0.1,-50) [-50|50] "m/s"  RadarFrontCenter,DASy
 SG_ VFC_Obj16A_Ax : 112|9@1+ (0.1,-16) [-16|16] "m/s^2"  RadarFrontCenter,DASy
 SG_ VFC_Obj16A_Ay : 128|8@1+ (0.1,-12) [-12|12] "m/s^2"  RadarFrontCenter,DASy
 SG_ VFC_Obj16A_DxStdDev : 144|10@1+ (0.05,0) [0|51.15] "m"  RadarFrontCenter,DASy
 SG_ VFC_Obj16A_DyStdDev : 160|10@1+ (0.02,0) [0|20.46] "m"  RadarFrontCenter,DASy
 SG_ VFC_Obj16A_VxStdDev : 176|10@1+ (0.1,0) [0|102.3] "m/s"  RadarFrontCenter,DASy
 SG_ VFC_Obj16A_VyStdDev : 192|9@1+ (0.1,0) [0|51.1] "m/s"  RadarFrontCenter,DASy
 SG_ VFC_Obj16A_AxStdDev : 40|8@1+ (0.1,0) [0|25.5] "m/s^2"  RadarFrontCenter,DASy
 SG_ VFC_Obj16A_AyStdDev : 136|8@1+ (0.1,0) [0|25.5] "m/s^2"  RadarFrontCenter,DASy
 SG_ VFC_Obj16A_Length : 217|9@1+ (0.05,0) [0|25.55] "m"  RadarFrontCenter,DASy
 SG_ VFC_Obj16A_Width : 294|10@1+ (0.01,0) [0|10.23] "m"  RadarFrontCenter,DASy
 SG_ VFC_Obj16A_Height : 208|9@1+ (0.01,0) [0|5.11] "m"  RadarFrontCenter,DASy
 SG_ VFC_Obj16A_LengthStdDev : 384|7@1+ (0.05,0) [0|5] "m"  RadarFrontCenter,DASy
 SG_ VFC_Obj16A_WidthStdDev : 391|7@1+ (0.01,0) [0|1] "m"  RadarFrontCenter,DASy
 SG_ VFC_Obj16A_HeightStdDev : 201|7@1+ (0.01,0) [0|1] "m"  RadarFrontCenter,DASy
 SG_ VFC_Obj16A_EdgeLeft : 411|13@1+ (0.00025,-1) [-1|1] "unitless"  RadarFrontCenter,DASy
 SG_ VFC_Obj16A_EdgeMid : 398|13@1+ (0.00025,-1) [-1|1] "unitless"  RadarFrontCenter,DASy
 SG_ VFC_Obj16A_EdgeRight : 424|13@1+ (0.00025,-1) [-1|1] "unitless"  RadarFrontCenter,DASy
 SG_ VFC_Obj16A_EdgeTop : 448|12@1+ (0.00025,-0.5) [-0.5|0.5] "unitless"  RadarFrontCenter,DASy
 SG_ VFC_Obj16A_EdgeBottom : 269|12@1+ (0.00025,-0.5) [-0.5|0.5] "unitless"  RadarFrontCenter,DASy
 SG_ VFC_Obj16A_EdgeLeftStdDev : 440|8@1+ (0.0002,0) [0|0.051] "unitless"  RadarFrontCenter,DASy
 SG_ VFC_Obj16A_EdgeMidStdDev : 464|8@1+ (0.0002,0) [0|0.051] "unitless"  RadarFrontCenter,DASy
 SG_ VFC_Obj16A_EdgeRightStdDev : 472|8@1+ (0.0002,0) [0|0.051] "unitless"  RadarFrontCenter,DASy
 SG_ VFC_Obj16A_EdgeTopStdDev : 480|8@1+ (0.0002,0) [0|0.051] "unitless"  RadarFrontCenter,DASy
 SG_ VFC_Obj16A_EdgeBottomStdDev : 488|8@1+ (0.0002,0) [0|0.051] "unitless"  RadarFrontCenter,DASy
 SG_ VFC_Obj16A_NormVx : 304|16@1+ (0.001,-40) [-40|25] "1/s"  RadarFrontCenter,DASy
 SG_ VFC_Obj16A_NormAx : 235|13@1+ (0.002,-10) [-10|6] "1/s^2"  RadarFrontCenter,DASy
 SG_ VFC_Obj16A_NormVyEdgeLeft : 256|13@1+ (0.001,-4) [-4|4] "1/s"  RadarFrontCenter,DASy
 SG_ VFC_Obj16A_NormVyEdgeRight : 281|13@1+ (0.001,-4) [-4|4] "1/s"  RadarFrontCenter,DASy
 SG_ VFC_Obj16A_NormVxStdDev : 368|10@1+ (0.001,0) [0|1.023] "1/s"  RadarFrontCenter,DASy
 SG_ VFC_Obj16A_NormAxStdDev : 328|10@1+ (0.0025,0) [0|2.5575] "1/s^2"  RadarFrontCenter,DASy
 SG_ VFC_Obj16A_NormVyEdgeLeftStdDev : 248|8@1+ (0.001,0) [0|0.255] "1/s"  RadarFrontCenter,DASy
 SG_ VFC_Obj16A_NormVyEdgeRightStdDev : 320|8@1+ (0.001,0) [0|0.255] "1/s"  RadarFrontCenter,DASy
 SG_ VFC_Obj16A_ScaleChange : 338|14@1+ (0.0001,0.5) [0.5|2.1383] "unitless"  RadarFrontCenter,DASy
 SG_ VFC_Obj16A_ScaleChngStdDev : 352|10@1+ (0.0001,0) [0|0.1023] "unitless"  RadarFrontCenter,DASy
 SG_ VFC_Obj16A_HeadingAngle : 226|9@1+ (0.01,-1.57) [-1.57|1.57] "rad"  RadarFrontCenter,DASy
 SG_ VFC_Obj16A_HeadingAngleStdDev : 186|6@1+ (0.01,0) [0|0.5] "rad"  RadarFrontCenter,DASy
 SG_ VFC_Obj16A_HeadOrientation : 460|4@1+ (1,0) [0|15] ""  RadarFrontCenter,DASy
 SG_ VFC_Obj16A_CompletelyInImg : 121|1@1+ (1,0) [0|1] ""  RadarFrontCenter,DASy
 SG_ VFC_Obj16A_ProbMovingLat : 154|6@1+ (2,0) [0|100] "%"  RadarFrontCenter,DASy
 SG_ VFC_Obj16A_ProbMovingLong : 170|6@1+ (2,0) [0|100] "%"  RadarFrontCenter,DASy
 SG_ VFC_Obj16A_ProbExist : 122|6@1+ (2,0) [0|100] "%"  RadarFrontCenter,DASy
 SG_ VFC_Obj16A_MeasSource : 91|5@1+ (1,0) [0|31] ""  RadarFrontCenter,DASy
 SG_ VFC_Obj16A_Reliability : 362|6@1+ (1,0) [0|63] ""  RadarFrontCenter,DASy
 SG_ VFC_Obj16A_Measured : 78|2@1+ (1,0) [0|3] ""  RadarFrontCenter,DASy
 SG_ VFC_Obj16A_VisibleView : 437|3@1+ (1,0) [0|4] ""  RadarFrontCenter,DASy
 SG_ VFC_Obj16A_ClassifiedView : 496|3@1+ (1,0) [0|4] ""  RadarFrontCenter,DASy
 SG_ VFC_Obj16A_DirIndicator : 106|3@1+ (1,0) [0|4] ""  RadarFrontCenter,DASy
 SG_ VFC_Obj16A_BrakeLight : 109|3@1+ (1,0) [0|7] ""  RadarFrontCenter,DASy

BO_ 210 VFC_Object17A: 64 MPC3
 SG_ VFC_Obj17A_CRC : 0|16@1+ (1,0) [0|65535] ""  RadarFrontCenter,DASy
 SG_ VFC_Obj17A_AliveCtr : 16|8@1+ (1,0) [0|255] ""  RadarFrontCenter,DASy
 SG_ VFC_Obj17A_ProtBlockCtr : 24|4@1+ (1,0) [0|15] ""  RadarFrontCenter,DASy
 SG_ VFC_Obj17A_ID : 32|8@1+ (1,0) [1|255] ""  RadarFrontCenter,DASy
 SG_ VFC_Obj17A_Type : 60|4@1+ (1,0) [0|15] ""  RadarFrontCenter,DASy
 SG_ VFC_Obj17A_TypeProb : 378|6@1+ (2,0) [0|100] "%"  RadarFrontCenter,DASy
 SG_ VFC_Obj17A_Dx : 48|12@1+ (0.05,0) [0|204.75] "m"  RadarFrontCenter,DASy
 SG_ VFC_Obj17A_Dy : 64|14@1+ (0.01,-80) [-80|80] "m"  RadarFrontCenter,DASy
 SG_ VFC_Obj17A_Vx : 80|11@1+ (0.1,-154) [-154|50] "m/s"  RadarFrontCenter,DASy
 SG_ VFC_Obj17A_Vy : 96|10@1+ (0.1,-50) [-50|50] "m/s"  RadarFrontCenter,DASy
 SG_ VFC_Obj17A_Ax : 112|9@1+ (0.1,-16) [-16|16] "m/s^2"  RadarFrontCenter,DASy
 SG_ VFC_Obj17A_Ay : 128|8@1+ (0.1,-12) [-12|12] "m/s^2"  RadarFrontCenter,DASy
 SG_ VFC_Obj17A_DxStdDev : 144|10@1+ (0.05,0) [0|51.15] "m"  RadarFrontCenter,DASy
 SG_ VFC_Obj17A_DyStdDev : 160|10@1+ (0.02,0) [0|20.46] "m"  RadarFrontCenter,DASy
 SG_ VFC_Obj17A_VxStdDev : 176|10@1+ (0.1,0) [0|102.3] "m/s"  RadarFrontCenter,DASy
 SG_ VFC_Obj17A_VyStdDev : 192|9@1+ (0.1,0) [0|51.1] "m/s"  RadarFrontCenter,DASy
 SG_ VFC_Obj17A_AxStdDev : 40|8@1+ (0.1,0) [0|25.5] "m/s^2"  RadarFrontCenter,DASy
 SG_ VFC_Obj17A_AyStdDev : 136|8@1+ (0.1,0) [0|25.5] "m/s^2"  RadarFrontCenter,DASy
 SG_ VFC_Obj17A_Length : 217|9@1+ (0.05,0) [0|25.55] "m"  RadarFrontCenter,DASy
 SG_ VFC_Obj17A_Width : 294|10@1+ (0.01,0) [0|10.23] "m"  RadarFrontCenter,DASy
 SG_ VFC_Obj17A_Height : 208|9@1+ (0.01,0) [0|5.11] "m"  RadarFrontCenter,DASy
 SG_ VFC_Obj17A_LengthStdDev : 384|7@1+ (0.05,0) [0|5] "m"  RadarFrontCenter,DASy
 SG_ VFC_Obj17A_WidthStdDev : 391|7@1+ (0.01,0) [0|1] "m"  RadarFrontCenter,DASy
 SG_ VFC_Obj17A_HeightStdDev : 201|7@1+ (0.01,0) [0|1] "m"  RadarFrontCenter,DASy
 SG_ VFC_Obj17A_EdgeLeft : 411|13@1+ (0.00025,-1) [-1|1] "unitless"  RadarFrontCenter,DASy
 SG_ VFC_Obj17A_EdgeMid : 398|13@1+ (0.00025,-1) [-1|1] "unitless"  RadarFrontCenter,DASy
 SG_ VFC_Obj17A_EdgeRight : 424|13@1+ (0.00025,-1) [-1|1] "unitless"  RadarFrontCenter,DASy
 SG_ VFC_Obj17A_EdgeTop : 448|12@1+ (0.00025,-0.5) [-0.5|0.5] "unitless"  RadarFrontCenter,DASy
 SG_ VFC_Obj17A_EdgeBottom : 269|12@1+ (0.00025,-0.5) [-0.5|0.5] "unitless"  RadarFrontCenter,DASy
 SG_ VFC_Obj17A_EdgeLeftStdDev : 440|8@1+ (0.0002,0) [0|0.051] "unitless"  RadarFrontCenter,DASy
 SG_ VFC_Obj17A_EdgeMidStdDev : 464|8@1+ (0.0002,0) [0|0.051] "unitless"  RadarFrontCenter,DASy
 SG_ VFC_Obj17A_EdgeRightStdDev : 472|8@1+ (0.0002,0) [0|0.051] "unitless"  RadarFrontCenter,DASy
 SG_ VFC_Obj17A_EdgeTopStdDev : 480|8@1+ (0.0002,0) [0|0.051] "unitless"  RadarFrontCenter,DASy
 SG_ VFC_Obj17A_EdgeBottomStdDev : 488|8@1+ (0.0002,0) [0|0.051] "unitless"  RadarFrontCenter,DASy
 SG_ VFC_Obj17A_NormVx : 304|16@1+ (0.001,-40) [-40|25] "1/s"  RadarFrontCenter,DASy
 SG_ VFC_Obj17A_NormAx : 235|13@1+ (0.002,-10) [-10|6] "1/s^2"  RadarFrontCenter,DASy
 SG_ VFC_Obj17A_NormVyEdgeLeft : 256|13@1+ (0.001,-4) [-4|4] "1/s"  RadarFrontCenter,DASy
 SG_ VFC_Obj17A_NormVyEdgeRight : 281|13@1+ (0.001,-4) [-4|4] "1/s"  RadarFrontCenter,DASy
 SG_ VFC_Obj17A_NormVxStdDev : 368|10@1+ (0.001,0) [0|1.023] "1/s"  RadarFrontCenter,DASy
 SG_ VFC_Obj17A_NormAxStdDev : 328|10@1+ (0.0025,0) [0|2.5575] "1/s^2"  RadarFrontCenter,DASy
 SG_ VFC_Obj17A_NormVyEdgeLeftStdDev : 248|8@1+ (0.001,0) [0|0.255] "1/s"  RadarFrontCenter,DASy
 SG_ VFC_Obj17A_NormVyEdgeRightStdDev : 320|8@1+ (0.001,0) [0|0.255] "1/s"  RadarFrontCenter,DASy
 SG_ VFC_Obj17A_ScaleChange : 338|14@1+ (0.0001,0.5) [0.5|2.1383] "unitless"  RadarFrontCenter,DASy
 SG_ VFC_Obj17A_ScaleChngStdDev : 352|10@1+ (0.0001,0) [0|0.1023] "unitless"  RadarFrontCenter,DASy
 SG_ VFC_Obj17A_HeadingAngle : 226|9@1+ (0.01,-1.57) [-1.57|1.57] "rad"  RadarFrontCenter,DASy
 SG_ VFC_Obj17A_HeadingAngleStdDev : 186|6@1+ (0.01,0) [0|0.5] "rad"  RadarFrontCenter,DASy
 SG_ VFC_Obj17A_HeadOrientation : 460|4@1+ (1,0) [0|15] ""  RadarFrontCenter,DASy
 SG_ VFC_Obj17A_CompletelyInImg : 121|1@1+ (1,0) [0|1] ""  RadarFrontCenter,DASy
 SG_ VFC_Obj17A_ProbMovingLat : 154|6@1+ (2,0) [0|100] "%"  RadarFrontCenter,DASy
 SG_ VFC_Obj17A_ProbMovingLong : 170|6@1+ (2,0) [0|100] "%"  RadarFrontCenter,DASy
 SG_ VFC_Obj17A_ProbExist : 122|6@1+ (2,0) [0|100] "%"  RadarFrontCenter,DASy
 SG_ VFC_Obj17A_MeasSource : 91|5@1+ (1,0) [0|31] ""  RadarFrontCenter,DASy
 SG_ VFC_Obj17A_Reliability : 362|6@1+ (1,0) [0|63] ""  RadarFrontCenter,DASy
 SG_ VFC_Obj17A_Measured : 78|2@1+ (1,0) [0|3] ""  RadarFrontCenter,DASy
 SG_ VFC_Obj17A_VisibleView : 437|3@1+ (1,0) [0|4] ""  RadarFrontCenter,DASy
 SG_ VFC_Obj17A_ClassifiedView : 496|3@1+ (1,0) [0|4] ""  RadarFrontCenter,DASy
 SG_ VFC_Obj17A_DirIndicator : 106|3@1+ (1,0) [0|4] ""  RadarFrontCenter,DASy
 SG_ VFC_Obj17A_BrakeLight : 109|3@1+ (1,0) [0|7] ""  RadarFrontCenter,DASy

BO_ 212 VFC_Object18A: 64 MPC3
 SG_ VFC_Obj18A_CRC : 0|16@1+ (1,0) [0|65535] ""  RadarFrontCenter,DASy
 SG_ VFC_Obj18A_AliveCtr : 16|8@1+ (1,0) [0|255] ""  RadarFrontCenter,DASy
 SG_ VFC_Obj18A_ProtBlockCtr : 24|4@1+ (1,0) [0|15] ""  RadarFrontCenter,DASy
 SG_ VFC_Obj18A_ID : 32|8@1+ (1,0) [1|255] ""  RadarFrontCenter,DASy
 SG_ VFC_Obj18A_Type : 60|4@1+ (1,0) [0|15] ""  RadarFrontCenter,DASy
 SG_ VFC_Obj18A_TypeProb : 378|6@1+ (2,0) [0|100] "%"  RadarFrontCenter,DASy
 SG_ VFC_Obj18A_Dx : 48|12@1+ (0.05,0) [0|204.75] "m"  RadarFrontCenter,DASy
 SG_ VFC_Obj18A_Dy : 64|14@1+ (0.01,-80) [-80|80] "m"  RadarFrontCenter,DASy
 SG_ VFC_Obj18A_Vx : 80|11@1+ (0.1,-154) [-154|50] "m/s"  RadarFrontCenter,DASy
 SG_ VFC_Obj18A_Vy : 96|10@1+ (0.1,-50) [-50|50] "m/s"  RadarFrontCenter,DASy
 SG_ VFC_Obj18A_Ax : 112|9@1+ (0.1,-16) [-16|16] "m/s^2"  RadarFrontCenter,DASy
 SG_ VFC_Obj18A_Ay : 128|8@1+ (0.1,-12) [-12|12] "m/s^2"  RadarFrontCenter,DASy
 SG_ VFC_Obj18A_DxStdDev : 144|10@1+ (0.05,0) [0|51.15] "m"  RadarFrontCenter,DASy
 SG_ VFC_Obj18A_DyStdDev : 160|10@1+ (0.02,0) [0|20.46] "m"  RadarFrontCenter,DASy
 SG_ VFC_Obj18A_VxStdDev : 176|10@1+ (0.1,0) [0|102.3] "m/s"  RadarFrontCenter,DASy
 SG_ VFC_Obj18A_VyStdDev : 192|9@1+ (0.1,0) [0|51.1] "m/s"  RadarFrontCenter,DASy
 SG_ VFC_Obj18A_AxStdDev : 40|8@1+ (0.1,0) [0|25.5] "m/s^2"  RadarFrontCenter,DASy
 SG_ VFC_Obj18A_AyStdDev : 136|8@1+ (0.1,0) [0|25.5] "m/s^2"  RadarFrontCenter,DASy
 SG_ VFC_Obj18A_Length : 217|9@1+ (0.05,0) [0|25.55] "m"  RadarFrontCenter,DASy
 SG_ VFC_Obj18A_Width : 294|10@1+ (0.01,0) [0|10.23] "m"  RadarFrontCenter,DASy
 SG_ VFC_Obj18A_Height : 208|9@1+ (0.01,0) [0|5.11] "m"  RadarFrontCenter,DASy
 SG_ VFC_Obj18A_LengthStdDev : 384|7@1+ (0.05,0) [0|5] "m"  RadarFrontCenter,DASy
 SG_ VFC_Obj18A_WidthStdDev : 391|7@1+ (0.01,0) [0|1] "m"  RadarFrontCenter,DASy
 SG_ VFC_Obj18A_HeightStdDev : 201|7@1+ (0.01,0) [0|1] "m"  RadarFrontCenter,DASy
 SG_ VFC_Obj18A_EdgeLeft : 411|13@1+ (0.00025,-1) [-1|1] "unitless"  RadarFrontCenter,DASy
 SG_ VFC_Obj18A_EdgeMid : 398|13@1+ (0.00025,-1) [-1|1] "unitless"  RadarFrontCenter,DASy
 SG_ VFC_Obj18A_EdgeRight : 424|13@1+ (0.00025,-1) [-1|1] "unitless"  RadarFrontCenter,DASy
 SG_ VFC_Obj18A_EdgeTop : 448|12@1+ (0.00025,-0.5) [-0.5|0.5] "unitless"  RadarFrontCenter,DASy
 SG_ VFC_Obj18A_EdgeBottom : 269|12@1+ (0.00025,-0.5) [-0.5|0.5] "unitless"  RadarFrontCenter,DASy
 SG_ VFC_Obj18A_EdgeLeftStdDev : 440|8@1+ (0.0002,0) [0|0.051] "unitless"  RadarFrontCenter,DASy
 SG_ VFC_Obj18A_EdgeMidStdDev : 464|8@1+ (0.0002,0) [0|0.051] "unitless"  RadarFrontCenter,DASy
 SG_ VFC_Obj18A_EdgeRightStdDev : 472|8@1+ (0.0002,0) [0|0.051] "unitless"  RadarFrontCenter,DASy
 SG_ VFC_Obj18A_EdgeTopStdDev : 480|8@1+ (0.0002,0) [0|0.051] "unitless"  RadarFrontCenter,DASy
 SG_ VFC_Obj18A_EdgeBottomStdDev : 488|8@1+ (0.0002,0) [0|0.051] "unitless"  RadarFrontCenter,DASy
 SG_ VFC_Obj18A_NormVx : 304|16@1+ (0.001,-40) [-40|25] "1/s"  RadarFrontCenter,DASy
 SG_ VFC_Obj18A_NormAx : 235|13@1+ (0.002,-10) [-10|6] "1/s^2"  RadarFrontCenter,DASy
 SG_ VFC_Obj18A_NormVyEdgeLeft : 256|13@1+ (0.001,-4) [-4|4] "1/s"  RadarFrontCenter,DASy
 SG_ VFC_Obj18A_NormVyEdgeRight : 281|13@1+ (0.001,-4) [-4|4] "1/s"  RadarFrontCenter,DASy
 SG_ VFC_Obj18A_NormVxStdDev : 368|10@1+ (0.001,0) [0|1.023] "1/s"  RadarFrontCenter,DASy
 SG_ VFC_Obj18A_NormAxStdDev : 328|10@1+ (0.0025,0) [0|2.5575] "1/s^2"  RadarFrontCenter,DASy
 SG_ VFC_Obj18A_NormVyEdgeLeftStdDev : 248|8@1+ (0.001,0) [0|0.255] "1/s"  RadarFrontCenter,DASy
 SG_ VFC_Obj18A_NormVyEdgeRightStdDev : 320|8@1+ (0.001,0) [0|0.255] "1/s"  RadarFrontCenter,DASy
 SG_ VFC_Obj18A_ScaleChange : 338|14@1+ (0.0001,0.5) [0.5|2.1383] "unitless"  RadarFrontCenter,DASy
 SG_ VFC_Obj18A_ScaleChngStdDev : 352|10@1+ (0.0001,0) [0|0.1023] "unitless"  RadarFrontCenter,DASy
 SG_ VFC_Obj18A_HeadingAngle : 226|9@1+ (0.01,-1.57) [-1.57|1.57] "rad"  RadarFrontCenter,DASy
 SG_ VFC_Obj18A_HeadingAngleStdDev : 186|6@1+ (0.01,0) [0|0.5] "rad"  RadarFrontCenter,DASy
 SG_ VFC_Obj18A_HeadOrientation : 460|4@1+ (1,0) [0|15] ""  RadarFrontCenter,DASy
 SG_ VFC_Obj18A_CompletelyInImg : 121|1@1+ (1,0) [0|1] ""  RadarFrontCenter,DASy
 SG_ VFC_Obj18A_ProbMovingLat : 154|6@1+ (2,0) [0|100] "%"  RadarFrontCenter,DASy
 SG_ VFC_Obj18A_ProbMovingLong : 170|6@1+ (2,0) [0|100] "%"  RadarFrontCenter,DASy
 SG_ VFC_Obj18A_ProbExist : 122|6@1+ (2,0) [0|100] "%"  RadarFrontCenter,DASy
 SG_ VFC_Obj18A_MeasSource : 91|5@1+ (1,0) [0|31] ""  RadarFrontCenter,DASy
 SG_ VFC_Obj18A_Reliability : 362|6@1+ (1,0) [0|63] ""  RadarFrontCenter,DASy
 SG_ VFC_Obj18A_Measured : 78|2@1+ (1,0) [0|3] ""  RadarFrontCenter,DASy
 SG_ VFC_Obj18A_VisibleView : 437|3@1+ (1,0) [0|4] ""  RadarFrontCenter,DASy
 SG_ VFC_Obj18A_ClassifiedView : 496|3@1+ (1,0) [0|4] ""  RadarFrontCenter,DASy
 SG_ VFC_Obj18A_DirIndicator : 106|3@1+ (1,0) [0|4] ""  RadarFrontCenter,DASy
 SG_ VFC_Obj18A_BrakeLight : 109|3@1+ (1,0) [0|7] ""  RadarFrontCenter,DASy

BO_ 214 VFC_Object19A: 64 MPC3
 SG_ VFC_Obj19A_CRC : 0|16@1+ (1,0) [0|65535] ""  RadarFrontCenter,DASy
 SG_ VFC_Obj19A_AliveCtr : 16|8@1+ (1,0) [0|255] ""  RadarFrontCenter,DASy
 SG_ VFC_Obj19A_ProtBlockCtr : 24|4@1+ (1,0) [0|15] ""  RadarFrontCenter,DASy
 SG_ VFC_Obj19A_ID : 32|8@1+ (1,0) [1|255] ""  RadarFrontCenter,DASy
 SG_ VFC_Obj19A_Type : 60|4@1+ (1,0) [0|15] ""  RadarFrontCenter,DASy
 SG_ VFC_Obj19A_TypeProb : 378|6@1+ (2,0) [0|100] "%"  RadarFrontCenter,DASy
 SG_ VFC_Obj19A_Dx : 48|12@1+ (0.05,0) [0|204.75] "m"  RadarFrontCenter,DASy
 SG_ VFC_Obj19A_Dy : 64|14@1+ (0.01,-80) [-80|80] "m"  RadarFrontCenter,DASy
 SG_ VFC_Obj19A_Vx : 80|11@1+ (0.1,-154) [-154|50] "m/s"  RadarFrontCenter,DASy
 SG_ VFC_Obj19A_Vy : 96|10@1+ (0.1,-50) [-50|50] "m/s"  RadarFrontCenter,DASy
 SG_ VFC_Obj19A_Ax : 112|9@1+ (0.1,-16) [-16|16] "m/s^2"  RadarFrontCenter,DASy
 SG_ VFC_Obj19A_Ay : 128|8@1+ (0.1,-12) [-12|12] "m/s^2"  RadarFrontCenter,DASy
 SG_ VFC_Obj19A_DxStdDev : 144|10@1+ (0.05,0) [0|51.15] "m"  RadarFrontCenter,DASy
 SG_ VFC_Obj19A_DyStdDev : 160|10@1+ (0.02,0) [0|20.46] "m"  RadarFrontCenter,DASy
 SG_ VFC_Obj19A_VxStdDev : 176|10@1+ (0.1,0) [0|102.3] "m/s"  RadarFrontCenter,DASy
 SG_ VFC_Obj19A_VyStdDev : 192|9@1+ (0.1,0) [0|51.1] "m/s"  RadarFrontCenter,DASy
 SG_ VFC_Obj19A_AxStdDev : 40|8@1+ (0.1,0) [0|25.5] "m/s^2"  RadarFrontCenter,DASy
 SG_ VFC_Obj19A_AyStdDev : 136|8@1+ (0.1,0) [0|25.5] "m/s^2"  RadarFrontCenter,DASy
 SG_ VFC_Obj19A_Length : 217|9@1+ (0.05,0) [0|25.55] "m"  RadarFrontCenter,DASy
 SG_ VFC_Obj19A_Width : 294|10@1+ (0.01,0) [0|10.23] "m"  RadarFrontCenter,DASy
 SG_ VFC_Obj19A_Height : 208|9@1+ (0.01,0) [0|5.11] "m"  RadarFrontCenter,DASy
 SG_ VFC_Obj19A_LengthStdDev : 384|7@1+ (0.05,0) [0|5] "m"  RadarFrontCenter,DASy
 SG_ VFC_Obj19A_WidthStdDev : 391|7@1+ (0.01,0) [0|1] "m"  RadarFrontCenter,DASy
 SG_ VFC_Obj19A_HeightStdDev : 201|7@1+ (0.01,0) [0|1] "m"  RadarFrontCenter,DASy
 SG_ VFC_Obj19A_EdgeLeft : 411|13@1+ (0.00025,-1) [-1|1] "unitless"  RadarFrontCenter,DASy
 SG_ VFC_Obj19A_EdgeMid : 398|13@1+ (0.00025,-1) [-1|1] "unitless"  RadarFrontCenter,DASy
 SG_ VFC_Obj19A_EdgeRight : 424|13@1+ (0.00025,-1) [-1|1] "unitless"  RadarFrontCenter,DASy
 SG_ VFC_Obj19A_EdgeTop : 448|12@1+ (0.00025,-0.5) [-0.5|0.5] "unitless"  RadarFrontCenter,DASy
 SG_ VFC_Obj19A_EdgeBottom : 269|12@1+ (0.00025,-0.5) [-0.5|0.5] "unitless"  RadarFrontCenter,DASy
 SG_ VFC_Obj19A_EdgeLeftStdDev : 440|8@1+ (0.0002,0) [0|0.051] "unitless"  RadarFrontCenter,DASy
 SG_ VFC_Obj19A_EdgeMidStdDev : 464|8@1+ (0.0002,0) [0|0.051] "unitless"  RadarFrontCenter,DASy
 SG_ VFC_Obj19A_EdgeRightStdDev : 472|8@1+ (0.0002,0) [0|0.051] "unitless"  RadarFrontCenter,DASy
 SG_ VFC_Obj19A_EdgeTopStdDev : 480|8@1+ (0.0002,0) [0|0.051] "unitless"  RadarFrontCenter,DASy
 SG_ VFC_Obj19A_EdgeBottomStdDev : 488|8@1+ (0.0002,0) [0|0.051] "unitless"  RadarFrontCenter,DASy
 SG_ VFC_Obj19A_NormVx : 304|16@1+ (0.001,-40) [-40|25] "1/s"  RadarFrontCenter,DASy
 SG_ VFC_Obj19A_NormAx : 235|13@1+ (0.002,-10) [-10|6] "1/s^2"  RadarFrontCenter,DASy
 SG_ VFC_Obj19A_NormVyEdgeLeft : 256|13@1+ (0.001,-4) [-4|4] "1/s"  RadarFrontCenter,DASy
 SG_ VFC_Obj19A_NormVyEdgeRight : 281|13@1+ (0.001,-4) [-4|4] "1/s"  RadarFrontCenter,DASy
 SG_ VFC_Obj19A_NormVxStdDev : 368|10@1+ (0.001,0) [0|1.023] "1/s"  RadarFrontCenter,DASy
 SG_ VFC_Obj19A_NormAxStdDev : 328|10@1+ (0.0025,0) [0|2.5575] "1/s^2"  RadarFrontCenter,DASy
 SG_ VFC_Obj19A_NormVyEdgeLeftStdDev : 248|8@1+ (0.001,0) [0|0.255] "1/s"  RadarFrontCenter,DASy
 SG_ VFC_Obj19A_NormVyEdgeRightStdDev : 320|8@1+ (0.001,0) [0|0.255] "1/s"  RadarFrontCenter,DASy
 SG_ VFC_Obj19A_ScaleChange : 338|14@1+ (0.0001,0.5) [0.5|2.1383] "unitless"  RadarFrontCenter,DASy
 SG_ VFC_Obj19A_ScaleChngStdDev : 352|10@1+ (0.0001,0) [0|0.1023] "unitless"  RadarFrontCenter,DASy
 SG_ VFC_Obj19A_HeadingAngle : 226|9@1+ (0.01,-1.57) [-1.57|1.57] "rad"  RadarFrontCenter,DASy
 SG_ VFC_Obj19A_HeadingAngleStdDev : 186|6@1+ (0.01,0) [0|0.5] "rad"  RadarFrontCenter,DASy
 SG_ VFC_Obj19A_HeadOrientation : 460|4@1+ (1,0) [0|15] ""  RadarFrontCenter,DASy
 SG_ VFC_Obj19A_CompletelyInImg : 121|1@1+ (1,0) [0|1] ""  RadarFrontCenter,DASy
 SG_ VFC_Obj19A_ProbMovingLat : 154|6@1+ (2,0) [0|100] "%"  RadarFrontCenter,DASy
 SG_ VFC_Obj19A_ProbMovingLong : 170|6@1+ (2,0) [0|100] "%"  RadarFrontCenter,DASy
 SG_ VFC_Obj19A_ProbExist : 122|6@1+ (2,0) [0|100] "%"  RadarFrontCenter,DASy
 SG_ VFC_Obj19A_MeasSource : 91|5@1+ (1,0) [0|31] ""  RadarFrontCenter,DASy
 SG_ VFC_Obj19A_Reliability : 362|6@1+ (1,0) [0|63] ""  RadarFrontCenter,DASy
 SG_ VFC_Obj19A_Measured : 78|2@1+ (1,0) [0|3] ""  RadarFrontCenter,DASy
 SG_ VFC_Obj19A_VisibleView : 437|3@1+ (1,0) [0|4] ""  RadarFrontCenter,DASy
 SG_ VFC_Obj19A_ClassifiedView : 496|3@1+ (1,0) [0|4] ""  RadarFrontCenter,DASy
 SG_ VFC_Obj19A_DirIndicator : 106|3@1+ (1,0) [0|4] ""  RadarFrontCenter,DASy
 SG_ VFC_Obj19A_BrakeLight : 109|3@1+ (1,0) [0|7] ""  RadarFrontCenter,DASy

BO_ 128 VFC_LaneHdr: 20 MPC3
 SG_ VFC_LaneHdr_CRC : 0|16@1+ (1,0) [0|65535] ""  RadarFrontCenter,DASy
 SG_ VFC_LaneHdr_AliveCtr : 16|8@1+ (1,0) [0|255] ""  RadarFrontCenter,DASy
 SG_ VFC_LaneHdr_ProtBlockCtr : 24|4@1+ (1,0) [0|15] ""  RadarFrontCenter,DASy
 SG_ VFC_LaneHdr_ProtSegCount : 32|8@1+ (1,0) [0|240] ""  RadarFrontCenter,DASy
 SG_ VFC_LaneHdr_ProtPointCount : 40|10@1+ (1,0) [0|1000] ""  RadarFrontCenter,DASy
 SG_ VFC_LaneHdr_ProtClothCount : 50|4@1+ (1,0) [0|8] ""  RadarFrontCenter,DASy
 SG_ VFC_LaneHdr_TimeStamp : 64|26@1+ (1,0) [0|67108863] "ms"  RadarFrontCenter,DASy
 SG_ VFC_LaneHdr_State : 93|3@1+ (1,0) [0|7] ""  RadarFrontCenter,DASy
 SG_ VFC_LaneHdr_TimeLatency : 96|16@1+ (1,0) [0|65535] ""  RadarFrontCenter,DASy
 SG_ VFC_LaneHdr_ImgFrameCounter : 112|32@1+ (1,0) [0|4294967295] ""  RadarFrontCenter

BO_ 129 VFC_LaneClothoid00: 20 MPC3
 SG_ VFC_Cloth00_CRC : 0|16@1+ (1,0) [0|65535] ""  RadarFrontCenter,DASy
 SG_ VFC_Cloth00_AliveCtr : 16|8@1+ (1,0) [0|255] ""  RadarFrontCenter,DASy
 SG_ VFC_Cloth00_ProtBlockCtr : 24|4@1+ (1,0) [0|15] ""  RadarFrontCenter,DASy
 SG_ VFC_Cloth00_Conf : 40|6@1+ (2,0) [0|100] "%"  RadarFrontCenter,DASy
 SG_ VFC_Cloth00_DxEnd : 31|9@1+ (0.5,0) [0|255.5] "m"  RadarFrontCenter,DASy
 SG_ VFC_Cloth00_Dy : 76|12@1+ (0.0078125,-16) [-16|15.9921875] "m"  RadarFrontCenter,DASy
 SG_ VFC_Cloth00_DyStdDev : 128|9@1+ (0.0078125,0) [0|3.9921875] "m"  RadarFrontCenter,DASy
 SG_ VFC_Cloth00_Curv : 96|12@1+ (3.0517578125E-005,-0.0625) [-0.0625|0.062469482421875] "1/m"  RadarFrontCenter,DASy
 SG_ VFC_Cloth00_CurvChange : 108|12@1+ (7.62939453125E-006,-0.015625) [-0.015625|0.0156173706054688] "1/m^2"  RadarFrontCenter,DASy
 SG_ VFC_Cloth00_CourseDeviation : 46|10@1+ (0.05,0) [0|51.15] ""  RadarFrontCenter,DASy
 SG_ VFC_Cloth00_HeadingAngle : 64|12@1+ (0.00048828125,-1) [-1|0.99951171875] "rad"  RadarFrontCenter,DASy
 SG_ VFC_Cloth00_LineWidth : 56|8@1+ (0.01,0) [0|2.55] "m"  RadarFrontCenter,DASy
 SG_ VFC_Cloth00_Type : 120|5@1+ (1,0) [0|19] ""  RadarFrontCenter,DASy
 SG_ VFC_Cloth00_TypeProb : 88|6@1+ (2,0) [0|100] "%"  RadarFrontCenter,DASy
 SG_ VFC_Cloth00_MeasureType : 94|2@1+ (1,0) [0|3] ""  RadarFrontCenter,DASy
 SG_ VFC_Cloth00_ColorClass : 137|3@1+ (1,0) [0|7] ""  RadarFrontCenter,DASy
 SG_ VFC_Cloth00_LineID : 144|8@1+ (1,0) [0|255] ""  RadarFrontCenter,DASy

BO_ 130 VFC_LaneClothoid01: 20 MPC3
 SG_ VFC_Cloth01_CRC : 0|16@1+ (1,0) [0|65535] ""  RadarFrontCenter,DASy
 SG_ VFC_Cloth01_AliveCtr : 16|8@1+ (1,0) [0|255] ""  RadarFrontCenter,DASy
 SG_ VFC_Cloth01_ProtBlockCtr : 24|4@1+ (1,0) [0|15] ""  RadarFrontCenter,DASy
 SG_ VFC_Cloth01_Conf : 40|6@1+ (2,0) [0|100] "%"  RadarFrontCenter,DASy
 SG_ VFC_Cloth01_DxEnd : 31|9@1+ (0.5,0) [0|255.5] "m"  RadarFrontCenter,DASy
 SG_ VFC_Cloth01_Dy : 76|12@1+ (0.0078125,-16) [-16|15.9921875] "m"  RadarFrontCenter,DASy
 SG_ VFC_Cloth01_DyStdDev : 128|9@1+ (0.0078125,0) [0|3.9921875] "m"  RadarFrontCenter,DASy
 SG_ VFC_Cloth01_Curv : 96|12@1+ (3.0517578125E-005,-0.0625) [-0.0625|0.062469482421875] "1/m"  RadarFrontCenter,DASy
 SG_ VFC_Cloth01_CurvChange : 108|12@1+ (7.62939453125E-006,-0.015625) [-0.015625|0.0156173706054688] "1/m^2"  RadarFrontCenter,DASy
 SG_ VFC_Cloth01_CourseDeviation : 46|10@1+ (0.05,0) [0|51.15] ""  RadarFrontCenter,DASy
 SG_ VFC_Cloth01_HeadingAngle : 64|12@1+ (0.00048828125,-1) [-1|0.99951171875] "rad"  RadarFrontCenter,DASy
 SG_ VFC_Cloth01_LineWidth : 56|8@1+ (0.01,0) [0|2.55] "m"  RadarFrontCenter,DASy
 SG_ VFC_Cloth01_Type : 120|5@1+ (1,0) [0|19] ""  RadarFrontCenter,DASy
 SG_ VFC_Cloth01_TypeProb : 88|6@1+ (2,0) [0|100] "%"  RadarFrontCenter,DASy
 SG_ VFC_Cloth01_MeasureType : 94|2@1+ (1,0) [0|3] ""  RadarFrontCenter,DASy
 SG_ VFC_Cloth01_ColorClass : 137|3@1+ (1,0) [0|7] ""  RadarFrontCenter,DASy
 SG_ VFC_Cloth01_LineID : 144|8@1+ (1,0) [0|255] ""  RadarFrontCenter,DASy

BO_ 131 VFC_LaneClothoid02: 20 MPC3
 SG_ VFC_Cloth02_CRC : 0|16@1+ (1,0) [0|65535] ""  RadarFrontCenter,DASy
 SG_ VFC_Cloth02_AliveCtr : 16|8@1+ (1,0) [0|255] ""  RadarFrontCenter,DASy
 SG_ VFC_Cloth02_ProtBlockCtr : 24|4@1+ (1,0) [0|15] ""  RadarFrontCenter,DASy
 SG_ VFC_Cloth02_Conf : 40|6@1+ (2,0) [0|100] "%"  RadarFrontCenter,DASy
 SG_ VFC_Cloth02_DxEnd : 31|9@1+ (0.5,0) [0|255.5] "m"  RadarFrontCenter,DASy
 SG_ VFC_Cloth02_Dy : 76|12@1+ (0.0078125,-16) [-16|15.9921875] "m"  RadarFrontCenter,DASy
 SG_ VFC_Cloth02_DyStdDev : 128|9@1+ (0.0078125,0) [0|3.9921875] "m"  RadarFrontCenter,DASy
 SG_ VFC_Cloth02_Curv : 96|12@1+ (3.0517578125E-005,-0.0625) [-0.0625|0.062469482421875] "1/m"  RadarFrontCenter,DASy
 SG_ VFC_Cloth02_CurvChange : 108|12@1+ (7.62939453125E-006,-0.015625) [-0.015625|0.0156173706054688] "1/m^2"  RadarFrontCenter,DASy
 SG_ VFC_Cloth02_CourseDeviation : 46|10@1+ (0.05,0) [0|51.15] ""  RadarFrontCenter,DASy
 SG_ VFC_Cloth02_HeadingAngle : 64|12@1+ (0.00048828125,-1) [-1|0.99951171875] "rad"  RadarFrontCenter,DASy
 SG_ VFC_Cloth02_LineWidth : 56|8@1+ (0.01,0) [0|2.55] "m"  RadarFrontCenter,DASy
 SG_ VFC_Cloth02_Type : 120|5@1+ (1,0) [0|19] ""  RadarFrontCenter,DASy
 SG_ VFC_Cloth02_TypeProb : 88|6@1+ (2,0) [0|100] "%"  RadarFrontCenter,DASy
 SG_ VFC_Cloth02_MeasureType : 94|2@1+ (1,0) [0|3] ""  RadarFrontCenter,DASy
 SG_ VFC_Cloth02_ColorClass : 137|3@1+ (1,0) [0|7] ""  RadarFrontCenter,DASy
 SG_ VFC_Cloth02_LineID : 144|8@1+ (1,0) [0|255] ""  RadarFrontCenter,DASy

BO_ 132 VFC_LaneClothoid03: 20 MPC3
 SG_ VFC_Cloth03_CRC : 0|16@1+ (1,0) [0|65535] ""  RadarFrontCenter,DASy
 SG_ VFC_Cloth03_AliveCtr : 16|8@1+ (1,0) [0|255] ""  RadarFrontCenter,DASy
 SG_ VFC_Cloth03_ProtBlockCtr : 24|4@1+ (1,0) [0|15] ""  RadarFrontCenter,DASy
 SG_ VFC_Cloth03_Conf : 40|6@1+ (2,0) [0|100] "%"  RadarFrontCenter,DASy
 SG_ VFC_Cloth03_DxEnd : 31|9@1+ (0.5,0) [0|255.5] "m"  RadarFrontCenter,DASy
 SG_ VFC_Cloth03_Dy : 76|12@1+ (0.0078125,-16) [-16|15.9921875] "m"  RadarFrontCenter,DASy
 SG_ VFC_Cloth03_DyStdDev : 128|9@1+ (0.0078125,0) [0|3.9921875] "m"  RadarFrontCenter,DASy
 SG_ VFC_Cloth03_Curv : 96|12@1+ (3.0517578125E-005,-0.0625) [-0.0625|0.062469482421875] "1/m"  RadarFrontCenter,DASy
 SG_ VFC_Cloth03_CurvChange : 108|12@1+ (7.62939453125E-006,-0.015625) [-0.015625|0.0156173706054688] "1/m^2"  RadarFrontCenter,DASy
 SG_ VFC_Cloth03_CourseDeviation : 46|10@1+ (0.05,0) [0|51.15] ""  RadarFrontCenter,DASy
 SG_ VFC_Cloth03_HeadingAngle : 64|12@1+ (0.00048828125,-1) [-1|0.99951171875] "rad"  RadarFrontCenter,DASy
 SG_ VFC_Cloth03_LineWidth : 56|8@1+ (0.01,0) [0|2.55] "m"  RadarFrontCenter,DASy
 SG_ VFC_Cloth03_Type : 120|5@1+ (1,0) [0|19] ""  RadarFrontCenter,DASy
 SG_ VFC_Cloth03_TypeProb : 88|6@1+ (2,0) [0|100] "%"  RadarFrontCenter,DASy
 SG_ VFC_Cloth03_MeasureType : 94|2@1+ (1,0) [0|3] ""  RadarFrontCenter,DASy
 SG_ VFC_Cloth03_ColorClass : 137|3@1+ (1,0) [0|7] ""  RadarFrontCenter,DASy
 SG_ VFC_Cloth03_LineID : 144|8@1+ (1,0) [0|255] ""  RadarFrontCenter,DASy

BO_ 133 VFC_LaneClothoid04: 20 MPC3
 SG_ VFC_Cloth04_CRC : 0|16@1+ (1,0) [0|65535] ""  RadarFrontCenter,DASy
 SG_ VFC_Cloth04_AliveCtr : 16|8@1+ (1,0) [0|255] ""  RadarFrontCenter,DASy
 SG_ VFC_Cloth04_ProtBlockCtr : 24|4@1+ (1,0) [0|15] ""  RadarFrontCenter,DASy
 SG_ VFC_Cloth04_Conf : 40|6@1+ (2,0) [0|100] "%"  RadarFrontCenter,DASy
 SG_ VFC_Cloth04_DxEnd : 31|9@1+ (0.5,0) [0|255.5] "m"  RadarFrontCenter,DASy
 SG_ VFC_Cloth04_Dy : 76|12@1+ (0.0078125,-16) [-16|15.9921875] "m"  RadarFrontCenter,DASy
 SG_ VFC_Cloth04_DyStdDev : 128|9@1+ (0.0078125,0) [0|3.9921875] "m"  RadarFrontCenter,DASy
 SG_ VFC_Cloth04_Curv : 96|12@1+ (3.0517578125E-005,-0.0625) [-0.0625|0.062469482421875] "1/m"  RadarFrontCenter,DASy
 SG_ VFC_Cloth04_CurvChange : 108|12@1+ (7.62939453125E-006,-0.015625) [-0.015625|0.0156173706054688] "1/m^2"  RadarFrontCenter,DASy
 SG_ VFC_Cloth04_CourseDeviation : 46|10@1+ (0.05,0) [0|51.15] ""  RadarFrontCenter,DASy
 SG_ VFC_Cloth04_HeadingAngle : 64|12@1+ (0.00048828125,-1) [-1|0.99951171875] "rad"  RadarFrontCenter,DASy
 SG_ VFC_Cloth04_LineWidth : 56|8@1+ (0.01,0) [0|2.55] "m"  RadarFrontCenter,DASy
 SG_ VFC_Cloth04_Type : 120|5@1+ (1,0) [0|19] ""  RadarFrontCenter,DASy
 SG_ VFC_Cloth04_TypeProb : 88|6@1+ (2,0) [0|100] "%"  RadarFrontCenter,DASy
 SG_ VFC_Cloth04_MeasureType : 94|2@1+ (1,0) [0|3] ""  RadarFrontCenter,DASy
 SG_ VFC_Cloth04_ColorClass : 137|3@1+ (1,0) [0|7] ""  RadarFrontCenter,DASy
 SG_ VFC_Cloth04_LineID : 144|8@1+ (1,0) [0|255] ""  RadarFrontCenter,DASy

BO_ 134 VFC_LaneClothoid05: 20 MPC3
 SG_ VFC_Cloth05_CRC : 0|16@1+ (1,0) [0|65535] ""  RadarFrontCenter,DASy
 SG_ VFC_Cloth05_AliveCtr : 16|8@1+ (1,0) [0|255] ""  RadarFrontCenter,DASy
 SG_ VFC_Cloth05_ProtBlockCtr : 24|4@1+ (1,0) [0|15] ""  RadarFrontCenter,DASy
 SG_ VFC_Cloth05_Conf : 40|6@1+ (2,0) [0|100] "%"  RadarFrontCenter,DASy
 SG_ VFC_Cloth05_DxEnd : 31|9@1+ (0.5,0) [0|255.5] "m"  RadarFrontCenter,DASy
 SG_ VFC_Cloth05_Dy : 76|12@1+ (0.0078125,-16) [-16|15.9921875] "m"  RadarFrontCenter,DASy
 SG_ VFC_Cloth05_DyStdDev : 128|9@1+ (0.0078125,0) [0|3.9921875] "m"  RadarFrontCenter,DASy
 SG_ VFC_Cloth05_Curv : 96|12@1+ (3.0517578125E-005,-0.0625) [-0.0625|0.062469482421875] "1/m"  RadarFrontCenter,DASy
 SG_ VFC_Cloth05_CurvChange : 108|12@1+ (7.62939453125E-006,-0.015625) [-0.015625|0.0156173706054688] "1/m^2"  RadarFrontCenter,DASy
 SG_ VFC_Cloth05_CourseDeviation : 46|10@1+ (0.05,0) [0|51.15] ""  RadarFrontCenter,DASy
 SG_ VFC_Cloth05_HeadingAngle : 64|12@1+ (0.00048828125,-1) [-1|0.99951171875] "rad"  RadarFrontCenter,DASy
 SG_ VFC_Cloth05_LineWidth : 56|8@1+ (0.01,0) [0|2.55] "m"  RadarFrontCenter,DASy
 SG_ VFC_Cloth05_Type : 120|5@1+ (1,0) [0|19] ""  RadarFrontCenter,DASy
 SG_ VFC_Cloth05_TypeProb : 88|6@1+ (2,0) [0|100] "%"  RadarFrontCenter,DASy
 SG_ VFC_Cloth05_MeasureType : 94|2@1+ (1,0) [0|3] ""  RadarFrontCenter,DASy
 SG_ VFC_Cloth05_ColorClass : 137|3@1+ (1,0) [0|7] ""  RadarFrontCenter,DASy
 SG_ VFC_Cloth05_LineID : 144|8@1+ (1,0) [0|255] ""  RadarFrontCenter,DASy

BO_ 135 VFC_LaneClothoid06: 20 MPC3
 SG_ VFC_Cloth06_CRC : 0|16@1+ (1,0) [0|65535] ""  RadarFrontCenter,DASy
 SG_ VFC_Cloth06_AliveCtr : 16|8@1+ (1,0) [0|255] ""  RadarFrontCenter,DASy
 SG_ VFC_Cloth06_ProtBlockCtr : 24|4@1+ (1,0) [0|15] ""  RadarFrontCenter,DASy
 SG_ VFC_Cloth06_Conf : 40|6@1+ (2,0) [0|100] "%"  RadarFrontCenter,DASy
 SG_ VFC_Cloth06_DxEnd : 31|9@1+ (0.5,0) [0|255.5] "m"  RadarFrontCenter,DASy
 SG_ VFC_Cloth06_Dy : 76|12@1+ (0.0078125,-16) [-16|15.9921875] "m"  RadarFrontCenter,DASy
 SG_ VFC_Cloth06_DyStdDev : 128|9@1+ (0.0078125,0) [0|3.9921875] "m"  RadarFrontCenter,DASy
 SG_ VFC_Cloth06_Curv : 96|12@1+ (3.0517578125E-005,-0.0625) [-0.0625|0.062469482421875] "1/m"  RadarFrontCenter,DASy
 SG_ VFC_Cloth06_CurvChange : 108|12@1+ (7.62939453125E-006,-0.015625) [-0.015625|0.0156173706054688] "1/m^2"  RadarFrontCenter,DASy
 SG_ VFC_Cloth06_CourseDeviation : 46|10@1+ (0.05,0) [0|51.15] ""  RadarFrontCenter,DASy
 SG_ VFC_Cloth06_HeadingAngle : 64|12@1+ (0.00048828125,-1) [-1|0.99951171875] "rad"  RadarFrontCenter,DASy
 SG_ VFC_Cloth06_LineWidth : 56|8@1+ (0.01,0) [0|2.55] "m"  RadarFrontCenter,DASy
 SG_ VFC_Cloth06_Type : 120|5@1+ (1,0) [0|19] ""  RadarFrontCenter,DASy
 SG_ VFC_Cloth06_TypeProb : 88|6@1+ (2,0) [0|100] "%"  RadarFrontCenter,DASy
 SG_ VFC_Cloth06_MeasureType : 94|2@1+ (1,0) [0|3] ""  RadarFrontCenter,DASy
 SG_ VFC_Cloth06_ColorClass : 137|3@1+ (1,0) [0|7] ""  RadarFrontCenter,DASy
 SG_ VFC_Cloth06_LineID : 144|8@1+ (1,0) [0|255] ""  RadarFrontCenter,DASy

BO_ 136 VFC_LaneClothoid07: 20 MPC3
 SG_ VFC_Cloth07_CRC : 0|16@1+ (1,0) [0|65535] ""  RadarFrontCenter,DASy
 SG_ VFC_Cloth07_AliveCtr : 16|8@1+ (1,0) [0|255] ""  RadarFrontCenter,DASy
 SG_ VFC_Cloth07_ProtBlockCtr : 24|4@1+ (1,0) [0|15] ""  RadarFrontCenter,DASy
 SG_ VFC_Cloth07_Conf : 40|6@1+ (2,0) [0|100] "%"  RadarFrontCenter,DASy
 SG_ VFC_Cloth07_DxEnd : 31|9@1+ (0.5,0) [0|255.5] "m"  RadarFrontCenter,DASy
 SG_ VFC_Cloth07_Dy : 76|12@1+ (0.0078125,-16) [-16|15.9921875] "m"  RadarFrontCenter,DASy
 SG_ VFC_Cloth07_DyStdDev : 128|9@1+ (0.0078125,0) [0|3.9921875] "m"  RadarFrontCenter,DASy
 SG_ VFC_Cloth07_Curv : 96|12@1+ (3.0517578125E-005,-0.0625) [-0.0625|0.062469482421875] "1/m"  RadarFrontCenter,DASy
 SG_ VFC_Cloth07_CurvChange : 108|12@1+ (7.62939453125E-006,-0.015625) [-0.015625|0.0156173706054688] "1/m^2"  RadarFrontCenter,DASy
 SG_ VFC_Cloth07_CourseDeviation : 46|10@1+ (0.05,0) [0|51.15] ""  RadarFrontCenter,DASy
 SG_ VFC_Cloth07_HeadingAngle : 64|12@1+ (0.00048828125,-1) [-1|0.99951171875] "rad"  RadarFrontCenter,DASy
 SG_ VFC_Cloth07_LineWidth : 56|8@1+ (0.01,0) [0|2.55] "m"  RadarFrontCenter,DASy
 SG_ VFC_Cloth07_Type : 120|5@1+ (1,0) [0|19] ""  RadarFrontCenter,DASy
 SG_ VFC_Cloth07_TypeProb : 88|6@1+ (2,0) [0|100] "%"  RadarFrontCenter,DASy
 SG_ VFC_Cloth07_MeasureType : 94|2@1+ (1,0) [0|3] ""  RadarFrontCenter,DASy
 SG_ VFC_Cloth07_ColorClass : 137|3@1+ (1,0) [0|7] ""  RadarFrontCenter,DASy
 SG_ VFC_Cloth07_LineID : 144|8@1+ (1,0) [0|255] ""  RadarFrontCenter,DASy

BO_ 272 RFC_DOPTraj: 32 RadarFrontCenter
 SG_ RFC_DOPTraj_CRC : 0|16@1+ (1,0) [0|65535] ""  MPC3
 SG_ RFC_DOPTraj_AliveCtr : 16|8@1+ (1,0) [0|255] ""  MPC3
 SG_ RFC_DOPTraj_BlockCtr : 24|4@1+ (1,0) [0|15] ""  MPC3
 SG_ RFC_DOPTrajValid : 40|1@1+ (1,0) [0|1] ""  MPC3
 SG_ RFC_DOPTraj_Dy : 28|12@1+ (0.015625,-32) [-32|31.984375] "m"  MPC3
 SG_ RFC_DOPTraj_HeadingAngle : 41|13@1+ (0.000488281,-1.6) [-1.6|1.6] "rad"  MPC3
 SG_ RFC_DOPTraj_Curvature : 64|13@1+ (3.8147E-006,-0.015625) [-0.015625|0.0156212077] "1/m"  MPC3
 SG_ RFC_DOPTraj_CurvChange : 80|12@1+ (3.8147E-006,-0.0078125) [-0.0078125|0.0078086965] "1/(m*m)"  MPC3
 SG_ RFC_DOPTraj_DxEnd : 54|10@1+ (0.25,0) [0|255.75] "m"  MPC3
 SG_ RFC_DOPTraj_DxStart : 96|13@1+ (0.025,0) [0|204.775] "m"  MPC3
 SG_ RFC_DOPObjInfo_dxv_sw : 112|16@1- (0.0078125,0) [-256|255.9921875] "m"  MPC3
 SG_ RFC_DOPObjInfo_dyv_sw : 128|12@1- (0.0078125,0) [-16|15.9921875] "m"  MPC3
 SG_ RFC_DOPObjInfo_Handle_ub : 144|8@1+ (1,0) [0|255] ""  MPC3
 SG_ RFC_DOPObjInfo_vxv_sw : 152|16@1- (0.00390625,0) [-128|127.99609375] "m/s"  MPC3
 SG_ RFC_DOPObjInfo_timestamp : 168|32@1+ (1.52588E-005,0) [0|65535.9999847412] "ms"  MPC3

BO_ 937 VFC_LatControl_Info: 32 MPC3
 SG_ VFC_CtrlStopPunishFlag : 245|1@1+ (1,0) [0|1] ""  RadarFrontCenter
 SG_ VFC_CtrlStopActiveFlag : 244|1@1+ (1,0) [0|1] ""  RadarFrontCenter
 SG_ VFC_kFfwDy : 232|12@1+ (0.01,-20.48) [-20.48|20.47] "" Vector__XXX
 SG_ VFC_kFfwChangeCurvature : 220|12@1+ (0.01,-20.48) [-20.48|20.47] "" Vector__XXX
 SG_ VFC_headingAngleDiffRate : 206|14@1+ (0.01,-81.92) [-81.92|81.91] "" Vector__XXX
 SG_ VFC_latOffsetDesTraj : 197|9@1+ (0.01,-2.56) [-2.56|2.55] "" Vector__XXX
 SG_ VFC_dYVehCenterDesTrj : 187|10@1+ (0.01,-5.12) [-5.12|5.11] "" Vector__XXX
 SG_ VFC_headingAngleDiff : 173|14@1+ (0.01,-81.92) [-81.92|81.91] "" Vector__XXX
 SG_ VFC_KtiN_near : 161|12@1+ (0.01,-20.48) [-20.48|20.47] "" Vector__XXX
 SG_ VFC_Kd_near : 149|12@1+ (0.01,-20.48) [-20.48|20.47] "" Vector__XXX
 SG_ VFC_Ki_near : 137|12@1+ (0.01,-20.48) [-20.48|20.47] "" Vector__XXX
 SG_ VFC_Kp_near : 125|12@1+ (0.01,-20.48) [-20.48|20.47] "" Vector__XXX
 SG_ VFC_KtiN_far : 113|12@1+ (0.01,-20.48) [-20.48|20.47] "" Vector__XXX
 SG_ VFC_Kd_far : 101|12@1+ (0.01,-20.48) [-20.48|20.47] "" Vector__XXX
 SG_ VFC_Ki_far : 89|12@1+ (0.01,-20.48) [-20.48|20.47] "" Vector__XXX
 SG_ VFC_Kp_far : 77|12@1+ (0.01,-20.48) [-20.48|20.47] "" Vector__XXX
 SG_ VFC_radiusRoadPred : 63|14@1+ (1,0) [0|16383] "" Vector__XXX
 SG_ VFC_agStWhDesPidFfw : 49|14@1+ (0.01,-81.92) [-81.92|81.91] "" Vector__XXX
 SG_ VFC_agStWhDesPidNear : 35|14@1+ (0.01,-81.92) [-81.92|81.91] "" Vector__XXX
 SG_ VFC_agStWhDesPidFar : 21|14@1+ (0.01,-81.92) [-81.92|81.91] "" Vector__XXX
 SG_ VFC_steeringWheelAngleOffset : 10|11@1+ (0.01,-10.24) [-10.24|10.23] "" Vector__XXX
 SG_ VFC_factorCrossFadeBathTub : 0|10@1+ (0.01,0) [0|10.23] "" Vector__XXX

BO_ 936 VFC_AgBathTub: 12 MPC3
 SG_ VFC_agbathTubELKsl : 64|14@1+ (0.01,-81.92) [-81.92|81.91] "" Vector__XXX
 SG_ VFC_agbathTubELKre : 48|14@1+ (0.01,-81.92) [-81.92|81.91] "" Vector__XXX
 SG_ VFC_agbathTubELKot : 32|14@1+ (0.01,-81.92) [-81.92|81.91] "" Vector__XXX
 SG_ VFC_agbathTubELKoc : 16|14@1+ (0.01,-81.92) [-81.92|81.91] "" Vector__XXX
 SG_ VFC_agbathTubRdp : 0|14@1+ (0.01,-81.92) [-81.92|81.91] "" Vector__XXX

BO_ 935 VFC_DLCThd: 16 MPC3
 SG_ VFC_dlcIUpprELKsl : 110|9@1+ (0.01,-2.56) [-2.56|2.55] "" Vector__XXX
 SG_ VFC_dlcLowrELKsl : 100|9@1+ (0.01,-2.56) [-2.56|2.55] "" Vector__XXX
 SG_ VFC_dlcIUpprELKre : 90|9@1+ (0.01,-2.56) [-2.56|2.55] "" Vector__XXX
 SG_ VFC_dlcLowrELKre : 80|9@1+ (0.01,-2.56) [-2.56|2.55] "" Vector__XXX
 SG_ VFC_dlcIUpprELKot : 70|9@1+ (0.01,-2.56) [-2.56|2.55] "" Vector__XXX
 SG_ VFC_dlcLowrELKot : 60|9@1+ (0.01,-2.56) [-2.56|2.55] "" Vector__XXX
 SG_ VFC_dlcIUpprELKoc : 50|9@1+ (0.01,-2.56) [-2.56|2.55] "" Vector__XXX
 SG_ VFC_dlcLowrELKoc : 40|9@1+ (0.01,-2.56) [-2.56|2.55] "" Vector__XXX
 SG_ VFC_dlcIUpprRDP : 30|9@1+ (0.01,-2.56) [-2.56|2.55] "" Vector__XXX
 SG_ VFC_dlcLowrRDP : 20|9@1+ (0.01,-2.56) [-2.56|2.55] "" Vector__XXX
 SG_ VFC_dlcIUpprLDW : 10|9@1+ (0.01,-2.56) [-2.56|2.55] "" Vector__XXX
 SG_ VFC_dlcLowrLDW : 0|9@1+ (0.01,-2.56) [-2.56|2.55] "" Vector__XXX

BO_ 934 VFC_DLCInfo: 12 MPC3
 SG_ VFC_latOffsetIntEva : 80|9@1+ (0.01,-2.56) [-2.56|2.55] "" Vector__XXX
 SG_ VFC_ddlcRoadedge : 64|10@1+ (0.01,-5.12) [-5.12|5.11] "" Vector__XXX
 SG_ VFC_dlcRoadedge : 48|11@1+ (0.01,-10.24) [-10.24|10.23] "" Vector__XXX
 SG_ VFC_sideDlcFrtWhl : 90|2@1+ (1,0) [0|3] "" Vector__XXX
 SG_ VFC_dlc : 32|11@1+ (0.01,-10.24) [-10.24|10.23] "" Vector__XXX
 SG_ VFC_dlcFrtWhl : 16|11@1+ (0.01,-10.24) [-10.24|10.23] "" Vector__XXX
 SG_ VFC_latSpeed : 0|10@1+ (0.01,-5.12) [-5.12|5.11] "" Vector__XXX

BO_ 933 VFC_LaneInfo: 12 MPC3
 SG_ VFC_laneWidthComplex : 80|10@1+ (0.01,0) [0|0] "" Vector__XXX
 SG_ VFC_laneWidthVirtualOffset : 64|10@1+ (0.01,0) [0|10.23] "" Vector__XXX
 SG_ VFC_laneWidthReal : 48|10@1+ (0.01,0) [0|10.23] "" Vector__XXX
 SG_ VFC_overrideOffset : 32|10@1+ (0.01,-5.12) [-5.12|5.11] "" Vector__XXX
 SG_ VFC_elkIntvMode : 3|3@1+ (1,0) [0|7] "" Vector__XXX
 SG_ VFC_activeTiplSuppression : 24|7@1+ (1,0) [0|127] "" Vector__XXX
 SG_ VFC_activeDopSuppression : 16|7@1+ (1,0) [0|127] "" Vector__XXX
 SG_ VFC_activeVideoSuppression : 8|7@1+ (1,0) [0|127] "" Vector__XXX
 SG_ VFC_selectedLineSource : 0|2@1+ (1,0) [0|3] "" Vector__XXX

BO_ 932 VFC_LatFCTSuppSts: 16 MPC3
 SG_ ELKsl_SuppReasRi : 104|7@1+ (1,0) [0|127] "" Vector__XXX
 SG_ ELKsl_SuppReasLe : 96|7@1+ (1,0) [0|127] "" Vector__XXX
 SG_ ELKre_SuppReasRi : 88|7@1+ (1,0) [0|127] "" Vector__XXX
 SG_ ELKre_SuppReasLe : 80|7@1+ (1,0) [0|127] "" Vector__XXX
 SG_ ELKot_SuppReasRi : 72|7@1+ (1,0) [0|127] "" Vector__XXX
 SG_ ELKot_SuppReasLe : 64|7@1+ (1,0) [0|127] "" Vector__XXX
 SG_ ELKoc_SuppReasRi : 56|7@1+ (1,0) [0|127] "" Vector__XXX
 SG_ ELKoc_SuppReasLe : 48|7@1+ (1,0) [0|127] "" Vector__XXX
 SG_ LDW_SuppReasRi : 40|7@1+ (1,0) [0|127] "" Vector__XXX
 SG_ LDW_SuppReasLe : 32|7@1+ (1,0) [0|127] "" Vector__XXX
 SG_ RDP_SuppReasRi : 24|7@1+ (1,0) [0|127] "" Vector__XXX
 SG_ RDP_SuppReasLe : 16|7@1+ (1,0) [0|127] "" Vector__XXX
 SG_ TJAICA_SuppReasRi : 8|7@1+ (1,0) [0|127] "" Vector__XXX
 SG_ TJAICA_SuppReasLe : 0|7@1+ (1,0) [0|127] "" Vector__XXX

CM_ SG_ 200 VFC_Obj12A_CRC "CRC - Autosar E2E Profile 5";
CM_ SG_ 200 VFC_Obj12A_AliveCtr "Alive counter - Autosar E2E Profile 5";
CM_ SG_ 200 VFC_Obj12A_ProtBlockCtr "Protocol-Signal: Block-Counter";
CM_ SG_ 200 VFC_Obj12A_ID "Unique Object ID";
CM_ SG_ 200 VFC_Obj12A_Type "Classification of the object";
CM_ SG_ 200 VFC_Obj12A_TypeProb "Probability of the classified object type";
CM_ SG_ 200 VFC_Obj12A_Dx "Object distance in longitudinal direction";
CM_ SG_ 200 VFC_Obj12A_Dy "Object distance in lateral direction";
CM_ SG_ 200 VFC_Obj12A_Vx "Object velocity in longitudinal direction";
CM_ SG_ 200 VFC_Obj12A_Vy "Object velocity in lateral direction";
CM_ SG_ 200 VFC_Obj12A_Ax "Object acceleration in longitudinal direction";
CM_ SG_ 200 VFC_Obj12A_Ay "Object acceleration in lateral direction";
CM_ SG_ 200 VFC_Obj12A_DxStdDev "Standard deviation of Object distance in longitudinal direction";
CM_ SG_ 200 VFC_Obj12A_DyStdDev "Standard deviation of Object distance in lateral direction";
CM_ SG_ 200 VFC_Obj12A_VxStdDev "Standard deviation of Object velocity in longitudinal direction";
CM_ SG_ 200 VFC_Obj12A_VyStdDev "Standard deviation of Object velocity in lateral direction";
CM_ SG_ 200 VFC_Obj12A_AxStdDev "Standard deviation of Object acceleration in longitudinal direction";
CM_ SG_ 200 VFC_Obj12A_AyStdDev "Standard deviation of Object acceleration in lateral direction";
CM_ SG_ 200 VFC_Obj12A_Length "Length of the object";
CM_ SG_ 200 VFC_Obj12A_Width "Width of the object";
CM_ SG_ 200 VFC_Obj12A_Height "Height of the object";
CM_ SG_ 200 VFC_Obj12A_LengthStdDev "Standard deviation of object length";
CM_ SG_ 200 VFC_Obj12A_WidthStdDev "Standard deviation of object width";
CM_ SG_ 200 VFC_Obj12A_HeightStdDev "Standard deviation of object height";
CM_ SG_ 200 VFC_Obj12A_EdgeLeft "In ACCS coordinates; corresponds to tan(viewing angle of left object edge)";
CM_ SG_ 200 VFC_Obj12A_EdgeMid "In ACCS coordinates; corresponds to tan(viewing angle of middle object edge)";
CM_ SG_ 200 VFC_Obj12A_EdgeRight "In ACCS coordinates; corresponds to tan(viewing angle of right object edge)";
CM_ SG_ 200 VFC_Obj12A_EdgeTop "In ACCS coordinates; corresponds to tan(viewing angle of top object edge)";
CM_ SG_ 200 VFC_Obj12A_EdgeBottom "In ACCS coordinates; corresponds to tan(viewing angle of bottom object edge)";
CM_ SG_ 200 VFC_Obj12A_EdgeLeftStdDev "Standard deviation of the ACCS left object edge";
CM_ SG_ 200 VFC_Obj12A_EdgeMidStdDev "Standard deviation of the ACCS middle object edge";
CM_ SG_ 200 VFC_Obj12A_EdgeRightStdDev "Standard deviation of the ACCS right object edge";
CM_ SG_ 200 VFC_Obj12A_EdgeTopStdDev "Standard deviation of the ACCS top object edge";
CM_ SG_ 200 VFC_Obj12A_EdgeBottomStdDev "Standard deviation of the ACCS bottom object edge";
CM_ SG_ 200 VFC_Obj12A_NormVx "Normalised Object velocity in longitudinal direction";
CM_ SG_ 200 VFC_Obj12A_NormAx "Normalised Object acceleration in longitudinal direction";
CM_ SG_ 200 VFC_Obj12A_NormVyEdgeLeft "Normalised velocity of the ACCS left object edge in lateral direction";
CM_ SG_ 200 VFC_Obj12A_NormVyEdgeRight "Normalised velocity of the ACCS right object edge in lateral direction";
CM_ SG_ 200 VFC_Obj12A_NormVxStdDev "Standard deviation of Normalised Object velocity in longitudinal direction";
CM_ SG_ 200 VFC_Obj12A_NormAxStdDev "Standard deviation of Normalised Object acceleration in longitudinal direction";
CM_ SG_ 200 VFC_Obj12A_NormVyEdgeLeftStdDev "Standard deviation of Normalised velocity of the ACCS left object edge in lateral direction";
CM_ SG_ 200 VFC_Obj12A_NormVyEdgeRightStdDev "Standard deviation of Normalised velocity of the ACCS right object edge in lateral direction";
CM_ SG_ 200 VFC_Obj12A_ScaleChange "A scale change of of the detected object";
CM_ SG_ 200 VFC_Obj12A_ScaleChngStdDev "Standard deviation of object scale change";
CM_ SG_ 200 VFC_Obj12A_HeadingAngle "Heading angle of the object";
CM_ SG_ 200 VFC_Obj12A_HeadingAngleStdDev "Standard deviation of object Heading angle";
CM_ SG_ 200 VFC_Obj12A_HeadOrientation "The orientation of the head of cyclists or pedestrians that are detected";
CM_ SG_ 200 VFC_Obj12A_CompletelyInImg "indicator if the object is completely measured in the image";
CM_ SG_ 200 VFC_Obj12A_ProbMovingLat "Probability of object moving laterally";
CM_ SG_ 200 VFC_Obj12A_ProbMovingLong "Probability of object moving longitudinally";
CM_ SG_ 200 VFC_Obj12A_ProbExist "Object existence probability";
CM_ SG_ 200 VFC_Obj12A_MeasSource "Bitfield for the measurement programs from which this object originates
Bit 0: MOD
Bit 1: PDET
Bit 2: OFT
Bit 3: OLS
Bit 4: RESERVED";
CM_ SG_ 200 VFC_Obj12A_Reliability "The bitfield shows if the signal quality is assumed to be sufficient for functions with safety target -no false positives-
Bit 0: DYNAMIC
Bit 1: SEMSEG_SURFACE
Bit 2: WDD_CRITICAL
Bit 3: GOD_CONFIRMED
Bit 4: RESTRICTED
Bit 5: ISO26262_SAFE";
CM_ SG_ 200 VFC_Obj12A_Measured "Indicator if the object detected is measured or predicted";
CM_ SG_ 200 VFC_Obj12A_VisibleView "The visible view of the detected object";
CM_ SG_ 200 VFC_Obj12A_ClassifiedView "The classified view of object to be used in connection with Heading angle";
CM_ SG_ 200 VFC_Obj12A_DirIndicator "The detected direction indicator lights";
CM_ SG_ 200 VFC_Obj12A_BrakeLight "The number of detected lights. More confident if more lights are detected.";
CM_ SG_ 202 VFC_Obj13A_CRC "CRC - Autosar E2E Profile 5";
CM_ SG_ 202 VFC_Obj13A_AliveCtr "Alive counter - Autosar E2E Profile 5";
CM_ SG_ 202 VFC_Obj13A_ProtBlockCtr "Protocol-Signal: Block-Counter";
CM_ SG_ 202 VFC_Obj13A_ID "Unique Object ID";
CM_ SG_ 202 VFC_Obj13A_Type "Classification of the object";
CM_ SG_ 202 VFC_Obj13A_TypeProb "Probability of the classified object type";
CM_ SG_ 202 VFC_Obj13A_Dx "Object distance in longitudinal direction";
CM_ SG_ 202 VFC_Obj13A_Dy "Object distance in lateral direction";
CM_ SG_ 202 VFC_Obj13A_Vx "Object velocity in longitudinal direction";
CM_ SG_ 202 VFC_Obj13A_Vy "Object velocity in lateral direction";
CM_ SG_ 202 VFC_Obj13A_Ax "Object acceleration in longitudinal direction";
CM_ SG_ 202 VFC_Obj13A_Ay "Object acceleration in lateral direction";
CM_ SG_ 202 VFC_Obj13A_DxStdDev "Standard deviation of Object distance in longitudinal direction";
CM_ SG_ 202 VFC_Obj13A_DyStdDev "Standard deviation of Object distance in lateral direction";
CM_ SG_ 202 VFC_Obj13A_VxStdDev "Standard deviation of Object velocity in longitudinal direction";
CM_ SG_ 202 VFC_Obj13A_VyStdDev "Standard deviation of Object velocity in lateral direction";
CM_ SG_ 202 VFC_Obj13A_AxStdDev "Standard deviation of Object acceleration in longitudinal direction";
CM_ SG_ 202 VFC_Obj13A_AyStdDev "Standard deviation of Object acceleration in lateral direction";
CM_ SG_ 202 VFC_Obj13A_Length "Length of the object";
CM_ SG_ 202 VFC_Obj13A_Width "Width of the object";
CM_ SG_ 202 VFC_Obj13A_Height "Height of the object";
CM_ SG_ 202 VFC_Obj13A_LengthStdDev "Standard deviation of object length";
CM_ SG_ 202 VFC_Obj13A_WidthStdDev "Standard deviation of object width";
CM_ SG_ 202 VFC_Obj13A_HeightStdDev "Standard deviation of object height";
CM_ SG_ 202 VFC_Obj13A_EdgeLeft "In ACCS coordinates; corresponds to tan(viewing angle of left object edge)";
CM_ SG_ 202 VFC_Obj13A_EdgeMid "In ACCS coordinates; corresponds to tan(viewing angle of middle object edge)";
CM_ SG_ 202 VFC_Obj13A_EdgeRight "In ACCS coordinates; corresponds to tan(viewing angle of right object edge)";
CM_ SG_ 202 VFC_Obj13A_EdgeTop "In ACCS coordinates; corresponds to tan(viewing angle of top object edge)";
CM_ SG_ 202 VFC_Obj13A_EdgeBottom "In ACCS coordinates; corresponds to tan(viewing angle of bottom object edge)";
CM_ SG_ 202 VFC_Obj13A_EdgeLeftStdDev "Standard deviation of the ACCS left object edge";
CM_ SG_ 202 VFC_Obj13A_EdgeMidStdDev "Standard deviation of the ACCS middle object edge";
CM_ SG_ 202 VFC_Obj13A_EdgeRightStdDev "Standard deviation of the ACCS right object edge";
CM_ SG_ 202 VFC_Obj13A_EdgeTopStdDev "Standard deviation of the ACCS top object edge";
CM_ SG_ 202 VFC_Obj13A_EdgeBottomStdDev "Standard deviation of the ACCS bottom object edge";
CM_ SG_ 202 VFC_Obj13A_NormVx "Normalised Object velocity in longitudinal direction";
CM_ SG_ 202 VFC_Obj13A_NormAx "Normalised Object acceleration in longitudinal direction";
CM_ SG_ 202 VFC_Obj13A_NormVyEdgeLeft "Normalised velocity of the ACCS left object edge in lateral direction";
CM_ SG_ 202 VFC_Obj13A_NormVyEdgeRight "Normalised velocity of the ACCS right object edge in lateral direction";
CM_ SG_ 202 VFC_Obj13A_NormVxStdDev "Standard deviation of Normalised Object velocity in longitudinal direction";
CM_ SG_ 202 VFC_Obj13A_NormAxStdDev "Standard deviation of Normalised Object acceleration in longitudinal direction";
CM_ SG_ 202 VFC_Obj13A_NormVyEdgeLeftStdDev "Standard deviation of Normalised velocity of the ACCS left object edge in lateral direction";
CM_ SG_ 202 VFC_Obj13A_NormVyEdgeRightStdDev "Standard deviation of Normalised velocity of the ACCS right object edge in lateral direction";
CM_ SG_ 202 VFC_Obj13A_ScaleChange "A scale change of of the detected object";
CM_ SG_ 202 VFC_Obj13A_ScaleChngStdDev "Standard deviation of object scale change";
CM_ SG_ 202 VFC_Obj13A_HeadingAngle "Heading angle of the object";
CM_ SG_ 202 VFC_Obj13A_HeadingAngleStdDev "Standard deviation of object Heading angle";
CM_ SG_ 202 VFC_Obj13A_HeadOrientation "The orientation of the head of cyclists or pedestrians that are detected";
CM_ SG_ 202 VFC_Obj13A_CompletelyInImg "indicator if the object is completely measured in the image";
CM_ SG_ 202 VFC_Obj13A_ProbMovingLat "Probability of object moving laterally";
CM_ SG_ 202 VFC_Obj13A_ProbMovingLong "Probability of object moving longitudinally";
CM_ SG_ 202 VFC_Obj13A_ProbExist "Object existence probability";
CM_ SG_ 202 VFC_Obj13A_MeasSource "Bitfield for the measurement programs from which this object originates
Bit 0: MOD
Bit 1: PDET
Bit 2: OFT
Bit 3: OLS
Bit 4: RESERVED";
CM_ SG_ 202 VFC_Obj13A_Reliability "The bitfield shows if the signal quality is assumed to be sufficient for functions with safety target -no false positives-
Bit 0: DYNAMIC
Bit 1: SEMSEG_SURFACE
Bit 2: WDD_CRITICAL
Bit 3: GOD_CONFIRMED
Bit 4: RESTRICTED
Bit 5: ISO26262_SAFE";
CM_ SG_ 202 VFC_Obj13A_Measured "Indicator if the object detected is measured or predicted";
CM_ SG_ 202 VFC_Obj13A_VisibleView "The visible view of the detected object";
CM_ SG_ 202 VFC_Obj13A_ClassifiedView "The classified view of object to be used in connection with Heading angle";
CM_ SG_ 202 VFC_Obj13A_DirIndicator "The detected direction indicator lights";
CM_ SG_ 202 VFC_Obj13A_BrakeLight "The number of detected lights. More confident if more lights are detected.";
CM_ SG_ 204 VFC_Obj14A_CRC "CRC - Autosar E2E Profile 5";
CM_ SG_ 204 VFC_Obj14A_AliveCtr "Alive counter - Autosar E2E Profile 5";
CM_ SG_ 204 VFC_Obj14A_ProtBlockCtr "Protocol-Signal: Block-Counter";
CM_ SG_ 204 VFC_Obj14A_ID "Unique Object ID";
CM_ SG_ 204 VFC_Obj14A_Type "Classification of the object";
CM_ SG_ 204 VFC_Obj14A_TypeProb "Probability of the classified object type";
CM_ SG_ 204 VFC_Obj14A_Dx "Object distance in longitudinal direction";
CM_ SG_ 204 VFC_Obj14A_Dy "Object distance in lateral direction";
CM_ SG_ 204 VFC_Obj14A_Vx "Object velocity in longitudinal direction";
CM_ SG_ 204 VFC_Obj14A_Vy "Object velocity in lateral direction";
CM_ SG_ 204 VFC_Obj14A_Ax "Object acceleration in longitudinal direction";
CM_ SG_ 204 VFC_Obj14A_Ay "Object acceleration in lateral direction";
CM_ SG_ 204 VFC_Obj14A_DxStdDev "Standard deviation of Object distance in longitudinal direction";
CM_ SG_ 204 VFC_Obj14A_DyStdDev "Standard deviation of Object distance in lateral direction";
CM_ SG_ 204 VFC_Obj14A_VxStdDev "Standard deviation of Object velocity in longitudinal direction";
CM_ SG_ 204 VFC_Obj14A_VyStdDev "Standard deviation of Object velocity in lateral direction";
CM_ SG_ 204 VFC_Obj14A_AxStdDev "Standard deviation of Object acceleration in longitudinal direction";
CM_ SG_ 204 VFC_Obj14A_AyStdDev "Standard deviation of Object acceleration in lateral direction";
CM_ SG_ 204 VFC_Obj14A_Length "Length of the object";
CM_ SG_ 204 VFC_Obj14A_Width "Width of the object";
CM_ SG_ 204 VFC_Obj14A_Height "Height of the object";
CM_ SG_ 204 VFC_Obj14A_LengthStdDev "Standard deviation of object length";
CM_ SG_ 204 VFC_Obj14A_WidthStdDev "Standard deviation of object width";
CM_ SG_ 204 VFC_Obj14A_HeightStdDev "Standard deviation of object height";
CM_ SG_ 204 VFC_Obj14A_EdgeLeft "In ACCS coordinates; corresponds to tan(viewing angle of left object edge)";
CM_ SG_ 204 VFC_Obj14A_EdgeMid "In ACCS coordinates; corresponds to tan(viewing angle of middle object edge)";
CM_ SG_ 204 VFC_Obj14A_EdgeRight "In ACCS coordinates; corresponds to tan(viewing angle of right object edge)";
CM_ SG_ 204 VFC_Obj14A_EdgeTop "In ACCS coordinates; corresponds to tan(viewing angle of top object edge)";
CM_ SG_ 204 VFC_Obj14A_EdgeBottom "In ACCS coordinates; corresponds to tan(viewing angle of bottom object edge)";
CM_ SG_ 204 VFC_Obj14A_EdgeLeftStdDev "Standard deviation of the ACCS left object edge";
CM_ SG_ 204 VFC_Obj14A_EdgeMidStdDev "Standard deviation of the ACCS middle object edge";
CM_ SG_ 204 VFC_Obj14A_EdgeRightStdDev "Standard deviation of the ACCS right object edge";
CM_ SG_ 204 VFC_Obj14A_EdgeTopStdDev "Standard deviation of the ACCS top object edge";
CM_ SG_ 204 VFC_Obj14A_EdgeBottomStdDev "Standard deviation of the ACCS bottom object edge";
CM_ SG_ 204 VFC_Obj14A_NormVx "Normalised Object velocity in longitudinal direction";
CM_ SG_ 204 VFC_Obj14A_NormAx "Normalised Object acceleration in longitudinal direction";
CM_ SG_ 204 VFC_Obj14A_NormVyEdgeLeft "Normalised velocity of the ACCS left object edge in lateral direction";
CM_ SG_ 204 VFC_Obj14A_NormVyEdgeRight "Normalised velocity of the ACCS right object edge in lateral direction";
CM_ SG_ 204 VFC_Obj14A_NormVxStdDev "Standard deviation of Normalised Object velocity in longitudinal direction";
CM_ SG_ 204 VFC_Obj14A_NormAxStdDev "Standard deviation of Normalised Object acceleration in longitudinal direction";
CM_ SG_ 204 VFC_Obj14A_NormVyEdgeLeftStdDev "Standard deviation of Normalised velocity of the ACCS left object edge in lateral direction";
CM_ SG_ 204 VFC_Obj14A_NormVyEdgeRightStdDev "Standard deviation of Normalised velocity of the ACCS right object edge in lateral direction";
CM_ SG_ 204 VFC_Obj14A_ScaleChange "A scale change of of the detected object";
CM_ SG_ 204 VFC_Obj14A_ScaleChngStdDev "Standard deviation of object scale change";
CM_ SG_ 204 VFC_Obj14A_HeadingAngle "Heading angle of the object";
CM_ SG_ 204 VFC_Obj14A_HeadingAngleStdDev "Standard deviation of object Heading angle";
CM_ SG_ 204 VFC_Obj14A_HeadOrientation "The orientation of the head of cyclists or pedestrians that are detected";
CM_ SG_ 204 VFC_Obj14A_CompletelyInImg "indicator if the object is completely measured in the image";
CM_ SG_ 204 VFC_Obj14A_ProbMovingLat "Probability of object moving laterally";
CM_ SG_ 204 VFC_Obj14A_ProbMovingLong "Probability of object moving longitudinally";
CM_ SG_ 204 VFC_Obj14A_ProbExist "Object existence probability";
CM_ SG_ 204 VFC_Obj14A_MeasSource "Bitfield for the measurement programs from which this object originates
Bit 0: MOD
Bit 1: PDET
Bit 2: OFT
Bit 3: OLS
Bit 4: RESERVED";
CM_ SG_ 204 VFC_Obj14A_Reliability "The bitfield shows if the signal quality is assumed to be sufficient for functions with safety target -no false positives-
Bit 0: DYNAMIC
Bit 1: SEMSEG_SURFACE
Bit 2: WDD_CRITICAL
Bit 3: GOD_CONFIRMED
Bit 4: RESTRICTED
Bit 5: ISO26262_SAFE";
CM_ SG_ 204 VFC_Obj14A_Measured "Indicator if the object detected is measured or predicted";
CM_ SG_ 204 VFC_Obj14A_VisibleView "The visible view of the detected object";
CM_ SG_ 204 VFC_Obj14A_ClassifiedView "The classified view of object to be used in connection with Heading angle";
CM_ SG_ 204 VFC_Obj14A_DirIndicator "The detected direction indicator lights";
CM_ SG_ 204 VFC_Obj14A_BrakeLight "The number of detected lights. More confident if more lights are detected.";
CM_ SG_ 206 VFC_Obj15A_CRC "CRC - Autosar E2E Profile 5";
CM_ SG_ 206 VFC_Obj15A_AliveCtr "Alive counter - Autosar E2E Profile 5";
CM_ SG_ 206 VFC_Obj15A_ProtBlockCtr "Protocol-Signal: Block-Counter";
CM_ SG_ 206 VFC_Obj15A_ID "Unique Object ID";
CM_ SG_ 206 VFC_Obj15A_Type "Classification of the object";
CM_ SG_ 206 VFC_Obj15A_TypeProb "Probability of the classified object type";
CM_ SG_ 206 VFC_Obj15A_Dx "Object distance in longitudinal direction";
CM_ SG_ 206 VFC_Obj15A_Dy "Object distance in lateral direction";
CM_ SG_ 206 VFC_Obj15A_Vx "Object velocity in longitudinal direction";
CM_ SG_ 206 VFC_Obj15A_Vy "Object velocity in lateral direction";
CM_ SG_ 206 VFC_Obj15A_Ax "Object acceleration in longitudinal direction";
CM_ SG_ 206 VFC_Obj15A_Ay "Object acceleration in lateral direction";
CM_ SG_ 206 VFC_Obj15A_DxStdDev "Standard deviation of Object distance in longitudinal direction";
CM_ SG_ 206 VFC_Obj15A_DyStdDev "Standard deviation of Object distance in lateral direction";
CM_ SG_ 206 VFC_Obj15A_VxStdDev "Standard deviation of Object velocity in longitudinal direction";
CM_ SG_ 206 VFC_Obj15A_VyStdDev "Standard deviation of Object velocity in lateral direction";
CM_ SG_ 206 VFC_Obj15A_AxStdDev "Standard deviation of Object acceleration in longitudinal direction";
CM_ SG_ 206 VFC_Obj15A_AyStdDev "Standard deviation of Object acceleration in lateral direction";
CM_ SG_ 206 VFC_Obj15A_Length "Length of the object";
CM_ SG_ 206 VFC_Obj15A_Width "Width of the object";
CM_ SG_ 206 VFC_Obj15A_Height "Height of the object";
CM_ SG_ 206 VFC_Obj15A_LengthStdDev "Standard deviation of object length";
CM_ SG_ 206 VFC_Obj15A_WidthStdDev "Standard deviation of object width";
CM_ SG_ 206 VFC_Obj15A_HeightStdDev "Standard deviation of object height";
CM_ SG_ 206 VFC_Obj15A_EdgeLeft "In ACCS coordinates; corresponds to tan(viewing angle of left object edge)";
CM_ SG_ 206 VFC_Obj15A_EdgeMid "In ACCS coordinates; corresponds to tan(viewing angle of middle object edge)";
CM_ SG_ 206 VFC_Obj15A_EdgeRight "In ACCS coordinates; corresponds to tan(viewing angle of right object edge)";
CM_ SG_ 206 VFC_Obj15A_EdgeTop "In ACCS coordinates; corresponds to tan(viewing angle of top object edge)";
CM_ SG_ 206 VFC_Obj15A_EdgeBottom "In ACCS coordinates; corresponds to tan(viewing angle of bottom object edge)";
CM_ SG_ 206 VFC_Obj15A_EdgeLeftStdDev "Standard deviation of the ACCS left object edge";
CM_ SG_ 206 VFC_Obj15A_EdgeMidStdDev "Standard deviation of the ACCS middle object edge";
CM_ SG_ 206 VFC_Obj15A_EdgeRightStdDev "Standard deviation of the ACCS right object edge";
CM_ SG_ 206 VFC_Obj15A_EdgeTopStdDev "Standard deviation of the ACCS top object edge";
CM_ SG_ 206 VFC_Obj15A_EdgeBottomStdDev "Standard deviation of the ACCS bottom object edge";
CM_ SG_ 206 VFC_Obj15A_NormVx "Normalised Object velocity in longitudinal direction";
CM_ SG_ 206 VFC_Obj15A_NormAx "Normalised Object acceleration in longitudinal direction";
CM_ SG_ 206 VFC_Obj15A_NormVyEdgeLeft "Normalised velocity of the ACCS left object edge in lateral direction";
CM_ SG_ 206 VFC_Obj15A_NormVyEdgeRight "Normalised velocity of the ACCS right object edge in lateral direction";
CM_ SG_ 206 VFC_Obj15A_NormVxStdDev "Standard deviation of Normalised Object velocity in longitudinal direction";
CM_ SG_ 206 VFC_Obj15A_NormAxStdDev "Standard deviation of Normalised Object acceleration in longitudinal direction";
CM_ SG_ 206 VFC_Obj15A_NormVyEdgeLeftStdDev "Standard deviation of Normalised velocity of the ACCS left object edge in lateral direction";
CM_ SG_ 206 VFC_Obj15A_NormVyEdgeRightStdDev "Standard deviation of Normalised velocity of the ACCS right object edge in lateral direction";
CM_ SG_ 206 VFC_Obj15A_ScaleChange "A scale change of of the detected object";
CM_ SG_ 206 VFC_Obj15A_ScaleChngStdDev "Standard deviation of object scale change";
CM_ SG_ 206 VFC_Obj15A_HeadingAngle "Heading angle of the object";
CM_ SG_ 206 VFC_Obj15A_HeadingAngleStdDev "Standard deviation of object Heading angle";
CM_ SG_ 206 VFC_Obj15A_HeadOrientation "The orientation of the head of cyclists or pedestrians that are detected";
CM_ SG_ 206 VFC_Obj15A_CompletelyInImg "indicator if the object is completely measured in the image";
CM_ SG_ 206 VFC_Obj15A_ProbMovingLat "Probability of object moving laterally";
CM_ SG_ 206 VFC_Obj15A_ProbMovingLong "Probability of object moving longitudinally";
CM_ SG_ 206 VFC_Obj15A_ProbExist "Object existence probability";
CM_ SG_ 206 VFC_Obj15A_MeasSource "Bitfield for the measurement programs from which this object originates
Bit 0: MOD
Bit 1: PDET
Bit 2: OFT
Bit 3: OLS
Bit 4: RESERVED";
CM_ SG_ 206 VFC_Obj15A_Reliability "The bitfield shows if the signal quality is assumed to be sufficient for functions with safety target -no false positives-
Bit 0: DYNAMIC
Bit 1: SEMSEG_SURFACE
Bit 2: WDD_CRITICAL
Bit 3: GOD_CONFIRMED
Bit 4: RESTRICTED
Bit 5: ISO26262_SAFE";
CM_ SG_ 206 VFC_Obj15A_Measured "Indicator if the object detected is measured or predicted";
CM_ SG_ 206 VFC_Obj15A_VisibleView "The visible view of the detected object";
CM_ SG_ 206 VFC_Obj15A_ClassifiedView "The classified view of object to be used in connection with Heading angle";
CM_ SG_ 206 VFC_Obj15A_DirIndicator "The detected direction indicator lights";
CM_ SG_ 206 VFC_Obj15A_BrakeLight "The number of detected lights. More confident if more lights are detected.";
CM_ SG_ 208 VFC_Obj16A_CRC "CRC - Autosar E2E Profile 5";
CM_ SG_ 208 VFC_Obj16A_AliveCtr "Alive counter - Autosar E2E Profile 5";
CM_ SG_ 208 VFC_Obj16A_ProtBlockCtr "Protocol-Signal: Block-Counter";
CM_ SG_ 208 VFC_Obj16A_ID "Unique Object ID";
CM_ SG_ 208 VFC_Obj16A_Type "Classification of the object";
CM_ SG_ 208 VFC_Obj16A_TypeProb "Probability of the classified object type";
CM_ SG_ 208 VFC_Obj16A_Dx "Object distance in longitudinal direction";
CM_ SG_ 208 VFC_Obj16A_Dy "Object distance in lateral direction";
CM_ SG_ 208 VFC_Obj16A_Vx "Object velocity in longitudinal direction";
CM_ SG_ 208 VFC_Obj16A_Vy "Object velocity in lateral direction";
CM_ SG_ 208 VFC_Obj16A_Ax "Object acceleration in longitudinal direction";
CM_ SG_ 208 VFC_Obj16A_Ay "Object acceleration in lateral direction";
CM_ SG_ 208 VFC_Obj16A_DxStdDev "Standard deviation of Object distance in longitudinal direction";
CM_ SG_ 208 VFC_Obj16A_DyStdDev "Standard deviation of Object distance in lateral direction";
CM_ SG_ 208 VFC_Obj16A_VxStdDev "Standard deviation of Object velocity in longitudinal direction";
CM_ SG_ 208 VFC_Obj16A_VyStdDev "Standard deviation of Object velocity in lateral direction";
CM_ SG_ 208 VFC_Obj16A_AxStdDev "Standard deviation of Object acceleration in longitudinal direction";
CM_ SG_ 208 VFC_Obj16A_AyStdDev "Standard deviation of Object acceleration in lateral direction";
CM_ SG_ 208 VFC_Obj16A_Length "Length of the object";
CM_ SG_ 208 VFC_Obj16A_Width "Width of the object";
CM_ SG_ 208 VFC_Obj16A_Height "Height of the object";
CM_ SG_ 208 VFC_Obj16A_LengthStdDev "Standard deviation of object length";
CM_ SG_ 208 VFC_Obj16A_WidthStdDev "Standard deviation of object width";
CM_ SG_ 208 VFC_Obj16A_HeightStdDev "Standard deviation of object height";
CM_ SG_ 208 VFC_Obj16A_EdgeLeft "In ACCS coordinates; corresponds to tan(viewing angle of left object edge)";
CM_ SG_ 208 VFC_Obj16A_EdgeMid "In ACCS coordinates; corresponds to tan(viewing angle of middle object edge)";
CM_ SG_ 208 VFC_Obj16A_EdgeRight "In ACCS coordinates; corresponds to tan(viewing angle of right object edge)";
CM_ SG_ 208 VFC_Obj16A_EdgeTop "In ACCS coordinates; corresponds to tan(viewing angle of top object edge)";
CM_ SG_ 208 VFC_Obj16A_EdgeBottom "In ACCS coordinates; corresponds to tan(viewing angle of bottom object edge)";
CM_ SG_ 208 VFC_Obj16A_EdgeLeftStdDev "Standard deviation of the ACCS left object edge";
CM_ SG_ 208 VFC_Obj16A_EdgeMidStdDev "Standard deviation of the ACCS middle object edge";
CM_ SG_ 208 VFC_Obj16A_EdgeRightStdDev "Standard deviation of the ACCS right object edge";
CM_ SG_ 208 VFC_Obj16A_EdgeTopStdDev "Standard deviation of the ACCS top object edge";
CM_ SG_ 208 VFC_Obj16A_EdgeBottomStdDev "Standard deviation of the ACCS bottom object edge";
CM_ SG_ 208 VFC_Obj16A_NormVx "Normalised Object velocity in longitudinal direction";
CM_ SG_ 208 VFC_Obj16A_NormAx "Normalised Object acceleration in longitudinal direction";
CM_ SG_ 208 VFC_Obj16A_NormVyEdgeLeft "Normalised velocity of the ACCS left object edge in lateral direction";
CM_ SG_ 208 VFC_Obj16A_NormVyEdgeRight "Normalised velocity of the ACCS right object edge in lateral direction";
CM_ SG_ 208 VFC_Obj16A_NormVxStdDev "Standard deviation of Normalised Object velocity in longitudinal direction";
CM_ SG_ 208 VFC_Obj16A_NormAxStdDev "Standard deviation of Normalised Object acceleration in longitudinal direction";
CM_ SG_ 208 VFC_Obj16A_NormVyEdgeLeftStdDev "Standard deviation of Normalised velocity of the ACCS left object edge in lateral direction";
CM_ SG_ 208 VFC_Obj16A_NormVyEdgeRightStdDev "Standard deviation of Normalised velocity of the ACCS right object edge in lateral direction";
CM_ SG_ 208 VFC_Obj16A_ScaleChange "A scale change of of the detected object";
CM_ SG_ 208 VFC_Obj16A_ScaleChngStdDev "Standard deviation of object scale change";
CM_ SG_ 208 VFC_Obj16A_HeadingAngle "Heading angle of the object";
CM_ SG_ 208 VFC_Obj16A_HeadingAngleStdDev "Standard deviation of object Heading angle";
CM_ SG_ 208 VFC_Obj16A_HeadOrientation "The orientation of the head of cyclists or pedestrians that are detected";
CM_ SG_ 208 VFC_Obj16A_CompletelyInImg "indicator if the object is completely measured in the image";
CM_ SG_ 208 VFC_Obj16A_ProbMovingLat "Probability of object moving laterally";
CM_ SG_ 208 VFC_Obj16A_ProbMovingLong "Probability of object moving longitudinally";
CM_ SG_ 208 VFC_Obj16A_ProbExist "Object existence probability";
CM_ SG_ 208 VFC_Obj16A_MeasSource "Bitfield for the measurement programs from which this object originates
Bit 0: MOD
Bit 1: PDET
Bit 2: OFT
Bit 3: OLS
Bit 4: RESERVED";
CM_ SG_ 208 VFC_Obj16A_Reliability "The bitfield shows if the signal quality is assumed to be sufficient for functions with safety target -no false positives-
Bit 0: DYNAMIC
Bit 1: SEMSEG_SURFACE
Bit 2: WDD_CRITICAL
Bit 3: GOD_CONFIRMED
Bit 4: RESTRICTED
Bit 5: ISO26262_SAFE";
CM_ SG_ 208 VFC_Obj16A_Measured "Indicator if the object detected is measured or predicted";
CM_ SG_ 208 VFC_Obj16A_VisibleView "The visible view of the detected object";
CM_ SG_ 208 VFC_Obj16A_ClassifiedView "The classified view of object to be used in connection with Heading angle";
CM_ SG_ 208 VFC_Obj16A_DirIndicator "The detected direction indicator lights";
CM_ SG_ 208 VFC_Obj16A_BrakeLight "The number of detected lights. More confident if more lights are detected.";
CM_ SG_ 210 VFC_Obj17A_CRC "CRC - Autosar E2E Profile 5";
CM_ SG_ 210 VFC_Obj17A_AliveCtr "Alive counter - Autosar E2E Profile 5";
CM_ SG_ 210 VFC_Obj17A_ProtBlockCtr "Protocol-Signal: Block-Counter";
CM_ SG_ 210 VFC_Obj17A_ID "Unique Object ID";
CM_ SG_ 210 VFC_Obj17A_Type "Classification of the object";
CM_ SG_ 210 VFC_Obj17A_TypeProb "Probability of the classified object type";
CM_ SG_ 210 VFC_Obj17A_Dx "Object distance in longitudinal direction";
CM_ SG_ 210 VFC_Obj17A_Dy "Object distance in lateral direction";
CM_ SG_ 210 VFC_Obj17A_Vx "Object velocity in longitudinal direction";
CM_ SG_ 210 VFC_Obj17A_Vy "Object velocity in lateral direction";
CM_ SG_ 210 VFC_Obj17A_Ax "Object acceleration in longitudinal direction";
CM_ SG_ 210 VFC_Obj17A_Ay "Object acceleration in lateral direction";
CM_ SG_ 210 VFC_Obj17A_DxStdDev "Standard deviation of Object distance in longitudinal direction";
CM_ SG_ 210 VFC_Obj17A_DyStdDev "Standard deviation of Object distance in lateral direction";
CM_ SG_ 210 VFC_Obj17A_VxStdDev "Standard deviation of Object velocity in longitudinal direction";
CM_ SG_ 210 VFC_Obj17A_VyStdDev "Standard deviation of Object velocity in lateral direction";
CM_ SG_ 210 VFC_Obj17A_AxStdDev "Standard deviation of Object acceleration in longitudinal direction";
CM_ SG_ 210 VFC_Obj17A_AyStdDev "Standard deviation of Object acceleration in lateral direction";
CM_ SG_ 210 VFC_Obj17A_Length "Length of the object";
CM_ SG_ 210 VFC_Obj17A_Width "Width of the object";
CM_ SG_ 210 VFC_Obj17A_Height "Height of the object";
CM_ SG_ 210 VFC_Obj17A_LengthStdDev "Standard deviation of object length";
CM_ SG_ 210 VFC_Obj17A_WidthStdDev "Standard deviation of object width";
CM_ SG_ 210 VFC_Obj17A_HeightStdDev "Standard deviation of object height";
CM_ SG_ 210 VFC_Obj17A_EdgeLeft "In ACCS coordinates; corresponds to tan(viewing angle of left object edge)";
CM_ SG_ 210 VFC_Obj17A_EdgeMid "In ACCS coordinates; corresponds to tan(viewing angle of middle object edge)";
CM_ SG_ 210 VFC_Obj17A_EdgeRight "In ACCS coordinates; corresponds to tan(viewing angle of right object edge)";
CM_ SG_ 210 VFC_Obj17A_EdgeTop "In ACCS coordinates; corresponds to tan(viewing angle of top object edge)";
CM_ SG_ 210 VFC_Obj17A_EdgeBottom "In ACCS coordinates; corresponds to tan(viewing angle of bottom object edge)";
CM_ SG_ 210 VFC_Obj17A_EdgeLeftStdDev "Standard deviation of the ACCS left object edge";
CM_ SG_ 210 VFC_Obj17A_EdgeMidStdDev "Standard deviation of the ACCS middle object edge";
CM_ SG_ 210 VFC_Obj17A_EdgeRightStdDev "Standard deviation of the ACCS right object edge";
CM_ SG_ 210 VFC_Obj17A_EdgeTopStdDev "Standard deviation of the ACCS top object edge";
CM_ SG_ 210 VFC_Obj17A_EdgeBottomStdDev "Standard deviation of the ACCS bottom object edge";
CM_ SG_ 210 VFC_Obj17A_NormVx "Normalised Object velocity in longitudinal direction";
CM_ SG_ 210 VFC_Obj17A_NormAx "Normalised Object acceleration in longitudinal direction";
CM_ SG_ 210 VFC_Obj17A_NormVyEdgeLeft "Normalised velocity of the ACCS left object edge in lateral direction";
CM_ SG_ 210 VFC_Obj17A_NormVyEdgeRight "Normalised velocity of the ACCS right object edge in lateral direction";
CM_ SG_ 210 VFC_Obj17A_NormVxStdDev "Standard deviation of Normalised Object velocity in longitudinal direction";
CM_ SG_ 210 VFC_Obj17A_NormAxStdDev "Standard deviation of Normalised Object acceleration in longitudinal direction";
CM_ SG_ 210 VFC_Obj17A_NormVyEdgeLeftStdDev "Standard deviation of Normalised velocity of the ACCS left object edge in lateral direction";
CM_ SG_ 210 VFC_Obj17A_NormVyEdgeRightStdDev "Standard deviation of Normalised velocity of the ACCS right object edge in lateral direction";
CM_ SG_ 210 VFC_Obj17A_ScaleChange "A scale change of of the detected object";
CM_ SG_ 210 VFC_Obj17A_ScaleChngStdDev "Standard deviation of object scale change";
CM_ SG_ 210 VFC_Obj17A_HeadingAngle "Heading angle of the object";
CM_ SG_ 210 VFC_Obj17A_HeadingAngleStdDev "Standard deviation of object Heading angle";
CM_ SG_ 210 VFC_Obj17A_HeadOrientation "The orientation of the head of cyclists or pedestrians that are detected";
CM_ SG_ 210 VFC_Obj17A_CompletelyInImg "indicator if the object is completely measured in the image";
CM_ SG_ 210 VFC_Obj17A_ProbMovingLat "Probability of object moving laterally";
CM_ SG_ 210 VFC_Obj17A_ProbMovingLong "Probability of object moving longitudinally";
CM_ SG_ 210 VFC_Obj17A_ProbExist "Object existence probability";
CM_ SG_ 210 VFC_Obj17A_MeasSource "Bitfield for the measurement programs from which this object originates
Bit 0: MOD
Bit 1: PDET
Bit 2: OFT
Bit 3: OLS
Bit 4: RESERVED";
CM_ SG_ 210 VFC_Obj17A_Reliability "The bitfield shows if the signal quality is assumed to be sufficient for functions with safety target -no false positives-
Bit 0: DYNAMIC
Bit 1: SEMSEG_SURFACE
Bit 2: WDD_CRITICAL
Bit 3: GOD_CONFIRMED
Bit 4: RESTRICTED
Bit 5: ISO26262_SAFE";
CM_ SG_ 210 VFC_Obj17A_Measured "Indicator if the object detected is measured or predicted";
CM_ SG_ 210 VFC_Obj17A_VisibleView "The visible view of the detected object";
CM_ SG_ 210 VFC_Obj17A_ClassifiedView "The classified view of object to be used in connection with Heading angle";
CM_ SG_ 210 VFC_Obj17A_DirIndicator "The detected direction indicator lights";
CM_ SG_ 210 VFC_Obj17A_BrakeLight "The number of detected lights. More confident if more lights are detected.";
CM_ SG_ 212 VFC_Obj18A_CRC "CRC - Autosar E2E Profile 5";
CM_ SG_ 212 VFC_Obj18A_AliveCtr "Alive counter - Autosar E2E Profile 5";
CM_ SG_ 212 VFC_Obj18A_ProtBlockCtr "Protocol-Signal: Block-Counter";
CM_ SG_ 212 VFC_Obj18A_ID "Unique Object ID";
CM_ SG_ 212 VFC_Obj18A_Type "Classification of the object";
CM_ SG_ 212 VFC_Obj18A_TypeProb "Probability of the classified object type";
CM_ SG_ 212 VFC_Obj18A_Dx "Object distance in longitudinal direction";
CM_ SG_ 212 VFC_Obj18A_Dy "Object distance in lateral direction";
CM_ SG_ 212 VFC_Obj18A_Vx "Object velocity in longitudinal direction";
CM_ SG_ 212 VFC_Obj18A_Vy "Object velocity in lateral direction";
CM_ SG_ 212 VFC_Obj18A_Ax "Object acceleration in longitudinal direction";
CM_ SG_ 212 VFC_Obj18A_Ay "Object acceleration in lateral direction";
CM_ SG_ 212 VFC_Obj18A_DxStdDev "Standard deviation of Object distance in longitudinal direction";
CM_ SG_ 212 VFC_Obj18A_DyStdDev "Standard deviation of Object distance in lateral direction";
CM_ SG_ 212 VFC_Obj18A_VxStdDev "Standard deviation of Object velocity in longitudinal direction";
CM_ SG_ 212 VFC_Obj18A_VyStdDev "Standard deviation of Object velocity in lateral direction";
CM_ SG_ 212 VFC_Obj18A_AxStdDev "Standard deviation of Object acceleration in longitudinal direction";
CM_ SG_ 212 VFC_Obj18A_AyStdDev "Standard deviation of Object acceleration in lateral direction";
CM_ SG_ 212 VFC_Obj18A_Length "Length of the object";
CM_ SG_ 212 VFC_Obj18A_Width "Width of the object";
CM_ SG_ 212 VFC_Obj18A_Height "Height of the object";
CM_ SG_ 212 VFC_Obj18A_LengthStdDev "Standard deviation of object length";
CM_ SG_ 212 VFC_Obj18A_WidthStdDev "Standard deviation of object width";
CM_ SG_ 212 VFC_Obj18A_HeightStdDev "Standard deviation of object height";
CM_ SG_ 212 VFC_Obj18A_EdgeLeft "In ACCS coordinates; corresponds to tan(viewing angle of left object edge)";
CM_ SG_ 212 VFC_Obj18A_EdgeMid "In ACCS coordinates; corresponds to tan(viewing angle of middle object edge)";
CM_ SG_ 212 VFC_Obj18A_EdgeRight "In ACCS coordinates; corresponds to tan(viewing angle of right object edge)";
CM_ SG_ 212 VFC_Obj18A_EdgeTop "In ACCS coordinates; corresponds to tan(viewing angle of top object edge)";
CM_ SG_ 212 VFC_Obj18A_EdgeBottom "In ACCS coordinates; corresponds to tan(viewing angle of bottom object edge)";
CM_ SG_ 212 VFC_Obj18A_EdgeLeftStdDev "Standard deviation of the ACCS left object edge";
CM_ SG_ 212 VFC_Obj18A_EdgeMidStdDev "Standard deviation of the ACCS middle object edge";
CM_ SG_ 212 VFC_Obj18A_EdgeRightStdDev "Standard deviation of the ACCS right object edge";
CM_ SG_ 212 VFC_Obj18A_EdgeTopStdDev "Standard deviation of the ACCS top object edge";
CM_ SG_ 212 VFC_Obj18A_EdgeBottomStdDev "Standard deviation of the ACCS bottom object edge";
CM_ SG_ 212 VFC_Obj18A_NormVx "Normalised Object velocity in longitudinal direction";
CM_ SG_ 212 VFC_Obj18A_NormAx "Normalised Object acceleration in longitudinal direction";
CM_ SG_ 212 VFC_Obj18A_NormVyEdgeLeft "Normalised velocity of the ACCS left object edge in lateral direction";
CM_ SG_ 212 VFC_Obj18A_NormVyEdgeRight "Normalised velocity of the ACCS right object edge in lateral direction";
CM_ SG_ 212 VFC_Obj18A_NormVxStdDev "Standard deviation of Normalised Object velocity in longitudinal direction";
CM_ SG_ 212 VFC_Obj18A_NormAxStdDev "Standard deviation of Normalised Object acceleration in longitudinal direction";
CM_ SG_ 212 VFC_Obj18A_NormVyEdgeLeftStdDev "Standard deviation of Normalised velocity of the ACCS left object edge in lateral direction";
CM_ SG_ 212 VFC_Obj18A_NormVyEdgeRightStdDev "Standard deviation of Normalised velocity of the ACCS right object edge in lateral direction";
CM_ SG_ 212 VFC_Obj18A_ScaleChange "A scale change of of the detected object";
CM_ SG_ 212 VFC_Obj18A_ScaleChngStdDev "Standard deviation of object scale change";
CM_ SG_ 212 VFC_Obj18A_HeadingAngle "Heading angle of the object";
CM_ SG_ 212 VFC_Obj18A_HeadingAngleStdDev "Standard deviation of object Heading angle";
CM_ SG_ 212 VFC_Obj18A_HeadOrientation "The orientation of the head of cyclists or pedestrians that are detected";
CM_ SG_ 212 VFC_Obj18A_CompletelyInImg "indicator if the object is completely measured in the image";
CM_ SG_ 212 VFC_Obj18A_ProbMovingLat "Probability of object moving laterally";
CM_ SG_ 212 VFC_Obj18A_ProbMovingLong "Probability of object moving longitudinally";
CM_ SG_ 212 VFC_Obj18A_ProbExist "Object existence probability";
CM_ SG_ 212 VFC_Obj18A_MeasSource "Bitfield for the measurement programs from which this object originates
Bit 0: MOD
Bit 1: PDET
Bit 2: OFT
Bit 3: OLS
Bit 4: RESERVED";
CM_ SG_ 212 VFC_Obj18A_Reliability "The bitfield shows if the signal quality is assumed to be sufficient for functions with safety target -no false positives-
Bit 0: DYNAMIC
Bit 1: SEMSEG_SURFACE
Bit 2: WDD_CRITICAL
Bit 3: GOD_CONFIRMED
Bit 4: RESTRICTED
Bit 5: ISO26262_SAFE";
CM_ SG_ 212 VFC_Obj18A_Measured "Indicator if the object detected is measured or predicted";
CM_ SG_ 212 VFC_Obj18A_VisibleView "The visible view of the detected object";
CM_ SG_ 212 VFC_Obj18A_ClassifiedView "The classified view of object to be used in connection with Heading angle";
CM_ SG_ 212 VFC_Obj18A_DirIndicator "The detected direction indicator lights";
CM_ SG_ 212 VFC_Obj18A_BrakeLight "The number of detected lights. More confident if more lights are detected.";
CM_ SG_ 214 VFC_Obj19A_CRC "CRC - Autosar E2E Profile 5";
CM_ SG_ 214 VFC_Obj19A_AliveCtr "Alive counter - Autosar E2E Profile 5";
CM_ SG_ 214 VFC_Obj19A_ProtBlockCtr "Protocol-Signal: Block-Counter";
CM_ SG_ 214 VFC_Obj19A_ID "Unique Object ID";
CM_ SG_ 214 VFC_Obj19A_Type "Classification of the object";
CM_ SG_ 214 VFC_Obj19A_TypeProb "Probability of the classified object type";
CM_ SG_ 214 VFC_Obj19A_Dx "Object distance in longitudinal direction";
CM_ SG_ 214 VFC_Obj19A_Dy "Object distance in lateral direction";
CM_ SG_ 214 VFC_Obj19A_Vx "Object velocity in longitudinal direction";
CM_ SG_ 214 VFC_Obj19A_Vy "Object velocity in lateral direction";
CM_ SG_ 214 VFC_Obj19A_Ax "Object acceleration in longitudinal direction";
CM_ SG_ 214 VFC_Obj19A_Ay "Object acceleration in lateral direction";
CM_ SG_ 214 VFC_Obj19A_DxStdDev "Standard deviation of Object distance in longitudinal direction";
CM_ SG_ 214 VFC_Obj19A_DyStdDev "Standard deviation of Object distance in lateral direction";
CM_ SG_ 214 VFC_Obj19A_VxStdDev "Standard deviation of Object velocity in longitudinal direction";
CM_ SG_ 214 VFC_Obj19A_VyStdDev "Standard deviation of Object velocity in lateral direction";
CM_ SG_ 214 VFC_Obj19A_AxStdDev "Standard deviation of Object acceleration in longitudinal direction";
CM_ SG_ 214 VFC_Obj19A_AyStdDev "Standard deviation of Object acceleration in lateral direction";
CM_ SG_ 214 VFC_Obj19A_Length "Length of the object";
CM_ SG_ 214 VFC_Obj19A_Width "Width of the object";
CM_ SG_ 214 VFC_Obj19A_Height "Height of the object";
CM_ SG_ 214 VFC_Obj19A_LengthStdDev "Standard deviation of object length";
CM_ SG_ 214 VFC_Obj19A_WidthStdDev "Standard deviation of object width";
CM_ SG_ 214 VFC_Obj19A_HeightStdDev "Standard deviation of object height";
CM_ SG_ 214 VFC_Obj19A_EdgeLeft "In ACCS coordinates; corresponds to tan(viewing angle of left object edge)";
CM_ SG_ 214 VFC_Obj19A_EdgeMid "In ACCS coordinates; corresponds to tan(viewing angle of middle object edge)";
CM_ SG_ 214 VFC_Obj19A_EdgeRight "In ACCS coordinates; corresponds to tan(viewing angle of right object edge)";
CM_ SG_ 214 VFC_Obj19A_EdgeTop "In ACCS coordinates; corresponds to tan(viewing angle of top object edge)";
CM_ SG_ 214 VFC_Obj19A_EdgeBottom "In ACCS coordinates; corresponds to tan(viewing angle of bottom object edge)";
CM_ SG_ 214 VFC_Obj19A_EdgeLeftStdDev "Standard deviation of the ACCS left object edge";
CM_ SG_ 214 VFC_Obj19A_EdgeMidStdDev "Standard deviation of the ACCS middle object edge";
CM_ SG_ 214 VFC_Obj19A_EdgeRightStdDev "Standard deviation of the ACCS right object edge";
CM_ SG_ 214 VFC_Obj19A_EdgeTopStdDev "Standard deviation of the ACCS top object edge";
CM_ SG_ 214 VFC_Obj19A_EdgeBottomStdDev "Standard deviation of the ACCS bottom object edge";
CM_ SG_ 214 VFC_Obj19A_NormVx "Normalised Object velocity in longitudinal direction";
CM_ SG_ 214 VFC_Obj19A_NormAx "Normalised Object acceleration in longitudinal direction";
CM_ SG_ 214 VFC_Obj19A_NormVyEdgeLeft "Normalised velocity of the ACCS left object edge in lateral direction";
CM_ SG_ 214 VFC_Obj19A_NormVyEdgeRight "Normalised velocity of the ACCS right object edge in lateral direction";
CM_ SG_ 214 VFC_Obj19A_NormVxStdDev "Standard deviation of Normalised Object velocity in longitudinal direction";
CM_ SG_ 214 VFC_Obj19A_NormAxStdDev "Standard deviation of Normalised Object acceleration in longitudinal direction";
CM_ SG_ 214 VFC_Obj19A_NormVyEdgeLeftStdDev "Standard deviation of Normalised velocity of the ACCS left object edge in lateral direction";
CM_ SG_ 214 VFC_Obj19A_NormVyEdgeRightStdDev "Standard deviation of Normalised velocity of the ACCS right object edge in lateral direction";
CM_ SG_ 214 VFC_Obj19A_ScaleChange "A scale change of of the detected object";
CM_ SG_ 214 VFC_Obj19A_ScaleChngStdDev "Standard deviation of object scale change";
CM_ SG_ 214 VFC_Obj19A_HeadingAngle "Heading angle of the object";
CM_ SG_ 214 VFC_Obj19A_HeadingAngleStdDev "Standard deviation of object Heading angle";
CM_ SG_ 214 VFC_Obj19A_HeadOrientation "The orientation of the head of cyclists or pedestrians that are detected";
CM_ SG_ 214 VFC_Obj19A_CompletelyInImg "indicator if the object is completely measured in the image";
CM_ SG_ 214 VFC_Obj19A_ProbMovingLat "Probability of object moving laterally";
CM_ SG_ 214 VFC_Obj19A_ProbMovingLong "Probability of object moving longitudinally";
CM_ SG_ 214 VFC_Obj19A_ProbExist "Object existence probability";
CM_ SG_ 214 VFC_Obj19A_MeasSource "Bitfield for the measurement programs from which this object originates
Bit 0: MOD
Bit 1: PDET
Bit 2: OFT
Bit 3: OLS
Bit 4: RESERVED";
CM_ SG_ 214 VFC_Obj19A_Reliability "The bitfield shows if the signal quality is assumed to be sufficient for functions with safety target -no false positives-
Bit 0: DYNAMIC
Bit 1: SEMSEG_SURFACE
Bit 2: WDD_CRITICAL
Bit 3: GOD_CONFIRMED
Bit 4: RESTRICTED
Bit 5: ISO26262_SAFE";
CM_ SG_ 214 VFC_Obj19A_Measured "Indicator if the object detected is measured or predicted";
CM_ SG_ 214 VFC_Obj19A_VisibleView "The visible view of the detected object";
CM_ SG_ 214 VFC_Obj19A_ClassifiedView "The classified view of object to be used in connection with Heading angle";
CM_ SG_ 214 VFC_Obj19A_DirIndicator "The detected direction indicator lights";
CM_ SG_ 214 VFC_Obj19A_BrakeLight "The number of detected lights. More confident if more lights are detected.";
CM_ SG_ 128 VFC_LaneHdr_CRC "CRC - Autosar E2E Profile 5";
CM_ SG_ 128 VFC_LaneHdr_AliveCtr "Alive counter - Autosar E2E Profile 5";
CM_ SG_ 128 VFC_LaneHdr_ProtBlockCtr "Protocol-Signal: Block-Counter";
CM_ SG_ 128 VFC_LaneHdr_ProtSegCount "Protocol-Signal: count of all lane segments";
CM_ SG_ 128 VFC_LaneHdr_ProtPointCount "Protocol-Signal: count of all lane points";
CM_ SG_ 128 VFC_LaneHdr_ProtClothCount "Protocol-Signal: count of all clothoids";
CM_ SG_ 128 VFC_LaneHdr_TimeStamp "AUTOSAR TimeStamp of Lane objects";
CM_ SG_ 128 VFC_LaneHdr_State "Informs the system of the current state of the lane detection system";
CM_ SG_ 128 VFC_LaneHdr_TimeLatency "Absolute time gap, i.e. latency, between measurement time and sending time";
CM_ SG_ 129 VFC_Cloth00_CRC "CRC - Autosar E2E Profile 5";
CM_ SG_ 129 VFC_Cloth00_AliveCtr "Alive counter - Autosar E2E Profile 5";
CM_ SG_ 129 VFC_Cloth00_ProtBlockCtr "Protocol-Signal: Block-Counter";
CM_ SG_ 129 VFC_Cloth00_Conf "Confidence for this clothoid, probability that it describes the true lane boundary";
CM_ SG_ 129 VFC_Cloth00_DxEnd "Longitudinal range of the clothoid, also called LookAheadDistance";
CM_ SG_ 129 VFC_Cloth00_Dy "Lateral offset at x=0, also called LatDeviation (resolution = 2^-7)";
CM_ SG_ 129 VFC_Cloth00_DyStdDev "Standard deviation at x=0 of the lateral offset (resolution = 2^-7)";
CM_ SG_ 129 VFC_Cloth00_Curv "Curvature of the clothoid, also called kappa ";
CM_ SG_ 129 VFC_Cloth00_CurvChange "Curvature change or alteration of the clothoid, also called kappaDt (resolution = 2^-17)";
CM_ SG_ 129 VFC_Cloth00_CourseDeviation "Confidence measure quantifying a weighted deviation between course/path and the predicted lane";
CM_ SG_ 129 VFC_Cloth00_HeadingAngle "Heading angle, difference in yaw angle between vehicle heading and clothoid (resolution = 2^-11)";
CM_ SG_ 129 VFC_Cloth00_LineWidth "Width of the line";
CM_ SG_ 129 VFC_Cloth00_Type "Type of the Line";
CM_ SG_ 129 VFC_Cloth00_TypeProb "Confidence measure for Type classification";
CM_ SG_ 129 VFC_Cloth00_MeasureType "Indicates if clothoid was measured, interpolated or inferred (virtual line)";
CM_ SG_ 129 VFC_Cloth00_ColorClass "The color of the line";
CM_ SG_ 129 VFC_Cloth00_LineID "Number of the clothoid, indicating its position relative to the ego lane";
CM_ SG_ 130 VFC_Cloth01_CRC "CRC - Autosar E2E Profile 5";
CM_ SG_ 130 VFC_Cloth01_AliveCtr "Alive counter - Autosar E2E Profile 5";
CM_ SG_ 130 VFC_Cloth01_ProtBlockCtr "Protocol-Signal: Block-Counter";
CM_ SG_ 130 VFC_Cloth01_Conf "Confidence for this clothoid, probability that it describes the true lane boundary";
CM_ SG_ 130 VFC_Cloth01_DxEnd "Longitudinal range of the clothoid, also called LookAheadDistance";
CM_ SG_ 130 VFC_Cloth01_Dy "Lateral offset at x=0, also called LatDeviation (resolution = 2^-7)";
CM_ SG_ 130 VFC_Cloth01_DyStdDev "Standard deviation at x=0 of the lateral offset (resolution = 2^-7)";
CM_ SG_ 130 VFC_Cloth01_Curv "Curvature of the clothoid, also called kappa ";
CM_ SG_ 130 VFC_Cloth01_CurvChange "Curvature change or alteration of the clothoid, also called kappaDt (resolution = 2^-17)";
CM_ SG_ 130 VFC_Cloth01_CourseDeviation "Confidence measure quantifying a weighted deviation between course/path and the predicted lane";
CM_ SG_ 130 VFC_Cloth01_HeadingAngle "Heading angle, difference in yaw angle between vehicle heading and clothoid (resolution = 2^-11)";
CM_ SG_ 130 VFC_Cloth01_LineWidth "Width of the line";
CM_ SG_ 130 VFC_Cloth01_Type "Type of the Line";
CM_ SG_ 130 VFC_Cloth01_TypeProb "Confidence measure for Type classification";
CM_ SG_ 130 VFC_Cloth01_MeasureType "Indicates if clothoid was measured, interpolated or inferred (virtual line)";
CM_ SG_ 130 VFC_Cloth01_ColorClass "The color of the line";
CM_ SG_ 130 VFC_Cloth01_LineID "Number of the clothoid, indicating its position relative to the ego lane";
CM_ SG_ 131 VFC_Cloth02_CRC "CRC - Autosar E2E Profile 5";
CM_ SG_ 131 VFC_Cloth02_AliveCtr "Alive counter - Autosar E2E Profile 5";
CM_ SG_ 131 VFC_Cloth02_ProtBlockCtr "Protocol-Signal: Block-Counter";
CM_ SG_ 131 VFC_Cloth02_Conf "Confidence for this clothoid, probability that it describes the true lane boundary";
CM_ SG_ 131 VFC_Cloth02_DxEnd "Longitudinal range of the clothoid, also called LookAheadDistance";
CM_ SG_ 131 VFC_Cloth02_Dy "Lateral offset at x=0, also called LatDeviation (resolution = 2^-7)";
CM_ SG_ 131 VFC_Cloth02_DyStdDev "Standard deviation at x=0 of the lateral offset (resolution = 2^-7)";
CM_ SG_ 131 VFC_Cloth02_Curv "Curvature of the clothoid, also called kappa ";
CM_ SG_ 131 VFC_Cloth02_CurvChange "Curvature change or alteration of the clothoid, also called kappaDt (resolution = 2^-17)";
CM_ SG_ 131 VFC_Cloth02_CourseDeviation "Confidence measure quantifying a weighted deviation between course/path and the predicted lane";
CM_ SG_ 131 VFC_Cloth02_HeadingAngle "Heading angle, difference in yaw angle between vehicle heading and clothoid (resolution = 2^-11)";
CM_ SG_ 131 VFC_Cloth02_LineWidth "Width of the line";
CM_ SG_ 131 VFC_Cloth02_Type "Type of the Line";
CM_ SG_ 131 VFC_Cloth02_TypeProb "Confidence measure for Type classification";
CM_ SG_ 131 VFC_Cloth02_MeasureType "Indicates if clothoid was measured, interpolated or inferred (virtual line)";
CM_ SG_ 131 VFC_Cloth02_ColorClass "The color of the line";
CM_ SG_ 131 VFC_Cloth02_LineID "Number of the clothoid, indicating its position relative to the ego lane";
CM_ SG_ 132 VFC_Cloth03_CRC "CRC - Autosar E2E Profile 5";
CM_ SG_ 132 VFC_Cloth03_AliveCtr "Alive counter - Autosar E2E Profile 5";
CM_ SG_ 132 VFC_Cloth03_ProtBlockCtr "Protocol-Signal: Block-Counter";
CM_ SG_ 132 VFC_Cloth03_Conf "Confidence for this clothoid, probability that it describes the true lane boundary";
CM_ SG_ 132 VFC_Cloth03_DxEnd "Longitudinal range of the clothoid, also called LookAheadDistance";
CM_ SG_ 132 VFC_Cloth03_Dy "Lateral offset at x=0, also called LatDeviation (resolution = 2^-7)";
CM_ SG_ 132 VFC_Cloth03_DyStdDev "Standard deviation at x=0 of the lateral offset (resolution = 2^-7)";
CM_ SG_ 132 VFC_Cloth03_Curv "Curvature of the clothoid, also called kappa ";
CM_ SG_ 132 VFC_Cloth03_CurvChange "Curvature change or alteration of the clothoid, also called kappaDt (resolution = 2^-17)";
CM_ SG_ 132 VFC_Cloth03_CourseDeviation "Confidence measure quantifying a weighted deviation between course/path and the predicted lane";
CM_ SG_ 132 VFC_Cloth03_HeadingAngle "Heading angle, difference in yaw angle between vehicle heading and clothoid (resolution = 2^-11)";
CM_ SG_ 132 VFC_Cloth03_LineWidth "Width of the line";
CM_ SG_ 132 VFC_Cloth03_Type "Type of the Line";
CM_ SG_ 132 VFC_Cloth03_TypeProb "Confidence measure for Type classification";
CM_ SG_ 132 VFC_Cloth03_MeasureType "Indicates if clothoid was measured, interpolated or inferred (virtual line)";
CM_ SG_ 132 VFC_Cloth03_ColorClass "The color of the line";
CM_ SG_ 132 VFC_Cloth03_LineID "Number of the clothoid, indicating its position relative to the ego lane";
CM_ SG_ 133 VFC_Cloth04_CRC "CRC - Autosar E2E Profile 5";
CM_ SG_ 133 VFC_Cloth04_AliveCtr "Alive counter - Autosar E2E Profile 5";
CM_ SG_ 133 VFC_Cloth04_ProtBlockCtr "Protocol-Signal: Block-Counter";
CM_ SG_ 133 VFC_Cloth04_Conf "Confidence for this clothoid, probability that it describes the true lane boundary";
CM_ SG_ 133 VFC_Cloth04_DxEnd "Longitudinal range of the clothoid, also called LookAheadDistance";
CM_ SG_ 133 VFC_Cloth04_Dy "Lateral offset at x=0, also called LatDeviation (resolution = 2^-7)";
CM_ SG_ 133 VFC_Cloth04_DyStdDev "Standard deviation at x=0 of the lateral offset (resolution = 2^-7)";
CM_ SG_ 133 VFC_Cloth04_Curv "Curvature of the clothoid, also called kappa ";
CM_ SG_ 133 VFC_Cloth04_CurvChange "Curvature change or alteration of the clothoid, also called kappaDt (resolution = 2^-17)";
CM_ SG_ 133 VFC_Cloth04_CourseDeviation "Confidence measure quantifying a weighted deviation between course/path and the predicted lane";
CM_ SG_ 133 VFC_Cloth04_HeadingAngle "Heading angle, difference in yaw angle between vehicle heading and clothoid (resolution = 2^-11)";
CM_ SG_ 133 VFC_Cloth04_LineWidth "Width of the line";
CM_ SG_ 133 VFC_Cloth04_Type "Type of the Line";
CM_ SG_ 133 VFC_Cloth04_TypeProb "Confidence measure for Type classification";
CM_ SG_ 133 VFC_Cloth04_MeasureType "Indicates if clothoid was measured, interpolated or inferred (virtual line)";
CM_ SG_ 133 VFC_Cloth04_ColorClass "The color of the line";
CM_ SG_ 133 VFC_Cloth04_LineID "Number of the clothoid, indicating its position relative to the ego lane";
CM_ SG_ 134 VFC_Cloth05_CRC "CRC - Autosar E2E Profile 5";
CM_ SG_ 134 VFC_Cloth05_AliveCtr "Alive counter - Autosar E2E Profile 5";
CM_ SG_ 134 VFC_Cloth05_ProtBlockCtr "Protocol-Signal: Block-Counter";
CM_ SG_ 134 VFC_Cloth05_Conf "Confidence for this clothoid, probability that it describes the true lane boundary";
CM_ SG_ 134 VFC_Cloth05_DxEnd "Longitudinal range of the clothoid, also called LookAheadDistance";
CM_ SG_ 134 VFC_Cloth05_Dy "Lateral offset at x=0, also called LatDeviation (resolution = 2^-7)";
CM_ SG_ 134 VFC_Cloth05_DyStdDev "Standard deviation at x=0 of the lateral offset (resolution = 2^-7)";
CM_ SG_ 134 VFC_Cloth05_Curv "Curvature of the clothoid, also called kappa ";
CM_ SG_ 134 VFC_Cloth05_CurvChange "Curvature change or alteration of the clothoid, also called kappaDt (resolution = 2^-17)";
CM_ SG_ 134 VFC_Cloth05_CourseDeviation "Confidence measure quantifying a weighted deviation between course/path and the predicted lane";
CM_ SG_ 134 VFC_Cloth05_HeadingAngle "Heading angle, difference in yaw angle between vehicle heading and clothoid (resolution = 2^-11)";
CM_ SG_ 134 VFC_Cloth05_LineWidth "Width of the line";
CM_ SG_ 134 VFC_Cloth05_Type "Type of the Line";
CM_ SG_ 134 VFC_Cloth05_TypeProb "Confidence measure for Type classification";
CM_ SG_ 134 VFC_Cloth05_MeasureType "Indicates if clothoid was measured, interpolated or inferred (virtual line)";
CM_ SG_ 134 VFC_Cloth05_ColorClass "The color of the line";
CM_ SG_ 134 VFC_Cloth05_LineID "Number of the clothoid, indicating its position relative to the ego lane";
CM_ SG_ 135 VFC_Cloth06_CRC "CRC - Autosar E2E Profile 5";
CM_ SG_ 135 VFC_Cloth06_AliveCtr "Alive counter - Autosar E2E Profile 5";
CM_ SG_ 135 VFC_Cloth06_ProtBlockCtr "Protocol-Signal: Block-Counter";
CM_ SG_ 135 VFC_Cloth06_Conf "Confidence for this clothoid, probability that it describes the true lane boundary";
CM_ SG_ 135 VFC_Cloth06_DxEnd "Longitudinal range of the clothoid, also called LookAheadDistance";
CM_ SG_ 135 VFC_Cloth06_Dy "Lateral offset at x=0, also called LatDeviation (resolution = 2^-7)";
CM_ SG_ 135 VFC_Cloth06_DyStdDev "Standard deviation at x=0 of the lateral offset (resolution = 2^-7)";
CM_ SG_ 135 VFC_Cloth06_Curv "Curvature of the clothoid, also called kappa ";
CM_ SG_ 135 VFC_Cloth06_CurvChange "Curvature change or alteration of the clothoid, also called kappaDt (resolution = 2^-17)";
CM_ SG_ 135 VFC_Cloth06_CourseDeviation "Confidence measure quantifying a weighted deviation between course/path and the predicted lane";
CM_ SG_ 135 VFC_Cloth06_HeadingAngle "Heading angle, difference in yaw angle between vehicle heading and clothoid (resolution = 2^-11)";
CM_ SG_ 135 VFC_Cloth06_LineWidth "Width of the line";
CM_ SG_ 135 VFC_Cloth06_Type "Type of the Line";
CM_ SG_ 135 VFC_Cloth06_TypeProb "Confidence measure for Type classification";
CM_ SG_ 135 VFC_Cloth06_MeasureType "Indicates if clothoid was measured, interpolated or inferred (virtual line)";
CM_ SG_ 135 VFC_Cloth06_ColorClass "The color of the line";
CM_ SG_ 135 VFC_Cloth06_LineID "Number of the clothoid, indicating its position relative to the ego lane";
CM_ SG_ 136 VFC_Cloth07_CRC "CRC - Autosar E2E Profile 5";
CM_ SG_ 136 VFC_Cloth07_AliveCtr "Alive counter - Autosar E2E Profile 5";
CM_ SG_ 136 VFC_Cloth07_ProtBlockCtr "Protocol-Signal: Block-Counter";
CM_ SG_ 136 VFC_Cloth07_Conf "Confidence for this clothoid, probability that it describes the true lane boundary";
CM_ SG_ 136 VFC_Cloth07_DxEnd "Longitudinal range of the clothoid, also called LookAheadDistance";
CM_ SG_ 136 VFC_Cloth07_Dy "Lateral offset at x=0, also called LatDeviation (resolution = 2^-7)";
CM_ SG_ 136 VFC_Cloth07_DyStdDev "Standard deviation at x=0 of the lateral offset (resolution = 2^-7)";
CM_ SG_ 136 VFC_Cloth07_Curv "Curvature of the clothoid, also called kappa ";
CM_ SG_ 136 VFC_Cloth07_CurvChange "Curvature change or alteration of the clothoid, also called kappaDt (resolution = 2^-17)";
CM_ SG_ 136 VFC_Cloth07_CourseDeviation "Confidence measure quantifying a weighted deviation between course/path and the predicted lane";
CM_ SG_ 136 VFC_Cloth07_HeadingAngle "Heading angle, difference in yaw angle between vehicle heading and clothoid (resolution = 2^-11)";
CM_ SG_ 136 VFC_Cloth07_LineWidth "Width of the line";
CM_ SG_ 136 VFC_Cloth07_Type "Type of the Line";
CM_ SG_ 136 VFC_Cloth07_TypeProb "Confidence measure for Type classification";
CM_ SG_ 136 VFC_Cloth07_MeasureType "Indicates if clothoid was measured, interpolated or inferred (virtual line)";
CM_ SG_ 136 VFC_Cloth07_ColorClass "The color of the line";
CM_ SG_ 136 VFC_Cloth07_LineID "Number of the clothoid, indicating its position relative to the ego lane";
CM_ SG_ 272 RFC_DOPTraj_CRC "CRC - Autosar E2E Profile 5";
CM_ SG_ 272 RFC_DOPTraj_AliveCtr "Alive counter - Autosar E2E Profile 5 - Not Required for Demo";
CM_ SG_ 272 RFC_DOPTraj_Dy "refer to Dy in Line Msg";
CM_ SG_ 272 RFC_DOPTraj_HeadingAngle "refer to HeadingAngle in Line Msg";
CM_ SG_ 272 RFC_DOPTraj_Curvature "refer to Curvature in Line Msg";
CM_ SG_ 272 RFC_DOPTraj_CurvChange "refer to Curvature Change in Line Msg";
CM_ SG_ 272 RFC_DOPTraj_DxEnd "Start of the trajectory";
CM_ SG_ 272 RFC_DOPTraj_DxStart "End of the trajectory";
CM_ SG_ 272 RFC_DOPObjInfo_dxv_sw "represent the current DOP object dx";
CM_ SG_ 272 RFC_DOPObjInfo_dyv_sw "represent the current DOP object dy";
CM_ SG_ 272 RFC_DOPObjInfo_Handle_ub "represent the handle ID of the DOP Object";
CM_ SG_ 272 RFC_DOPObjInfo_vxv_sw "represent the current DOP relative object vx";
CM_ SG_ 272 RFC_DOPObjInfo_timestamp "time stamp for which the object data corresponds to";
CM_ SG_ 937 VFC_CtrlStopPunishFlag "if entered 3-times handsoff punishment now";
CM_ SG_ 937 VFC_CtrlStopActiveFlag "safe_stop control request";
BA_DEF_ BO_  "GenMsgSendType" ENUM  "cyclic","NoMsgSendType","IfActive","Event","CA","CE";
BA_DEF_ BO_  "GenMsgCycleTime" INT 0 0;
BA_DEF_ SG_  "GenSigSendType" ENUM  "cyclic","OnChange","OnWrite","IfActive","OnChangeWithRepetition","OnWriteWithRepetition","IfActiveWithRepetition","CA","CE","Event";
BA_DEF_ SG_  "GenSigStartValue" INT 0 0;
BA_DEF_ BO_  "CANFD_BRS" ENUM  "0","1";
BA_DEF_ BO_  "VFrameFormat" ENUM  "StandardCAN","ExtendedCAN","reserved","reserved","reserved","reserved","reserved","reserved","reserved","reserved","reserved","reserved","reserved","reserved","StandardCAN_FD","ExtendedCAN_FD";
BA_DEF_ BO_  "GenMsgILSupport" ENUM  "No","Yes";
BA_DEF_DEF_  "GenMsgSendType" "cyclic";
BA_DEF_DEF_  "GenMsgCycleTime" 0;
BA_DEF_DEF_  "GenSigSendType" "cyclic";
BA_DEF_DEF_  "GenSigStartValue" 0;
BA_DEF_DEF_  "CANFD_BRS" "1";
BA_DEF_DEF_  "VFrameFormat" "";
BA_DEF_DEF_  "GenMsgILSupport" "Yes";
BA_ "GenMsgSendType" BO_ 200 3;
BA_ "VFrameFormat" BO_ 200 14;
BA_ "GenMsgSendType" BO_ 202 3;
BA_ "VFrameFormat" BO_ 202 14;
BA_ "GenMsgSendType" BO_ 204 3;
BA_ "VFrameFormat" BO_ 204 14;
BA_ "GenMsgSendType" BO_ 206 3;
BA_ "VFrameFormat" BO_ 206 14;
BA_ "GenMsgSendType" BO_ 208 3;
BA_ "VFrameFormat" BO_ 208 14;
BA_ "GenMsgSendType" BO_ 210 3;
BA_ "VFrameFormat" BO_ 210 14;
BA_ "GenMsgSendType" BO_ 212 3;
BA_ "VFrameFormat" BO_ 212 14;
BA_ "GenMsgSendType" BO_ 214 3;
BA_ "VFrameFormat" BO_ 214 14;
BA_ "GenMsgSendType" BO_ 128 3;
BA_ "VFrameFormat" BO_ 128 14;
BA_ "GenMsgSendType" BO_ 129 3;
BA_ "VFrameFormat" BO_ 129 14;
BA_ "GenMsgSendType" BO_ 130 3;
BA_ "VFrameFormat" BO_ 130 14;
BA_ "GenMsgSendType" BO_ 131 3;
BA_ "VFrameFormat" BO_ 131 14;
BA_ "GenMsgSendType" BO_ 132 3;
BA_ "VFrameFormat" BO_ 132 14;
BA_ "GenMsgSendType" BO_ 133 3;
BA_ "VFrameFormat" BO_ 133 14;
BA_ "GenMsgSendType" BO_ 134 3;
BA_ "VFrameFormat" BO_ 134 14;
BA_ "GenMsgSendType" BO_ 135 3;
BA_ "VFrameFormat" BO_ 135 14;
BA_ "GenMsgSendType" BO_ 136 3;
BA_ "VFrameFormat" BO_ 136 14;
BA_ "GenMsgSendType" BO_ 272 3;
BA_ "VFrameFormat" BO_ 272 14;
BA_ "GenMsgCycleTime" BO_ 937 20;
BA_ "VFrameFormat" BO_ 937 14;
BA_ "GenMsgCycleTime" BO_ 936 20;
BA_ "VFrameFormat" BO_ 936 14;
BA_ "GenMsgCycleTime" BO_ 935 20;
BA_ "VFrameFormat" BO_ 935 14;
BA_ "GenMsgCycleTime" BO_ 934 20;
BA_ "VFrameFormat" BO_ 934 14;
BA_ "GenMsgCycleTime" BO_ 933 20;
BA_ "VFrameFormat" BO_ 933 14;
BA_ "GenMsgCycleTime" BO_ 932 20;
BA_ "VFrameFormat" BO_ 932 14;
BA_ "GenSigSendType" SG_ 200 VFC_Obj12A_CRC 9;
BA_ "GenSigSendType" SG_ 200 VFC_Obj12A_AliveCtr 9;
BA_ "GenSigSendType" SG_ 200 VFC_Obj12A_ProtBlockCtr 9;
BA_ "GenSigSendType" SG_ 200 VFC_Obj12A_ID 9;
BA_ "GenSigSendType" SG_ 200 VFC_Obj12A_Type 9;
BA_ "GenSigSendType" SG_ 200 VFC_Obj12A_TypeProb 9;
BA_ "GenSigSendType" SG_ 200 VFC_Obj12A_Dx 9;
BA_ "GenSigSendType" SG_ 200 VFC_Obj12A_Dy 9;
BA_ "GenSigStartValue" SG_ 200 VFC_Obj12A_Dy 8000;
BA_ "GenSigSendType" SG_ 200 VFC_Obj12A_Vx 9;
BA_ "GenSigStartValue" SG_ 200 VFC_Obj12A_Vx 1540;
BA_ "GenSigSendType" SG_ 200 VFC_Obj12A_Vy 9;
BA_ "GenSigStartValue" SG_ 200 VFC_Obj12A_Vy 500;
BA_ "GenSigSendType" SG_ 200 VFC_Obj12A_Ax 9;
BA_ "GenSigStartValue" SG_ 200 VFC_Obj12A_Ax 160;
BA_ "GenSigSendType" SG_ 200 VFC_Obj12A_Ay 9;
BA_ "GenSigStartValue" SG_ 200 VFC_Obj12A_Ay 120;
BA_ "GenSigSendType" SG_ 200 VFC_Obj12A_DxStdDev 9;
BA_ "GenSigSendType" SG_ 200 VFC_Obj12A_DyStdDev 9;
BA_ "GenSigSendType" SG_ 200 VFC_Obj12A_VxStdDev 9;
BA_ "GenSigSendType" SG_ 200 VFC_Obj12A_VyStdDev 9;
BA_ "GenSigSendType" SG_ 200 VFC_Obj12A_AxStdDev 9;
BA_ "GenSigSendType" SG_ 200 VFC_Obj12A_AyStdDev 9;
BA_ "GenSigSendType" SG_ 200 VFC_Obj12A_Length 9;
BA_ "GenSigSendType" SG_ 200 VFC_Obj12A_Width 9;
BA_ "GenSigSendType" SG_ 200 VFC_Obj12A_Height 9;
BA_ "GenSigSendType" SG_ 200 VFC_Obj12A_LengthStdDev 9;
BA_ "GenSigSendType" SG_ 200 VFC_Obj12A_WidthStdDev 9;
BA_ "GenSigSendType" SG_ 200 VFC_Obj12A_HeightStdDev 9;
BA_ "GenSigSendType" SG_ 200 VFC_Obj12A_EdgeLeft 9;
BA_ "GenSigStartValue" SG_ 200 VFC_Obj12A_EdgeLeft 4000;
BA_ "GenSigSendType" SG_ 200 VFC_Obj12A_EdgeMid 9;
BA_ "GenSigStartValue" SG_ 200 VFC_Obj12A_EdgeMid 4000;
BA_ "GenSigSendType" SG_ 200 VFC_Obj12A_EdgeRight 9;
BA_ "GenSigStartValue" SG_ 200 VFC_Obj12A_EdgeRight 4000;
BA_ "GenSigSendType" SG_ 200 VFC_Obj12A_EdgeTop 9;
BA_ "GenSigStartValue" SG_ 200 VFC_Obj12A_EdgeTop 2000;
BA_ "GenSigSendType" SG_ 200 VFC_Obj12A_EdgeBottom 9;
BA_ "GenSigStartValue" SG_ 200 VFC_Obj12A_EdgeBottom 2000;
BA_ "GenSigSendType" SG_ 200 VFC_Obj12A_EdgeLeftStdDev 9;
BA_ "GenSigSendType" SG_ 200 VFC_Obj12A_EdgeMidStdDev 9;
BA_ "GenSigSendType" SG_ 200 VFC_Obj12A_EdgeRightStdDev 9;
BA_ "GenSigSendType" SG_ 200 VFC_Obj12A_EdgeTopStdDev 9;
BA_ "GenSigSendType" SG_ 200 VFC_Obj12A_EdgeBottomStdDev 9;
BA_ "GenSigSendType" SG_ 200 VFC_Obj12A_NormVx 9;
BA_ "GenSigStartValue" SG_ 200 VFC_Obj12A_NormVx 40000;
BA_ "GenSigSendType" SG_ 200 VFC_Obj12A_NormAx 9;
BA_ "GenSigStartValue" SG_ 200 VFC_Obj12A_NormAx 5000;
BA_ "GenSigSendType" SG_ 200 VFC_Obj12A_NormVyEdgeLeft 9;
BA_ "GenSigStartValue" SG_ 200 VFC_Obj12A_NormVyEdgeLeft 4000;
BA_ "GenSigSendType" SG_ 200 VFC_Obj12A_NormVyEdgeRight 9;
BA_ "GenSigStartValue" SG_ 200 VFC_Obj12A_NormVyEdgeRight 4000;
BA_ "GenSigSendType" SG_ 200 VFC_Obj12A_NormVxStdDev 9;
BA_ "GenSigSendType" SG_ 200 VFC_Obj12A_NormAxStdDev 9;
BA_ "GenSigSendType" SG_ 200 VFC_Obj12A_NormVyEdgeLeftStdDev 9;
BA_ "GenSigSendType" SG_ 200 VFC_Obj12A_NormVyEdgeRightStdDev 9;
BA_ "GenSigSendType" SG_ 200 VFC_Obj12A_ScaleChange 9;
BA_ "GenSigSendType" SG_ 200 VFC_Obj12A_ScaleChngStdDev 9;
BA_ "GenSigSendType" SG_ 200 VFC_Obj12A_HeadingAngle 9;
BA_ "GenSigStartValue" SG_ 200 VFC_Obj12A_HeadingAngle 157;
BA_ "GenSigSendType" SG_ 200 VFC_Obj12A_HeadingAngleStdDev 9;
BA_ "GenSigSendType" SG_ 200 VFC_Obj12A_HeadOrientation 9;
BA_ "GenSigSendType" SG_ 200 VFC_Obj12A_CompletelyInImg 9;
BA_ "GenSigSendType" SG_ 200 VFC_Obj12A_ProbMovingLat 9;
BA_ "GenSigSendType" SG_ 200 VFC_Obj12A_ProbMovingLong 9;
BA_ "GenSigSendType" SG_ 200 VFC_Obj12A_ProbExist 9;
BA_ "GenSigSendType" SG_ 200 VFC_Obj12A_MeasSource 9;
BA_ "GenSigSendType" SG_ 200 VFC_Obj12A_Reliability 9;
BA_ "GenSigSendType" SG_ 200 VFC_Obj12A_Measured 9;
BA_ "GenSigSendType" SG_ 200 VFC_Obj12A_VisibleView 9;
BA_ "GenSigSendType" SG_ 200 VFC_Obj12A_ClassifiedView 9;
BA_ "GenSigSendType" SG_ 200 VFC_Obj12A_DirIndicator 9;
BA_ "GenSigSendType" SG_ 200 VFC_Obj12A_BrakeLight 9;
BA_ "GenSigSendType" SG_ 202 VFC_Obj13A_CRC 9;
BA_ "GenSigSendType" SG_ 202 VFC_Obj13A_AliveCtr 9;
BA_ "GenSigSendType" SG_ 202 VFC_Obj13A_ProtBlockCtr 9;
BA_ "GenSigSendType" SG_ 202 VFC_Obj13A_ID 9;
BA_ "GenSigSendType" SG_ 202 VFC_Obj13A_Type 9;
BA_ "GenSigSendType" SG_ 202 VFC_Obj13A_TypeProb 9;
BA_ "GenSigSendType" SG_ 202 VFC_Obj13A_Dx 9;
BA_ "GenSigSendType" SG_ 202 VFC_Obj13A_Dy 9;
BA_ "GenSigStartValue" SG_ 202 VFC_Obj13A_Dy 8000;
BA_ "GenSigSendType" SG_ 202 VFC_Obj13A_Vx 9;
BA_ "GenSigStartValue" SG_ 202 VFC_Obj13A_Vx 1540;
BA_ "GenSigSendType" SG_ 202 VFC_Obj13A_Vy 9;
BA_ "GenSigStartValue" SG_ 202 VFC_Obj13A_Vy 500;
BA_ "GenSigSendType" SG_ 202 VFC_Obj13A_Ax 9;
BA_ "GenSigStartValue" SG_ 202 VFC_Obj13A_Ax 160;
BA_ "GenSigSendType" SG_ 202 VFC_Obj13A_Ay 9;
BA_ "GenSigStartValue" SG_ 202 VFC_Obj13A_Ay 120;
BA_ "GenSigSendType" SG_ 202 VFC_Obj13A_DxStdDev 9;
BA_ "GenSigSendType" SG_ 202 VFC_Obj13A_DyStdDev 9;
BA_ "GenSigSendType" SG_ 202 VFC_Obj13A_VxStdDev 9;
BA_ "GenSigSendType" SG_ 202 VFC_Obj13A_VyStdDev 9;
BA_ "GenSigSendType" SG_ 202 VFC_Obj13A_AxStdDev 9;
BA_ "GenSigSendType" SG_ 202 VFC_Obj13A_AyStdDev 9;
BA_ "GenSigSendType" SG_ 202 VFC_Obj13A_Length 9;
BA_ "GenSigSendType" SG_ 202 VFC_Obj13A_Width 9;
BA_ "GenSigSendType" SG_ 202 VFC_Obj13A_Height 9;
BA_ "GenSigSendType" SG_ 202 VFC_Obj13A_LengthStdDev 9;
BA_ "GenSigSendType" SG_ 202 VFC_Obj13A_WidthStdDev 9;
BA_ "GenSigSendType" SG_ 202 VFC_Obj13A_HeightStdDev 9;
BA_ "GenSigSendType" SG_ 202 VFC_Obj13A_EdgeLeft 9;
BA_ "GenSigStartValue" SG_ 202 VFC_Obj13A_EdgeLeft 4000;
BA_ "GenSigSendType" SG_ 202 VFC_Obj13A_EdgeMid 9;
BA_ "GenSigStartValue" SG_ 202 VFC_Obj13A_EdgeMid 4000;
BA_ "GenSigSendType" SG_ 202 VFC_Obj13A_EdgeRight 9;
BA_ "GenSigStartValue" SG_ 202 VFC_Obj13A_EdgeRight 4000;
BA_ "GenSigSendType" SG_ 202 VFC_Obj13A_EdgeTop 9;
BA_ "GenSigStartValue" SG_ 202 VFC_Obj13A_EdgeTop 2000;
BA_ "GenSigSendType" SG_ 202 VFC_Obj13A_EdgeBottom 9;
BA_ "GenSigStartValue" SG_ 202 VFC_Obj13A_EdgeBottom 2000;
BA_ "GenSigSendType" SG_ 202 VFC_Obj13A_EdgeLeftStdDev 9;
BA_ "GenSigSendType" SG_ 202 VFC_Obj13A_EdgeMidStdDev 9;
BA_ "GenSigSendType" SG_ 202 VFC_Obj13A_EdgeRightStdDev 9;
BA_ "GenSigSendType" SG_ 202 VFC_Obj13A_EdgeTopStdDev 9;
BA_ "GenSigSendType" SG_ 202 VFC_Obj13A_EdgeBottomStdDev 9;
BA_ "GenSigSendType" SG_ 202 VFC_Obj13A_NormVx 9;
BA_ "GenSigStartValue" SG_ 202 VFC_Obj13A_NormVx 40000;
BA_ "GenSigSendType" SG_ 202 VFC_Obj13A_NormAx 9;
BA_ "GenSigStartValue" SG_ 202 VFC_Obj13A_NormAx 5000;
BA_ "GenSigSendType" SG_ 202 VFC_Obj13A_NormVyEdgeLeft 9;
BA_ "GenSigStartValue" SG_ 202 VFC_Obj13A_NormVyEdgeLeft 4000;
BA_ "GenSigSendType" SG_ 202 VFC_Obj13A_NormVyEdgeRight 9;
BA_ "GenSigStartValue" SG_ 202 VFC_Obj13A_NormVyEdgeRight 4000;
BA_ "GenSigSendType" SG_ 202 VFC_Obj13A_NormVxStdDev 9;
BA_ "GenSigSendType" SG_ 202 VFC_Obj13A_NormAxStdDev 9;
BA_ "GenSigSendType" SG_ 202 VFC_Obj13A_NormVyEdgeLeftStdDev 9;
BA_ "GenSigSendType" SG_ 202 VFC_Obj13A_NormVyEdgeRightStdDev 9;
BA_ "GenSigSendType" SG_ 202 VFC_Obj13A_ScaleChange 9;
BA_ "GenSigSendType" SG_ 202 VFC_Obj13A_ScaleChngStdDev 9;
BA_ "GenSigSendType" SG_ 202 VFC_Obj13A_HeadingAngle 9;
BA_ "GenSigStartValue" SG_ 202 VFC_Obj13A_HeadingAngle 157;
BA_ "GenSigSendType" SG_ 202 VFC_Obj13A_HeadingAngleStdDev 9;
BA_ "GenSigSendType" SG_ 202 VFC_Obj13A_HeadOrientation 9;
BA_ "GenSigSendType" SG_ 202 VFC_Obj13A_CompletelyInImg 9;
BA_ "GenSigSendType" SG_ 202 VFC_Obj13A_ProbMovingLat 9;
BA_ "GenSigSendType" SG_ 202 VFC_Obj13A_ProbMovingLong 9;
BA_ "GenSigSendType" SG_ 202 VFC_Obj13A_ProbExist 9;
BA_ "GenSigSendType" SG_ 202 VFC_Obj13A_MeasSource 9;
BA_ "GenSigSendType" SG_ 202 VFC_Obj13A_Reliability 9;
BA_ "GenSigSendType" SG_ 202 VFC_Obj13A_Measured 9;
BA_ "GenSigSendType" SG_ 202 VFC_Obj13A_VisibleView 9;
BA_ "GenSigSendType" SG_ 202 VFC_Obj13A_ClassifiedView 9;
BA_ "GenSigSendType" SG_ 202 VFC_Obj13A_DirIndicator 9;
BA_ "GenSigSendType" SG_ 202 VFC_Obj13A_BrakeLight 9;
BA_ "GenSigSendType" SG_ 204 VFC_Obj14A_CRC 9;
BA_ "GenSigSendType" SG_ 204 VFC_Obj14A_AliveCtr 9;
BA_ "GenSigSendType" SG_ 204 VFC_Obj14A_ProtBlockCtr 9;
BA_ "GenSigSendType" SG_ 204 VFC_Obj14A_ID 9;
BA_ "GenSigSendType" SG_ 204 VFC_Obj14A_Type 9;
BA_ "GenSigSendType" SG_ 204 VFC_Obj14A_TypeProb 9;
BA_ "GenSigSendType" SG_ 204 VFC_Obj14A_Dx 9;
BA_ "GenSigSendType" SG_ 204 VFC_Obj14A_Dy 9;
BA_ "GenSigStartValue" SG_ 204 VFC_Obj14A_Dy 8000;
BA_ "GenSigSendType" SG_ 204 VFC_Obj14A_Vx 9;
BA_ "GenSigStartValue" SG_ 204 VFC_Obj14A_Vx 1540;
BA_ "GenSigSendType" SG_ 204 VFC_Obj14A_Vy 9;
BA_ "GenSigStartValue" SG_ 204 VFC_Obj14A_Vy 500;
BA_ "GenSigSendType" SG_ 204 VFC_Obj14A_Ax 9;
BA_ "GenSigStartValue" SG_ 204 VFC_Obj14A_Ax 160;
BA_ "GenSigSendType" SG_ 204 VFC_Obj14A_Ay 9;
BA_ "GenSigStartValue" SG_ 204 VFC_Obj14A_Ay 120;
BA_ "GenSigSendType" SG_ 204 VFC_Obj14A_DxStdDev 9;
BA_ "GenSigSendType" SG_ 204 VFC_Obj14A_DyStdDev 9;
BA_ "GenSigSendType" SG_ 204 VFC_Obj14A_VxStdDev 9;
BA_ "GenSigSendType" SG_ 204 VFC_Obj14A_VyStdDev 9;
BA_ "GenSigSendType" SG_ 204 VFC_Obj14A_AxStdDev 9;
BA_ "GenSigSendType" SG_ 204 VFC_Obj14A_AyStdDev 9;
BA_ "GenSigSendType" SG_ 204 VFC_Obj14A_Length 9;
BA_ "GenSigSendType" SG_ 204 VFC_Obj14A_Width 9;
BA_ "GenSigSendType" SG_ 204 VFC_Obj14A_Height 9;
BA_ "GenSigSendType" SG_ 204 VFC_Obj14A_LengthStdDev 9;
BA_ "GenSigSendType" SG_ 204 VFC_Obj14A_WidthStdDev 9;
BA_ "GenSigSendType" SG_ 204 VFC_Obj14A_HeightStdDev 9;
BA_ "GenSigSendType" SG_ 204 VFC_Obj14A_EdgeLeft 9;
BA_ "GenSigStartValue" SG_ 204 VFC_Obj14A_EdgeLeft 4000;
BA_ "GenSigSendType" SG_ 204 VFC_Obj14A_EdgeMid 9;
BA_ "GenSigStartValue" SG_ 204 VFC_Obj14A_EdgeMid 4000;
BA_ "GenSigSendType" SG_ 204 VFC_Obj14A_EdgeRight 9;
BA_ "GenSigStartValue" SG_ 204 VFC_Obj14A_EdgeRight 4000;
BA_ "GenSigSendType" SG_ 204 VFC_Obj14A_EdgeTop 9;
BA_ "GenSigStartValue" SG_ 204 VFC_Obj14A_EdgeTop 2000;
BA_ "GenSigSendType" SG_ 204 VFC_Obj14A_EdgeBottom 9;
BA_ "GenSigStartValue" SG_ 204 VFC_Obj14A_EdgeBottom 2000;
BA_ "GenSigSendType" SG_ 204 VFC_Obj14A_EdgeLeftStdDev 9;
BA_ "GenSigSendType" SG_ 204 VFC_Obj14A_EdgeMidStdDev 9;
BA_ "GenSigSendType" SG_ 204 VFC_Obj14A_EdgeRightStdDev 9;
BA_ "GenSigSendType" SG_ 204 VFC_Obj14A_EdgeTopStdDev 9;
BA_ "GenSigSendType" SG_ 204 VFC_Obj14A_EdgeBottomStdDev 9;
BA_ "GenSigSendType" SG_ 204 VFC_Obj14A_NormVx 9;
BA_ "GenSigStartValue" SG_ 204 VFC_Obj14A_NormVx 40000;
BA_ "GenSigSendType" SG_ 204 VFC_Obj14A_NormAx 9;
BA_ "GenSigStartValue" SG_ 204 VFC_Obj14A_NormAx 5000;
BA_ "GenSigSendType" SG_ 204 VFC_Obj14A_NormVyEdgeLeft 9;
BA_ "GenSigStartValue" SG_ 204 VFC_Obj14A_NormVyEdgeLeft 4000;
BA_ "GenSigSendType" SG_ 204 VFC_Obj14A_NormVyEdgeRight 9;
BA_ "GenSigStartValue" SG_ 204 VFC_Obj14A_NormVyEdgeRight 4000;
BA_ "GenSigSendType" SG_ 204 VFC_Obj14A_NormVxStdDev 9;
BA_ "GenSigSendType" SG_ 204 VFC_Obj14A_NormAxStdDev 9;
BA_ "GenSigSendType" SG_ 204 VFC_Obj14A_NormVyEdgeLeftStdDev 9;
BA_ "GenSigSendType" SG_ 204 VFC_Obj14A_NormVyEdgeRightStdDev 9;
BA_ "GenSigSendType" SG_ 204 VFC_Obj14A_ScaleChange 9;
BA_ "GenSigSendType" SG_ 204 VFC_Obj14A_ScaleChngStdDev 9;
BA_ "GenSigSendType" SG_ 204 VFC_Obj14A_HeadingAngle 9;
BA_ "GenSigStartValue" SG_ 204 VFC_Obj14A_HeadingAngle 157;
BA_ "GenSigSendType" SG_ 204 VFC_Obj14A_HeadingAngleStdDev 9;
BA_ "GenSigSendType" SG_ 204 VFC_Obj14A_HeadOrientation 9;
BA_ "GenSigSendType" SG_ 204 VFC_Obj14A_CompletelyInImg 9;
BA_ "GenSigSendType" SG_ 204 VFC_Obj14A_ProbMovingLat 9;
BA_ "GenSigSendType" SG_ 204 VFC_Obj14A_ProbMovingLong 9;
BA_ "GenSigSendType" SG_ 204 VFC_Obj14A_ProbExist 9;
BA_ "GenSigSendType" SG_ 204 VFC_Obj14A_MeasSource 9;
BA_ "GenSigSendType" SG_ 204 VFC_Obj14A_Reliability 9;
BA_ "GenSigSendType" SG_ 204 VFC_Obj14A_Measured 9;
BA_ "GenSigSendType" SG_ 204 VFC_Obj14A_VisibleView 9;
BA_ "GenSigSendType" SG_ 204 VFC_Obj14A_ClassifiedView 9;
BA_ "GenSigSendType" SG_ 204 VFC_Obj14A_DirIndicator 9;
BA_ "GenSigSendType" SG_ 204 VFC_Obj14A_BrakeLight 9;
BA_ "GenSigSendType" SG_ 206 VFC_Obj15A_CRC 9;
BA_ "GenSigSendType" SG_ 206 VFC_Obj15A_AliveCtr 9;
BA_ "GenSigSendType" SG_ 206 VFC_Obj15A_ProtBlockCtr 9;
BA_ "GenSigSendType" SG_ 206 VFC_Obj15A_ID 9;
BA_ "GenSigSendType" SG_ 206 VFC_Obj15A_Type 9;
BA_ "GenSigSendType" SG_ 206 VFC_Obj15A_TypeProb 9;
BA_ "GenSigSendType" SG_ 206 VFC_Obj15A_Dx 9;
BA_ "GenSigSendType" SG_ 206 VFC_Obj15A_Dy 9;
BA_ "GenSigStartValue" SG_ 206 VFC_Obj15A_Dy 8000;
BA_ "GenSigSendType" SG_ 206 VFC_Obj15A_Vx 9;
BA_ "GenSigStartValue" SG_ 206 VFC_Obj15A_Vx 1540;
BA_ "GenSigSendType" SG_ 206 VFC_Obj15A_Vy 9;
BA_ "GenSigStartValue" SG_ 206 VFC_Obj15A_Vy 500;
BA_ "GenSigSendType" SG_ 206 VFC_Obj15A_Ax 9;
BA_ "GenSigStartValue" SG_ 206 VFC_Obj15A_Ax 160;
BA_ "GenSigSendType" SG_ 206 VFC_Obj15A_Ay 9;
BA_ "GenSigStartValue" SG_ 206 VFC_Obj15A_Ay 120;
BA_ "GenSigSendType" SG_ 206 VFC_Obj15A_DxStdDev 9;
BA_ "GenSigSendType" SG_ 206 VFC_Obj15A_DyStdDev 9;
BA_ "GenSigSendType" SG_ 206 VFC_Obj15A_VxStdDev 9;
BA_ "GenSigSendType" SG_ 206 VFC_Obj15A_VyStdDev 9;
BA_ "GenSigSendType" SG_ 206 VFC_Obj15A_AxStdDev 9;
BA_ "GenSigSendType" SG_ 206 VFC_Obj15A_AyStdDev 9;
BA_ "GenSigSendType" SG_ 206 VFC_Obj15A_Length 9;
BA_ "GenSigSendType" SG_ 206 VFC_Obj15A_Width 9;
BA_ "GenSigSendType" SG_ 206 VFC_Obj15A_Height 9;
BA_ "GenSigSendType" SG_ 206 VFC_Obj15A_LengthStdDev 9;
BA_ "GenSigSendType" SG_ 206 VFC_Obj15A_WidthStdDev 9;
BA_ "GenSigSendType" SG_ 206 VFC_Obj15A_HeightStdDev 9;
BA_ "GenSigSendType" SG_ 206 VFC_Obj15A_EdgeLeft 9;
BA_ "GenSigStartValue" SG_ 206 VFC_Obj15A_EdgeLeft 4000;
BA_ "GenSigSendType" SG_ 206 VFC_Obj15A_EdgeMid 9;
BA_ "GenSigStartValue" SG_ 206 VFC_Obj15A_EdgeMid 4000;
BA_ "GenSigSendType" SG_ 206 VFC_Obj15A_EdgeRight 9;
BA_ "GenSigStartValue" SG_ 206 VFC_Obj15A_EdgeRight 4000;
BA_ "GenSigSendType" SG_ 206 VFC_Obj15A_EdgeTop 9;
BA_ "GenSigStartValue" SG_ 206 VFC_Obj15A_EdgeTop 2000;
BA_ "GenSigSendType" SG_ 206 VFC_Obj15A_EdgeBottom 9;
BA_ "GenSigStartValue" SG_ 206 VFC_Obj15A_EdgeBottom 2000;
BA_ "GenSigSendType" SG_ 206 VFC_Obj15A_EdgeLeftStdDev 9;
BA_ "GenSigSendType" SG_ 206 VFC_Obj15A_EdgeMidStdDev 9;
BA_ "GenSigSendType" SG_ 206 VFC_Obj15A_EdgeRightStdDev 9;
BA_ "GenSigSendType" SG_ 206 VFC_Obj15A_EdgeTopStdDev 9;
BA_ "GenSigSendType" SG_ 206 VFC_Obj15A_EdgeBottomStdDev 9;
BA_ "GenSigSendType" SG_ 206 VFC_Obj15A_NormVx 9;
BA_ "GenSigStartValue" SG_ 206 VFC_Obj15A_NormVx 40000;
BA_ "GenSigSendType" SG_ 206 VFC_Obj15A_NormAx 9;
BA_ "GenSigStartValue" SG_ 206 VFC_Obj15A_NormAx 5000;
BA_ "GenSigSendType" SG_ 206 VFC_Obj15A_NormVyEdgeLeft 9;
BA_ "GenSigStartValue" SG_ 206 VFC_Obj15A_NormVyEdgeLeft 4000;
BA_ "GenSigSendType" SG_ 206 VFC_Obj15A_NormVyEdgeRight 9;
BA_ "GenSigStartValue" SG_ 206 VFC_Obj15A_NormVyEdgeRight 4000;
BA_ "GenSigSendType" SG_ 206 VFC_Obj15A_NormVxStdDev 9;
BA_ "GenSigSendType" SG_ 206 VFC_Obj15A_NormAxStdDev 9;
BA_ "GenSigSendType" SG_ 206 VFC_Obj15A_NormVyEdgeLeftStdDev 9;
BA_ "GenSigSendType" SG_ 206 VFC_Obj15A_NormVyEdgeRightStdDev 9;
BA_ "GenSigSendType" SG_ 206 VFC_Obj15A_ScaleChange 9;
BA_ "GenSigSendType" SG_ 206 VFC_Obj15A_ScaleChngStdDev 9;
BA_ "GenSigSendType" SG_ 206 VFC_Obj15A_HeadingAngle 9;
BA_ "GenSigStartValue" SG_ 206 VFC_Obj15A_HeadingAngle 157;
BA_ "GenSigSendType" SG_ 206 VFC_Obj15A_HeadingAngleStdDev 9;
BA_ "GenSigSendType" SG_ 206 VFC_Obj15A_HeadOrientation 9;
BA_ "GenSigSendType" SG_ 206 VFC_Obj15A_CompletelyInImg 9;
BA_ "GenSigSendType" SG_ 206 VFC_Obj15A_ProbMovingLat 9;
BA_ "GenSigSendType" SG_ 206 VFC_Obj15A_ProbMovingLong 9;
BA_ "GenSigSendType" SG_ 206 VFC_Obj15A_ProbExist 9;
BA_ "GenSigSendType" SG_ 206 VFC_Obj15A_MeasSource 9;
BA_ "GenSigSendType" SG_ 206 VFC_Obj15A_Reliability 9;
BA_ "GenSigSendType" SG_ 206 VFC_Obj15A_Measured 9;
BA_ "GenSigSendType" SG_ 206 VFC_Obj15A_VisibleView 9;
BA_ "GenSigSendType" SG_ 206 VFC_Obj15A_ClassifiedView 9;
BA_ "GenSigSendType" SG_ 206 VFC_Obj15A_DirIndicator 9;
BA_ "GenSigSendType" SG_ 206 VFC_Obj15A_BrakeLight 9;
BA_ "GenSigSendType" SG_ 208 VFC_Obj16A_CRC 9;
BA_ "GenSigSendType" SG_ 208 VFC_Obj16A_AliveCtr 9;
BA_ "GenSigSendType" SG_ 208 VFC_Obj16A_ProtBlockCtr 9;
BA_ "GenSigSendType" SG_ 208 VFC_Obj16A_ID 9;
BA_ "GenSigSendType" SG_ 208 VFC_Obj16A_Type 9;
BA_ "GenSigSendType" SG_ 208 VFC_Obj16A_TypeProb 9;
BA_ "GenSigSendType" SG_ 208 VFC_Obj16A_Dx 9;
BA_ "GenSigSendType" SG_ 208 VFC_Obj16A_Dy 9;
BA_ "GenSigStartValue" SG_ 208 VFC_Obj16A_Dy 8000;
BA_ "GenSigSendType" SG_ 208 VFC_Obj16A_Vx 9;
BA_ "GenSigStartValue" SG_ 208 VFC_Obj16A_Vx 1540;
BA_ "GenSigSendType" SG_ 208 VFC_Obj16A_Vy 9;
BA_ "GenSigStartValue" SG_ 208 VFC_Obj16A_Vy 500;
BA_ "GenSigSendType" SG_ 208 VFC_Obj16A_Ax 9;
BA_ "GenSigStartValue" SG_ 208 VFC_Obj16A_Ax 160;
BA_ "GenSigSendType" SG_ 208 VFC_Obj16A_Ay 9;
BA_ "GenSigStartValue" SG_ 208 VFC_Obj16A_Ay 120;
BA_ "GenSigSendType" SG_ 208 VFC_Obj16A_DxStdDev 9;
BA_ "GenSigSendType" SG_ 208 VFC_Obj16A_DyStdDev 9;
BA_ "GenSigSendType" SG_ 208 VFC_Obj16A_VxStdDev 9;
BA_ "GenSigSendType" SG_ 208 VFC_Obj16A_VyStdDev 9;
BA_ "GenSigSendType" SG_ 208 VFC_Obj16A_AxStdDev 9;
BA_ "GenSigSendType" SG_ 208 VFC_Obj16A_AyStdDev 9;
BA_ "GenSigSendType" SG_ 208 VFC_Obj16A_Length 9;
BA_ "GenSigSendType" SG_ 208 VFC_Obj16A_Width 9;
BA_ "GenSigSendType" SG_ 208 VFC_Obj16A_Height 9;
BA_ "GenSigSendType" SG_ 208 VFC_Obj16A_LengthStdDev 9;
BA_ "GenSigSendType" SG_ 208 VFC_Obj16A_WidthStdDev 9;
BA_ "GenSigSendType" SG_ 208 VFC_Obj16A_HeightStdDev 9;
BA_ "GenSigSendType" SG_ 208 VFC_Obj16A_EdgeLeft 9;
BA_ "GenSigStartValue" SG_ 208 VFC_Obj16A_EdgeLeft 4000;
BA_ "GenSigSendType" SG_ 208 VFC_Obj16A_EdgeMid 9;
BA_ "GenSigStartValue" SG_ 208 VFC_Obj16A_EdgeMid 4000;
BA_ "GenSigSendType" SG_ 208 VFC_Obj16A_EdgeRight 9;
BA_ "GenSigStartValue" SG_ 208 VFC_Obj16A_EdgeRight 4000;
BA_ "GenSigSendType" SG_ 208 VFC_Obj16A_EdgeTop 9;
BA_ "GenSigStartValue" SG_ 208 VFC_Obj16A_EdgeTop 2000;
BA_ "GenSigSendType" SG_ 208 VFC_Obj16A_EdgeBottom 9;
BA_ "GenSigStartValue" SG_ 208 VFC_Obj16A_EdgeBottom 2000;
BA_ "GenSigSendType" SG_ 208 VFC_Obj16A_EdgeLeftStdDev 9;
BA_ "GenSigSendType" SG_ 208 VFC_Obj16A_EdgeMidStdDev 9;
BA_ "GenSigSendType" SG_ 208 VFC_Obj16A_EdgeRightStdDev 9;
BA_ "GenSigSendType" SG_ 208 VFC_Obj16A_EdgeTopStdDev 9;
BA_ "GenSigSendType" SG_ 208 VFC_Obj16A_EdgeBottomStdDev 9;
BA_ "GenSigSendType" SG_ 208 VFC_Obj16A_NormVx 9;
BA_ "GenSigStartValue" SG_ 208 VFC_Obj16A_NormVx 40000;
BA_ "GenSigSendType" SG_ 208 VFC_Obj16A_NormAx 9;
BA_ "GenSigStartValue" SG_ 208 VFC_Obj16A_NormAx 5000;
BA_ "GenSigSendType" SG_ 208 VFC_Obj16A_NormVyEdgeLeft 9;
BA_ "GenSigStartValue" SG_ 208 VFC_Obj16A_NormVyEdgeLeft 4000;
BA_ "GenSigSendType" SG_ 208 VFC_Obj16A_NormVyEdgeRight 9;
BA_ "GenSigStartValue" SG_ 208 VFC_Obj16A_NormVyEdgeRight 4000;
BA_ "GenSigSendType" SG_ 208 VFC_Obj16A_NormVxStdDev 9;
BA_ "GenSigSendType" SG_ 208 VFC_Obj16A_NormAxStdDev 9;
BA_ "GenSigSendType" SG_ 208 VFC_Obj16A_NormVyEdgeLeftStdDev 9;
BA_ "GenSigSendType" SG_ 208 VFC_Obj16A_NormVyEdgeRightStdDev 9;
BA_ "GenSigSendType" SG_ 208 VFC_Obj16A_ScaleChange 9;
BA_ "GenSigSendType" SG_ 208 VFC_Obj16A_ScaleChngStdDev 9;
BA_ "GenSigSendType" SG_ 208 VFC_Obj16A_HeadingAngle 9;
BA_ "GenSigStartValue" SG_ 208 VFC_Obj16A_HeadingAngle 157;
BA_ "GenSigSendType" SG_ 208 VFC_Obj16A_HeadingAngleStdDev 9;
BA_ "GenSigSendType" SG_ 208 VFC_Obj16A_HeadOrientation 9;
BA_ "GenSigSendType" SG_ 208 VFC_Obj16A_CompletelyInImg 9;
BA_ "GenSigSendType" SG_ 208 VFC_Obj16A_ProbMovingLat 9;
BA_ "GenSigSendType" SG_ 208 VFC_Obj16A_ProbMovingLong 9;
BA_ "GenSigSendType" SG_ 208 VFC_Obj16A_ProbExist 9;
BA_ "GenSigSendType" SG_ 208 VFC_Obj16A_MeasSource 9;
BA_ "GenSigSendType" SG_ 208 VFC_Obj16A_Reliability 9;
BA_ "GenSigSendType" SG_ 208 VFC_Obj16A_Measured 9;
BA_ "GenSigSendType" SG_ 208 VFC_Obj16A_VisibleView 9;
BA_ "GenSigSendType" SG_ 208 VFC_Obj16A_ClassifiedView 9;
BA_ "GenSigSendType" SG_ 208 VFC_Obj16A_DirIndicator 9;
BA_ "GenSigSendType" SG_ 208 VFC_Obj16A_BrakeLight 9;
BA_ "GenSigSendType" SG_ 210 VFC_Obj17A_CRC 9;
BA_ "GenSigSendType" SG_ 210 VFC_Obj17A_AliveCtr 9;
BA_ "GenSigSendType" SG_ 210 VFC_Obj17A_ProtBlockCtr 9;
BA_ "GenSigSendType" SG_ 210 VFC_Obj17A_ID 9;
BA_ "GenSigSendType" SG_ 210 VFC_Obj17A_Type 9;
BA_ "GenSigSendType" SG_ 210 VFC_Obj17A_TypeProb 9;
BA_ "GenSigSendType" SG_ 210 VFC_Obj17A_Dx 9;
BA_ "GenSigSendType" SG_ 210 VFC_Obj17A_Dy 9;
BA_ "GenSigStartValue" SG_ 210 VFC_Obj17A_Dy 8000;
BA_ "GenSigSendType" SG_ 210 VFC_Obj17A_Vx 9;
BA_ "GenSigStartValue" SG_ 210 VFC_Obj17A_Vx 1540;
BA_ "GenSigSendType" SG_ 210 VFC_Obj17A_Vy 9;
BA_ "GenSigStartValue" SG_ 210 VFC_Obj17A_Vy 500;
BA_ "GenSigSendType" SG_ 210 VFC_Obj17A_Ax 9;
BA_ "GenSigStartValue" SG_ 210 VFC_Obj17A_Ax 160;
BA_ "GenSigSendType" SG_ 210 VFC_Obj17A_Ay 9;
BA_ "GenSigStartValue" SG_ 210 VFC_Obj17A_Ay 120;
BA_ "GenSigSendType" SG_ 210 VFC_Obj17A_DxStdDev 9;
BA_ "GenSigSendType" SG_ 210 VFC_Obj17A_DyStdDev 9;
BA_ "GenSigSendType" SG_ 210 VFC_Obj17A_VxStdDev 9;
BA_ "GenSigSendType" SG_ 210 VFC_Obj17A_VyStdDev 9;
BA_ "GenSigSendType" SG_ 210 VFC_Obj17A_AxStdDev 9;
BA_ "GenSigSendType" SG_ 210 VFC_Obj17A_AyStdDev 9;
BA_ "GenSigSendType" SG_ 210 VFC_Obj17A_Length 9;
BA_ "GenSigSendType" SG_ 210 VFC_Obj17A_Width 9;
BA_ "GenSigSendType" SG_ 210 VFC_Obj17A_Height 9;
BA_ "GenSigSendType" SG_ 210 VFC_Obj17A_LengthStdDev 9;
BA_ "GenSigSendType" SG_ 210 VFC_Obj17A_WidthStdDev 9;
BA_ "GenSigSendType" SG_ 210 VFC_Obj17A_HeightStdDev 9;
BA_ "GenSigSendType" SG_ 210 VFC_Obj17A_EdgeLeft 9;
BA_ "GenSigStartValue" SG_ 210 VFC_Obj17A_EdgeLeft 4000;
BA_ "GenSigSendType" SG_ 210 VFC_Obj17A_EdgeMid 9;
BA_ "GenSigStartValue" SG_ 210 VFC_Obj17A_EdgeMid 4000;
BA_ "GenSigSendType" SG_ 210 VFC_Obj17A_EdgeRight 9;
BA_ "GenSigStartValue" SG_ 210 VFC_Obj17A_EdgeRight 4000;
BA_ "GenSigSendType" SG_ 210 VFC_Obj17A_EdgeTop 9;
BA_ "GenSigStartValue" SG_ 210 VFC_Obj17A_EdgeTop 2000;
BA_ "GenSigSendType" SG_ 210 VFC_Obj17A_EdgeBottom 9;
BA_ "GenSigStartValue" SG_ 210 VFC_Obj17A_EdgeBottom 2000;
BA_ "GenSigSendType" SG_ 210 VFC_Obj17A_EdgeLeftStdDev 9;
BA_ "GenSigSendType" SG_ 210 VFC_Obj17A_EdgeMidStdDev 9;
BA_ "GenSigSendType" SG_ 210 VFC_Obj17A_EdgeRightStdDev 9;
BA_ "GenSigSendType" SG_ 210 VFC_Obj17A_EdgeTopStdDev 9;
BA_ "GenSigSendType" SG_ 210 VFC_Obj17A_EdgeBottomStdDev 9;
BA_ "GenSigSendType" SG_ 210 VFC_Obj17A_NormVx 9;
BA_ "GenSigStartValue" SG_ 210 VFC_Obj17A_NormVx 40000;
BA_ "GenSigSendType" SG_ 210 VFC_Obj17A_NormAx 9;
BA_ "GenSigStartValue" SG_ 210 VFC_Obj17A_NormAx 5000;
BA_ "GenSigSendType" SG_ 210 VFC_Obj17A_NormVyEdgeLeft 9;
BA_ "GenSigStartValue" SG_ 210 VFC_Obj17A_NormVyEdgeLeft 4000;
BA_ "GenSigSendType" SG_ 210 VFC_Obj17A_NormVyEdgeRight 9;
BA_ "GenSigStartValue" SG_ 210 VFC_Obj17A_NormVyEdgeRight 4000;
BA_ "GenSigSendType" SG_ 210 VFC_Obj17A_NormVxStdDev 9;
BA_ "GenSigSendType" SG_ 210 VFC_Obj17A_NormAxStdDev 9;
BA_ "GenSigSendType" SG_ 210 VFC_Obj17A_NormVyEdgeLeftStdDev 9;
BA_ "GenSigSendType" SG_ 210 VFC_Obj17A_NormVyEdgeRightStdDev 9;
BA_ "GenSigSendType" SG_ 210 VFC_Obj17A_ScaleChange 9;
BA_ "GenSigSendType" SG_ 210 VFC_Obj17A_ScaleChngStdDev 9;
BA_ "GenSigSendType" SG_ 210 VFC_Obj17A_HeadingAngle 9;
BA_ "GenSigStartValue" SG_ 210 VFC_Obj17A_HeadingAngle 157;
BA_ "GenSigSendType" SG_ 210 VFC_Obj17A_HeadingAngleStdDev 9;
BA_ "GenSigSendType" SG_ 210 VFC_Obj17A_HeadOrientation 9;
BA_ "GenSigSendType" SG_ 210 VFC_Obj17A_CompletelyInImg 9;
BA_ "GenSigSendType" SG_ 210 VFC_Obj17A_ProbMovingLat 9;
BA_ "GenSigSendType" SG_ 210 VFC_Obj17A_ProbMovingLong 9;
BA_ "GenSigSendType" SG_ 210 VFC_Obj17A_ProbExist 9;
BA_ "GenSigSendType" SG_ 210 VFC_Obj17A_MeasSource 9;
BA_ "GenSigSendType" SG_ 210 VFC_Obj17A_Reliability 9;
BA_ "GenSigSendType" SG_ 210 VFC_Obj17A_Measured 9;
BA_ "GenSigSendType" SG_ 210 VFC_Obj17A_VisibleView 9;
BA_ "GenSigSendType" SG_ 210 VFC_Obj17A_ClassifiedView 9;
BA_ "GenSigSendType" SG_ 210 VFC_Obj17A_DirIndicator 9;
BA_ "GenSigSendType" SG_ 210 VFC_Obj17A_BrakeLight 9;
BA_ "GenSigSendType" SG_ 212 VFC_Obj18A_CRC 9;
BA_ "GenSigSendType" SG_ 212 VFC_Obj18A_AliveCtr 9;
BA_ "GenSigSendType" SG_ 212 VFC_Obj18A_ProtBlockCtr 9;
BA_ "GenSigSendType" SG_ 212 VFC_Obj18A_ID 9;
BA_ "GenSigSendType" SG_ 212 VFC_Obj18A_Type 9;
BA_ "GenSigSendType" SG_ 212 VFC_Obj18A_TypeProb 9;
BA_ "GenSigSendType" SG_ 212 VFC_Obj18A_Dx 9;
BA_ "GenSigSendType" SG_ 212 VFC_Obj18A_Dy 9;
BA_ "GenSigStartValue" SG_ 212 VFC_Obj18A_Dy 8000;
BA_ "GenSigSendType" SG_ 212 VFC_Obj18A_Vx 9;
BA_ "GenSigStartValue" SG_ 212 VFC_Obj18A_Vx 1540;
BA_ "GenSigSendType" SG_ 212 VFC_Obj18A_Vy 9;
BA_ "GenSigStartValue" SG_ 212 VFC_Obj18A_Vy 500;
BA_ "GenSigSendType" SG_ 212 VFC_Obj18A_Ax 9;
BA_ "GenSigStartValue" SG_ 212 VFC_Obj18A_Ax 160;
BA_ "GenSigSendType" SG_ 212 VFC_Obj18A_Ay 9;
BA_ "GenSigStartValue" SG_ 212 VFC_Obj18A_Ay 120;
BA_ "GenSigSendType" SG_ 212 VFC_Obj18A_DxStdDev 9;
BA_ "GenSigSendType" SG_ 212 VFC_Obj18A_DyStdDev 9;
BA_ "GenSigSendType" SG_ 212 VFC_Obj18A_VxStdDev 9;
BA_ "GenSigSendType" SG_ 212 VFC_Obj18A_VyStdDev 9;
BA_ "GenSigSendType" SG_ 212 VFC_Obj18A_AxStdDev 9;
BA_ "GenSigSendType" SG_ 212 VFC_Obj18A_AyStdDev 9;
BA_ "GenSigSendType" SG_ 212 VFC_Obj18A_Length 9;
BA_ "GenSigSendType" SG_ 212 VFC_Obj18A_Width 9;
BA_ "GenSigSendType" SG_ 212 VFC_Obj18A_Height 9;
BA_ "GenSigSendType" SG_ 212 VFC_Obj18A_LengthStdDev 9;
BA_ "GenSigSendType" SG_ 212 VFC_Obj18A_WidthStdDev 9;
BA_ "GenSigSendType" SG_ 212 VFC_Obj18A_HeightStdDev 9;
BA_ "GenSigSendType" SG_ 212 VFC_Obj18A_EdgeLeft 9;
BA_ "GenSigStartValue" SG_ 212 VFC_Obj18A_EdgeLeft 4000;
BA_ "GenSigSendType" SG_ 212 VFC_Obj18A_EdgeMid 9;
BA_ "GenSigStartValue" SG_ 212 VFC_Obj18A_EdgeMid 4000;
BA_ "GenSigSendType" SG_ 212 VFC_Obj18A_EdgeRight 9;
BA_ "GenSigStartValue" SG_ 212 VFC_Obj18A_EdgeRight 4000;
BA_ "GenSigSendType" SG_ 212 VFC_Obj18A_EdgeTop 9;
BA_ "GenSigStartValue" SG_ 212 VFC_Obj18A_EdgeTop 2000;
BA_ "GenSigSendType" SG_ 212 VFC_Obj18A_EdgeBottom 9;
BA_ "GenSigStartValue" SG_ 212 VFC_Obj18A_EdgeBottom 2000;
BA_ "GenSigSendType" SG_ 212 VFC_Obj18A_EdgeLeftStdDev 9;
BA_ "GenSigSendType" SG_ 212 VFC_Obj18A_EdgeMidStdDev 9;
BA_ "GenSigSendType" SG_ 212 VFC_Obj18A_EdgeRightStdDev 9;
BA_ "GenSigSendType" SG_ 212 VFC_Obj18A_EdgeTopStdDev 9;
BA_ "GenSigSendType" SG_ 212 VFC_Obj18A_EdgeBottomStdDev 9;
BA_ "GenSigSendType" SG_ 212 VFC_Obj18A_NormVx 9;
BA_ "GenSigStartValue" SG_ 212 VFC_Obj18A_NormVx 40000;
BA_ "GenSigSendType" SG_ 212 VFC_Obj18A_NormAx 9;
BA_ "GenSigStartValue" SG_ 212 VFC_Obj18A_NormAx 5000;
BA_ "GenSigSendType" SG_ 212 VFC_Obj18A_NormVyEdgeLeft 9;
BA_ "GenSigStartValue" SG_ 212 VFC_Obj18A_NormVyEdgeLeft 4000;
BA_ "GenSigSendType" SG_ 212 VFC_Obj18A_NormVyEdgeRight 9;
BA_ "GenSigStartValue" SG_ 212 VFC_Obj18A_NormVyEdgeRight 4000;
BA_ "GenSigSendType" SG_ 212 VFC_Obj18A_NormVxStdDev 9;
BA_ "GenSigSendType" SG_ 212 VFC_Obj18A_NormAxStdDev 9;
BA_ "GenSigSendType" SG_ 212 VFC_Obj18A_NormVyEdgeLeftStdDev 9;
BA_ "GenSigSendType" SG_ 212 VFC_Obj18A_NormVyEdgeRightStdDev 9;
BA_ "GenSigSendType" SG_ 212 VFC_Obj18A_ScaleChange 9;
BA_ "GenSigSendType" SG_ 212 VFC_Obj18A_ScaleChngStdDev 9;
BA_ "GenSigSendType" SG_ 212 VFC_Obj18A_HeadingAngle 9;
BA_ "GenSigStartValue" SG_ 212 VFC_Obj18A_HeadingAngle 157;
BA_ "GenSigSendType" SG_ 212 VFC_Obj18A_HeadingAngleStdDev 9;
BA_ "GenSigSendType" SG_ 212 VFC_Obj18A_HeadOrientation 9;
BA_ "GenSigSendType" SG_ 212 VFC_Obj18A_CompletelyInImg 9;
BA_ "GenSigSendType" SG_ 212 VFC_Obj18A_ProbMovingLat 9;
BA_ "GenSigSendType" SG_ 212 VFC_Obj18A_ProbMovingLong 9;
BA_ "GenSigSendType" SG_ 212 VFC_Obj18A_ProbExist 9;
BA_ "GenSigSendType" SG_ 212 VFC_Obj18A_MeasSource 9;
BA_ "GenSigSendType" SG_ 212 VFC_Obj18A_Reliability 9;
BA_ "GenSigSendType" SG_ 212 VFC_Obj18A_Measured 9;
BA_ "GenSigSendType" SG_ 212 VFC_Obj18A_VisibleView 9;
BA_ "GenSigSendType" SG_ 212 VFC_Obj18A_ClassifiedView 9;
BA_ "GenSigSendType" SG_ 212 VFC_Obj18A_DirIndicator 9;
BA_ "GenSigSendType" SG_ 212 VFC_Obj18A_BrakeLight 9;
BA_ "GenSigSendType" SG_ 214 VFC_Obj19A_CRC 9;
BA_ "GenSigSendType" SG_ 214 VFC_Obj19A_AliveCtr 9;
BA_ "GenSigSendType" SG_ 214 VFC_Obj19A_ProtBlockCtr 9;
BA_ "GenSigSendType" SG_ 214 VFC_Obj19A_ID 9;
BA_ "GenSigSendType" SG_ 214 VFC_Obj19A_Type 9;
BA_ "GenSigSendType" SG_ 214 VFC_Obj19A_TypeProb 9;
BA_ "GenSigSendType" SG_ 214 VFC_Obj19A_Dx 9;
BA_ "GenSigSendType" SG_ 214 VFC_Obj19A_Dy 9;
BA_ "GenSigStartValue" SG_ 214 VFC_Obj19A_Dy 8000;
BA_ "GenSigSendType" SG_ 214 VFC_Obj19A_Vx 9;
BA_ "GenSigStartValue" SG_ 214 VFC_Obj19A_Vx 1540;
BA_ "GenSigSendType" SG_ 214 VFC_Obj19A_Vy 9;
BA_ "GenSigStartValue" SG_ 214 VFC_Obj19A_Vy 500;
BA_ "GenSigSendType" SG_ 214 VFC_Obj19A_Ax 9;
BA_ "GenSigStartValue" SG_ 214 VFC_Obj19A_Ax 160;
BA_ "GenSigSendType" SG_ 214 VFC_Obj19A_Ay 9;
BA_ "GenSigStartValue" SG_ 214 VFC_Obj19A_Ay 120;
BA_ "GenSigSendType" SG_ 214 VFC_Obj19A_DxStdDev 9;
BA_ "GenSigSendType" SG_ 214 VFC_Obj19A_DyStdDev 9;
BA_ "GenSigSendType" SG_ 214 VFC_Obj19A_VxStdDev 9;
BA_ "GenSigSendType" SG_ 214 VFC_Obj19A_VyStdDev 9;
BA_ "GenSigSendType" SG_ 214 VFC_Obj19A_AxStdDev 9;
BA_ "GenSigSendType" SG_ 214 VFC_Obj19A_AyStdDev 9;
BA_ "GenSigSendType" SG_ 214 VFC_Obj19A_Length 9;
BA_ "GenSigSendType" SG_ 214 VFC_Obj19A_Width 9;
BA_ "GenSigSendType" SG_ 214 VFC_Obj19A_Height 9;
BA_ "GenSigSendType" SG_ 214 VFC_Obj19A_LengthStdDev 9;
BA_ "GenSigSendType" SG_ 214 VFC_Obj19A_WidthStdDev 9;
BA_ "GenSigSendType" SG_ 214 VFC_Obj19A_HeightStdDev 9;
BA_ "GenSigSendType" SG_ 214 VFC_Obj19A_EdgeLeft 9;
BA_ "GenSigStartValue" SG_ 214 VFC_Obj19A_EdgeLeft 4000;
BA_ "GenSigSendType" SG_ 214 VFC_Obj19A_EdgeMid 9;
BA_ "GenSigStartValue" SG_ 214 VFC_Obj19A_EdgeMid 4000;
BA_ "GenSigSendType" SG_ 214 VFC_Obj19A_EdgeRight 9;
BA_ "GenSigStartValue" SG_ 214 VFC_Obj19A_EdgeRight 4000;
BA_ "GenSigSendType" SG_ 214 VFC_Obj19A_EdgeTop 9;
BA_ "GenSigStartValue" SG_ 214 VFC_Obj19A_EdgeTop 2000;
BA_ "GenSigSendType" SG_ 214 VFC_Obj19A_EdgeBottom 9;
BA_ "GenSigStartValue" SG_ 214 VFC_Obj19A_EdgeBottom 2000;
BA_ "GenSigSendType" SG_ 214 VFC_Obj19A_EdgeLeftStdDev 9;
BA_ "GenSigSendType" SG_ 214 VFC_Obj19A_EdgeMidStdDev 9;
BA_ "GenSigSendType" SG_ 214 VFC_Obj19A_EdgeRightStdDev 9;
BA_ "GenSigSendType" SG_ 214 VFC_Obj19A_EdgeTopStdDev 9;
BA_ "GenSigSendType" SG_ 214 VFC_Obj19A_EdgeBottomStdDev 9;
BA_ "GenSigSendType" SG_ 214 VFC_Obj19A_NormVx 9;
BA_ "GenSigStartValue" SG_ 214 VFC_Obj19A_NormVx 40000;
BA_ "GenSigSendType" SG_ 214 VFC_Obj19A_NormAx 9;
BA_ "GenSigStartValue" SG_ 214 VFC_Obj19A_NormAx 5000;
BA_ "GenSigSendType" SG_ 214 VFC_Obj19A_NormVyEdgeLeft 9;
BA_ "GenSigStartValue" SG_ 214 VFC_Obj19A_NormVyEdgeLeft 4000;
BA_ "GenSigSendType" SG_ 214 VFC_Obj19A_NormVyEdgeRight 9;
BA_ "GenSigStartValue" SG_ 214 VFC_Obj19A_NormVyEdgeRight 4000;
BA_ "GenSigSendType" SG_ 214 VFC_Obj19A_NormVxStdDev 9;
BA_ "GenSigSendType" SG_ 214 VFC_Obj19A_NormAxStdDev 9;
BA_ "GenSigSendType" SG_ 214 VFC_Obj19A_NormVyEdgeLeftStdDev 9;
BA_ "GenSigSendType" SG_ 214 VFC_Obj19A_NormVyEdgeRightStdDev 9;
BA_ "GenSigSendType" SG_ 214 VFC_Obj19A_ScaleChange 9;
BA_ "GenSigSendType" SG_ 214 VFC_Obj19A_ScaleChngStdDev 9;
BA_ "GenSigSendType" SG_ 214 VFC_Obj19A_HeadingAngle 9;
BA_ "GenSigStartValue" SG_ 214 VFC_Obj19A_HeadingAngle 157;
BA_ "GenSigSendType" SG_ 214 VFC_Obj19A_HeadingAngleStdDev 9;
BA_ "GenSigSendType" SG_ 214 VFC_Obj19A_HeadOrientation 9;
BA_ "GenSigSendType" SG_ 214 VFC_Obj19A_CompletelyInImg 9;
BA_ "GenSigSendType" SG_ 214 VFC_Obj19A_ProbMovingLat 9;
BA_ "GenSigSendType" SG_ 214 VFC_Obj19A_ProbMovingLong 9;
BA_ "GenSigSendType" SG_ 214 VFC_Obj19A_ProbExist 9;
BA_ "GenSigSendType" SG_ 214 VFC_Obj19A_MeasSource 9;
BA_ "GenSigSendType" SG_ 214 VFC_Obj19A_Reliability 9;
BA_ "GenSigSendType" SG_ 214 VFC_Obj19A_Measured 9;
BA_ "GenSigSendType" SG_ 214 VFC_Obj19A_VisibleView 9;
BA_ "GenSigSendType" SG_ 214 VFC_Obj19A_ClassifiedView 9;
BA_ "GenSigSendType" SG_ 214 VFC_Obj19A_DirIndicator 9;
BA_ "GenSigSendType" SG_ 214 VFC_Obj19A_BrakeLight 9;
BA_ "GenSigSendType" SG_ 128 VFC_LaneHdr_CRC 9;
BA_ "GenSigSendType" SG_ 128 VFC_LaneHdr_AliveCtr 9;
BA_ "GenSigSendType" SG_ 128 VFC_LaneHdr_ProtBlockCtr 9;
BA_ "GenSigSendType" SG_ 128 VFC_LaneHdr_ProtSegCount 9;
BA_ "GenSigSendType" SG_ 128 VFC_LaneHdr_ProtPointCount 9;
BA_ "GenSigSendType" SG_ 128 VFC_LaneHdr_ProtClothCount 9;
BA_ "GenSigSendType" SG_ 128 VFC_LaneHdr_TimeStamp 9;
BA_ "GenSigSendType" SG_ 128 VFC_LaneHdr_State 9;
BA_ "GenSigSendType" SG_ 128 VFC_LaneHdr_TimeLatency 9;
BA_ "GenSigSendType" SG_ 129 VFC_Cloth00_CRC 9;
BA_ "GenSigSendType" SG_ 129 VFC_Cloth00_AliveCtr 9;
BA_ "GenSigSendType" SG_ 129 VFC_Cloth00_ProtBlockCtr 9;
BA_ "GenSigSendType" SG_ 129 VFC_Cloth00_Conf 9;
BA_ "GenSigSendType" SG_ 129 VFC_Cloth00_DxEnd 9;
BA_ "GenSigSendType" SG_ 129 VFC_Cloth00_Dy 9;
BA_ "GenSigStartValue" SG_ 129 VFC_Cloth00_Dy 2048;
BA_ "GenSigSendType" SG_ 129 VFC_Cloth00_DyStdDev 9;
BA_ "GenSigSendType" SG_ 129 VFC_Cloth00_Curv 9;
BA_ "GenSigStartValue" SG_ 129 VFC_Cloth00_Curv 2048;
BA_ "GenSigSendType" SG_ 129 VFC_Cloth00_CurvChange 9;
BA_ "GenSigStartValue" SG_ 129 VFC_Cloth00_CurvChange 2048;
BA_ "GenSigSendType" SG_ 129 VFC_Cloth00_CourseDeviation 9;
BA_ "GenSigSendType" SG_ 129 VFC_Cloth00_HeadingAngle 9;
BA_ "GenSigStartValue" SG_ 129 VFC_Cloth00_HeadingAngle 2048;
BA_ "GenSigSendType" SG_ 129 VFC_Cloth00_LineWidth 9;
BA_ "GenSigSendType" SG_ 129 VFC_Cloth00_Type 9;
BA_ "GenSigSendType" SG_ 129 VFC_Cloth00_TypeProb 9;
BA_ "GenSigSendType" SG_ 129 VFC_Cloth00_MeasureType 9;
BA_ "GenSigSendType" SG_ 129 VFC_Cloth00_ColorClass 9;
BA_ "GenSigSendType" SG_ 129 VFC_Cloth00_LineID 9;
BA_ "GenSigSendType" SG_ 130 VFC_Cloth01_CRC 9;
BA_ "GenSigSendType" SG_ 130 VFC_Cloth01_AliveCtr 9;
BA_ "GenSigSendType" SG_ 130 VFC_Cloth01_ProtBlockCtr 9;
BA_ "GenSigSendType" SG_ 130 VFC_Cloth01_Conf 9;
BA_ "GenSigSendType" SG_ 130 VFC_Cloth01_DxEnd 9;
BA_ "GenSigSendType" SG_ 130 VFC_Cloth01_Dy 9;
BA_ "GenSigStartValue" SG_ 130 VFC_Cloth01_Dy 2048;
BA_ "GenSigSendType" SG_ 130 VFC_Cloth01_DyStdDev 9;
BA_ "GenSigSendType" SG_ 130 VFC_Cloth01_Curv 9;
BA_ "GenSigStartValue" SG_ 130 VFC_Cloth01_Curv 2048;
BA_ "GenSigSendType" SG_ 130 VFC_Cloth01_CurvChange 9;
BA_ "GenSigStartValue" SG_ 130 VFC_Cloth01_CurvChange 2048;
BA_ "GenSigSendType" SG_ 130 VFC_Cloth01_CourseDeviation 9;
BA_ "GenSigSendType" SG_ 130 VFC_Cloth01_HeadingAngle 9;
BA_ "GenSigStartValue" SG_ 130 VFC_Cloth01_HeadingAngle 2048;
BA_ "GenSigSendType" SG_ 130 VFC_Cloth01_LineWidth 9;
BA_ "GenSigSendType" SG_ 130 VFC_Cloth01_Type 9;
BA_ "GenSigSendType" SG_ 130 VFC_Cloth01_TypeProb 9;
BA_ "GenSigSendType" SG_ 130 VFC_Cloth01_MeasureType 9;
BA_ "GenSigSendType" SG_ 130 VFC_Cloth01_ColorClass 9;
BA_ "GenSigSendType" SG_ 130 VFC_Cloth01_LineID 9;
BA_ "GenSigSendType" SG_ 131 VFC_Cloth02_CRC 9;
BA_ "GenSigSendType" SG_ 131 VFC_Cloth02_AliveCtr 9;
BA_ "GenSigSendType" SG_ 131 VFC_Cloth02_ProtBlockCtr 9;
BA_ "GenSigSendType" SG_ 131 VFC_Cloth02_Conf 9;
BA_ "GenSigSendType" SG_ 131 VFC_Cloth02_DxEnd 9;
BA_ "GenSigSendType" SG_ 131 VFC_Cloth02_Dy 9;
BA_ "GenSigStartValue" SG_ 131 VFC_Cloth02_Dy 2048;
BA_ "GenSigSendType" SG_ 131 VFC_Cloth02_DyStdDev 9;
BA_ "GenSigSendType" SG_ 131 VFC_Cloth02_Curv 9;
BA_ "GenSigStartValue" SG_ 131 VFC_Cloth02_Curv 2048;
BA_ "GenSigSendType" SG_ 131 VFC_Cloth02_CurvChange 9;
BA_ "GenSigStartValue" SG_ 131 VFC_Cloth02_CurvChange 2048;
BA_ "GenSigSendType" SG_ 131 VFC_Cloth02_CourseDeviation 9;
BA_ "GenSigSendType" SG_ 131 VFC_Cloth02_HeadingAngle 9;
BA_ "GenSigStartValue" SG_ 131 VFC_Cloth02_HeadingAngle 2048;
BA_ "GenSigSendType" SG_ 131 VFC_Cloth02_LineWidth 9;
BA_ "GenSigSendType" SG_ 131 VFC_Cloth02_Type 9;
BA_ "GenSigSendType" SG_ 131 VFC_Cloth02_TypeProb 9;
BA_ "GenSigSendType" SG_ 131 VFC_Cloth02_MeasureType 9;
BA_ "GenSigSendType" SG_ 131 VFC_Cloth02_ColorClass 9;
BA_ "GenSigSendType" SG_ 131 VFC_Cloth02_LineID 9;
BA_ "GenSigSendType" SG_ 132 VFC_Cloth03_CRC 9;
BA_ "GenSigSendType" SG_ 132 VFC_Cloth03_AliveCtr 9;
BA_ "GenSigSendType" SG_ 132 VFC_Cloth03_ProtBlockCtr 9;
BA_ "GenSigSendType" SG_ 132 VFC_Cloth03_Conf 9;
BA_ "GenSigSendType" SG_ 132 VFC_Cloth03_DxEnd 9;
BA_ "GenSigSendType" SG_ 132 VFC_Cloth03_Dy 9;
BA_ "GenSigStartValue" SG_ 132 VFC_Cloth03_Dy 2048;
BA_ "GenSigSendType" SG_ 132 VFC_Cloth03_DyStdDev 9;
BA_ "GenSigSendType" SG_ 132 VFC_Cloth03_Curv 9;
BA_ "GenSigStartValue" SG_ 132 VFC_Cloth03_Curv 2048;
BA_ "GenSigSendType" SG_ 132 VFC_Cloth03_CurvChange 9;
BA_ "GenSigStartValue" SG_ 132 VFC_Cloth03_CurvChange 2048;
BA_ "GenSigSendType" SG_ 132 VFC_Cloth03_CourseDeviation 9;
BA_ "GenSigSendType" SG_ 132 VFC_Cloth03_HeadingAngle 9;
BA_ "GenSigStartValue" SG_ 132 VFC_Cloth03_HeadingAngle 2048;
BA_ "GenSigSendType" SG_ 132 VFC_Cloth03_LineWidth 9;
BA_ "GenSigSendType" SG_ 132 VFC_Cloth03_Type 9;
BA_ "GenSigSendType" SG_ 132 VFC_Cloth03_TypeProb 9;
BA_ "GenSigSendType" SG_ 132 VFC_Cloth03_MeasureType 9;
BA_ "GenSigSendType" SG_ 132 VFC_Cloth03_ColorClass 9;
BA_ "GenSigSendType" SG_ 132 VFC_Cloth03_LineID 9;
BA_ "GenSigSendType" SG_ 133 VFC_Cloth04_CRC 9;
BA_ "GenSigSendType" SG_ 133 VFC_Cloth04_AliveCtr 9;
BA_ "GenSigSendType" SG_ 133 VFC_Cloth04_ProtBlockCtr 9;
BA_ "GenSigSendType" SG_ 133 VFC_Cloth04_Conf 9;
BA_ "GenSigSendType" SG_ 133 VFC_Cloth04_DxEnd 9;
BA_ "GenSigSendType" SG_ 133 VFC_Cloth04_Dy 9;
BA_ "GenSigStartValue" SG_ 133 VFC_Cloth04_Dy 2048;
BA_ "GenSigSendType" SG_ 133 VFC_Cloth04_DyStdDev 9;
BA_ "GenSigSendType" SG_ 133 VFC_Cloth04_Curv 9;
BA_ "GenSigStartValue" SG_ 133 VFC_Cloth04_Curv 2048;
BA_ "GenSigSendType" SG_ 133 VFC_Cloth04_CurvChange 9;
BA_ "GenSigStartValue" SG_ 133 VFC_Cloth04_CurvChange 2048;
BA_ "GenSigSendType" SG_ 133 VFC_Cloth04_CourseDeviation 9;
BA_ "GenSigSendType" SG_ 133 VFC_Cloth04_HeadingAngle 9;
BA_ "GenSigStartValue" SG_ 133 VFC_Cloth04_HeadingAngle 2048;
BA_ "GenSigSendType" SG_ 133 VFC_Cloth04_LineWidth 9;
BA_ "GenSigSendType" SG_ 133 VFC_Cloth04_Type 9;
BA_ "GenSigSendType" SG_ 133 VFC_Cloth04_TypeProb 9;
BA_ "GenSigSendType" SG_ 133 VFC_Cloth04_MeasureType 9;
BA_ "GenSigSendType" SG_ 133 VFC_Cloth04_ColorClass 9;
BA_ "GenSigSendType" SG_ 133 VFC_Cloth04_LineID 9;
BA_ "GenSigSendType" SG_ 134 VFC_Cloth05_CRC 9;
BA_ "GenSigSendType" SG_ 134 VFC_Cloth05_AliveCtr 9;
BA_ "GenSigSendType" SG_ 134 VFC_Cloth05_ProtBlockCtr 9;
BA_ "GenSigSendType" SG_ 134 VFC_Cloth05_Conf 9;
BA_ "GenSigSendType" SG_ 134 VFC_Cloth05_DxEnd 9;
BA_ "GenSigSendType" SG_ 134 VFC_Cloth05_Dy 9;
BA_ "GenSigStartValue" SG_ 134 VFC_Cloth05_Dy 2048;
BA_ "GenSigSendType" SG_ 134 VFC_Cloth05_DyStdDev 9;
BA_ "GenSigSendType" SG_ 134 VFC_Cloth05_Curv 9;
BA_ "GenSigStartValue" SG_ 134 VFC_Cloth05_Curv 2048;
BA_ "GenSigSendType" SG_ 134 VFC_Cloth05_CurvChange 9;
BA_ "GenSigStartValue" SG_ 134 VFC_Cloth05_CurvChange 2048;
BA_ "GenSigSendType" SG_ 134 VFC_Cloth05_CourseDeviation 9;
BA_ "GenSigSendType" SG_ 134 VFC_Cloth05_HeadingAngle 9;
BA_ "GenSigStartValue" SG_ 134 VFC_Cloth05_HeadingAngle 2048;
BA_ "GenSigSendType" SG_ 134 VFC_Cloth05_LineWidth 9;
BA_ "GenSigSendType" SG_ 134 VFC_Cloth05_Type 9;
BA_ "GenSigSendType" SG_ 134 VFC_Cloth05_TypeProb 9;
BA_ "GenSigSendType" SG_ 134 VFC_Cloth05_MeasureType 9;
BA_ "GenSigSendType" SG_ 134 VFC_Cloth05_ColorClass 9;
BA_ "GenSigSendType" SG_ 134 VFC_Cloth05_LineID 9;
BA_ "GenSigSendType" SG_ 135 VFC_Cloth06_CRC 9;
BA_ "GenSigSendType" SG_ 135 VFC_Cloth06_AliveCtr 9;
BA_ "GenSigSendType" SG_ 135 VFC_Cloth06_ProtBlockCtr 9;
BA_ "GenSigSendType" SG_ 135 VFC_Cloth06_Conf 9;
BA_ "GenSigSendType" SG_ 135 VFC_Cloth06_DxEnd 9;
BA_ "GenSigSendType" SG_ 135 VFC_Cloth06_Dy 9;
BA_ "GenSigStartValue" SG_ 135 VFC_Cloth06_Dy 2048;
BA_ "GenSigSendType" SG_ 135 VFC_Cloth06_DyStdDev 9;
BA_ "GenSigSendType" SG_ 135 VFC_Cloth06_Curv 9;
BA_ "GenSigStartValue" SG_ 135 VFC_Cloth06_Curv 2048;
BA_ "GenSigSendType" SG_ 135 VFC_Cloth06_CurvChange 9;
BA_ "GenSigStartValue" SG_ 135 VFC_Cloth06_CurvChange 2048;
BA_ "GenSigSendType" SG_ 135 VFC_Cloth06_CourseDeviation 9;
BA_ "GenSigSendType" SG_ 135 VFC_Cloth06_HeadingAngle 9;
BA_ "GenSigStartValue" SG_ 135 VFC_Cloth06_HeadingAngle 2048;
BA_ "GenSigSendType" SG_ 135 VFC_Cloth06_LineWidth 9;
BA_ "GenSigSendType" SG_ 135 VFC_Cloth06_Type 9;
BA_ "GenSigSendType" SG_ 135 VFC_Cloth06_TypeProb 9;
BA_ "GenSigSendType" SG_ 135 VFC_Cloth06_MeasureType 9;
BA_ "GenSigSendType" SG_ 135 VFC_Cloth06_ColorClass 9;
BA_ "GenSigSendType" SG_ 135 VFC_Cloth06_LineID 9;
BA_ "GenSigSendType" SG_ 136 VFC_Cloth07_CRC 9;
BA_ "GenSigSendType" SG_ 136 VFC_Cloth07_AliveCtr 9;
BA_ "GenSigSendType" SG_ 136 VFC_Cloth07_ProtBlockCtr 9;
BA_ "GenSigSendType" SG_ 136 VFC_Cloth07_Conf 9;
BA_ "GenSigSendType" SG_ 136 VFC_Cloth07_DxEnd 9;
BA_ "GenSigSendType" SG_ 136 VFC_Cloth07_Dy 9;
BA_ "GenSigStartValue" SG_ 136 VFC_Cloth07_Dy 2048;
BA_ "GenSigSendType" SG_ 136 VFC_Cloth07_DyStdDev 9;
BA_ "GenSigSendType" SG_ 136 VFC_Cloth07_Curv 9;
BA_ "GenSigStartValue" SG_ 136 VFC_Cloth07_Curv 2048;
BA_ "GenSigSendType" SG_ 136 VFC_Cloth07_CurvChange 9;
BA_ "GenSigStartValue" SG_ 136 VFC_Cloth07_CurvChange 2048;
BA_ "GenSigSendType" SG_ 136 VFC_Cloth07_CourseDeviation 9;
BA_ "GenSigSendType" SG_ 136 VFC_Cloth07_HeadingAngle 9;
BA_ "GenSigStartValue" SG_ 136 VFC_Cloth07_HeadingAngle 2048;
BA_ "GenSigSendType" SG_ 136 VFC_Cloth07_LineWidth 9;
BA_ "GenSigSendType" SG_ 136 VFC_Cloth07_Type 9;
BA_ "GenSigSendType" SG_ 136 VFC_Cloth07_TypeProb 9;
BA_ "GenSigSendType" SG_ 136 VFC_Cloth07_MeasureType 9;
BA_ "GenSigSendType" SG_ 136 VFC_Cloth07_ColorClass 9;
BA_ "GenSigSendType" SG_ 136 VFC_Cloth07_LineID 9;
BA_ "GenSigStartValue" SG_ 272 RFC_DOPTraj_Dy 2048;
BA_ "GenSigStartValue" SG_ 272 RFC_DOPTraj_HeadingAngle 3277;
BA_ "GenSigStartValue" SG_ 272 RFC_DOPTraj_Curvature 4096;
BA_ "GenSigStartValue" SG_ 272 RFC_DOPTraj_CurvChange 2048;
BA_ "GenSigStartValue" SG_ 937 VFC_kFfwDy 2048;
BA_ "GenSigStartValue" SG_ 937 VFC_kFfwChangeCurvature 2048;
BA_ "GenSigStartValue" SG_ 937 VFC_headingAngleDiffRate 8192;
BA_ "GenSigStartValue" SG_ 937 VFC_latOffsetDesTraj 256;
BA_ "GenSigStartValue" SG_ 937 VFC_dYVehCenterDesTrj 512;
BA_ "GenSigStartValue" SG_ 937 VFC_headingAngleDiff 8192;
BA_ "GenSigStartValue" SG_ 937 VFC_KtiN_near 2048;
BA_ "GenSigStartValue" SG_ 937 VFC_Kd_near 2048;
BA_ "GenSigStartValue" SG_ 937 VFC_Ki_near 2048;
BA_ "GenSigStartValue" SG_ 937 VFC_Kp_near 2048;
BA_ "GenSigStartValue" SG_ 937 VFC_KtiN_far 2048;
BA_ "GenSigStartValue" SG_ 937 VFC_Kd_far 2048;
BA_ "GenSigStartValue" SG_ 937 VFC_Ki_far 2048;
BA_ "GenSigStartValue" SG_ 937 VFC_Kp_far 2048;
BA_ "GenSigStartValue" SG_ 937 VFC_agStWhDesPidFfw 8192;
BA_ "GenSigStartValue" SG_ 937 VFC_agStWhDesPidNear 8192;
BA_ "GenSigStartValue" SG_ 937 VFC_agStWhDesPidFar 8192;
BA_ "GenSigStartValue" SG_ 937 VFC_steeringWheelAngleOffset 1024;
BA_ "GenSigStartValue" SG_ 936 VFC_agbathTubELKsl 8192;
BA_ "GenSigStartValue" SG_ 936 VFC_agbathTubELKre 8192;
BA_ "GenSigStartValue" SG_ 936 VFC_agbathTubELKot 8192;
BA_ "GenSigStartValue" SG_ 936 VFC_agbathTubELKoc 8192;
BA_ "GenSigStartValue" SG_ 936 VFC_agbathTubRdp 8192;
BA_ "GenSigStartValue" SG_ 935 VFC_dlcIUpprELKsl 256;
BA_ "GenSigStartValue" SG_ 935 VFC_dlcLowrELKsl 256;
BA_ "GenSigStartValue" SG_ 935 VFC_dlcIUpprELKre 256;
BA_ "GenSigStartValue" SG_ 935 VFC_dlcLowrELKre 256;
BA_ "GenSigStartValue" SG_ 935 VFC_dlcIUpprELKot 256;
BA_ "GenSigStartValue" SG_ 935 VFC_dlcLowrELKot 256;
BA_ "GenSigStartValue" SG_ 935 VFC_dlcIUpprELKoc 256;
BA_ "GenSigStartValue" SG_ 935 VFC_dlcLowrELKoc 256;
BA_ "GenSigStartValue" SG_ 935 VFC_dlcIUpprRDP 256;
BA_ "GenSigStartValue" SG_ 935 VFC_dlcLowrRDP 256;
BA_ "GenSigStartValue" SG_ 935 VFC_dlcIUpprLDW 256;
BA_ "GenSigStartValue" SG_ 935 VFC_dlcLowrLDW 256;
BA_ "GenSigStartValue" SG_ 934 VFC_latOffsetIntEva 256;
BA_ "GenSigStartValue" SG_ 934 VFC_ddlcRoadedge 512;
BA_ "GenSigStartValue" SG_ 934 VFC_dlcRoadedge 1024;
BA_ "GenSigStartValue" SG_ 934 VFC_dlc 1024;
BA_ "GenSigStartValue" SG_ 934 VFC_dlcFrtWhl 1024;
BA_ "GenSigStartValue" SG_ 934 VFC_latSpeed 512;
BA_ "GenSigStartValue" SG_ 933 VFC_overrideOffset 512;
VAL_ 200 VFC_Obj12A_ID 0 "INVALID" ;
VAL_ 200 VFC_Obj12A_Type 0 "NOTYPE" 1 "CAR" 2 "TRUCK" 3 "MOTORCYCLIST" 4 "PEDESTRIAN" 5 "CYCLIST" ;
VAL_ 200 VFC_Obj12A_HeadOrientation 0 "N/A" 1 "Head front" 2 "Head left front" 3 "Head left" 4 "Head left back" 5 "Head back" 6 "Head right back" 7 "Head right" 8 "Head right front" 9 "Reserved09" 10 "Reserved10" 11 "Reserved11" 12 "Reserved12" 13 "Reserved13" 14 "Reserved14" 15 "Unknown" ;
VAL_ 200 VFC_Obj12A_CompletelyInImg 0 "not completely measured" 1 "completely measured" ;
VAL_ 200 VFC_Obj12A_Measured 0 "Invalid" 1 "Measured" 2 "Predicted" 3 "Reserved3" ;
VAL_ 200 VFC_Obj12A_VisibleView 0 "UNKNOWN" 1 "CLASSIC" 2 "SIDE" 3 "CLASSIC_SIDE" 4 "SIDE_CLASSIC" ;
VAL_ 200 VFC_Obj12A_ClassifiedView 0 "Unknown" 1 "Front" 2 "Rear" 3 "Left" 4 "Right" ;
VAL_ 200 VFC_Obj12A_DirIndicator 0 "Unknown" 1 "No direction indicator" 2 "Left indicator" 3 "Right indicator" 4 "Warning Lights" ;
VAL_ 200 VFC_Obj12A_BrakeLight 0 "Unknown" 1 "No light detected" 2 "One light detected" 3 "Two lights detected" 4 "Three lights detected" 5 "Reserved5" 6 "Reserved6" 7 "Reserved7" ;
VAL_ 202 VFC_Obj13A_ID 0 "INVALID" ;
VAL_ 202 VFC_Obj13A_Type 0 "NOTYPE" 1 "CAR" 2 "TRUCK" 3 "MOTORCYCLIST" 4 "PEDESTRIAN" 5 "CYCLIST" ;
VAL_ 202 VFC_Obj13A_HeadOrientation 0 "N/A" 1 "Head front" 2 "Head left front" 3 "Head left" 4 "Head left back" 5 "Head back" 6 "Head right back" 7 "Head right" 8 "Head right front" 9 "Reserved09" 10 "Reserved10" 11 "Reserved11" 12 "Reserved12" 13 "Reserved13" 14 "Reserved14" 15 "Unknown" ;
VAL_ 202 VFC_Obj13A_CompletelyInImg 0 "not completely measured" 1 "completely measured" ;
VAL_ 202 VFC_Obj13A_Measured 0 "Invalid" 1 "Measured" 2 "Predicted" 3 "Reserved3" ;
VAL_ 202 VFC_Obj13A_VisibleView 0 "UNKNOWN" 1 "CLASSIC" 2 "SIDE" 3 "CLASSIC_SIDE" 4 "SIDE_CLASSIC" ;
VAL_ 202 VFC_Obj13A_ClassifiedView 0 "Unknown" 1 "Front" 2 "Rear" 3 "Left" 4 "Right" ;
VAL_ 202 VFC_Obj13A_DirIndicator 0 "Unknown" 1 "No direction indicator" 2 "Left indicator" 3 "Right indicator" 4 "Warning Lights" ;
VAL_ 202 VFC_Obj13A_BrakeLight 0 "Unknown" 1 "No light detected" 2 "One light detected" 3 "Two lights detected" 4 "Three lights detected" 5 "Reserved5" 6 "Reserved6" 7 "Reserved7" ;
VAL_ 204 VFC_Obj14A_ID 0 "INVALID" ;
VAL_ 204 VFC_Obj14A_Type 0 "NOTYPE" 1 "CAR" 2 "TRUCK" 3 "MOTORCYCLIST" 4 "PEDESTRIAN" 5 "CYCLIST" ;
VAL_ 204 VFC_Obj14A_HeadOrientation 0 "N/A" 1 "Head front" 2 "Head left front" 3 "Head left" 4 "Head left back" 5 "Head back" 6 "Head right back" 7 "Head right" 8 "Head right front" 9 "Reserved09" 10 "Reserved10" 11 "Reserved11" 12 "Reserved12" 13 "Reserved13" 14 "Reserved14" 15 "Unknown" ;
VAL_ 204 VFC_Obj14A_CompletelyInImg 0 "not completely measured" 1 "completely measured" ;
VAL_ 204 VFC_Obj14A_Measured 0 "Invalid" 1 "Measured" 2 "Predicted" 3 "Reserved3" ;
VAL_ 204 VFC_Obj14A_VisibleView 0 "UNKNOWN" 1 "CLASSIC" 2 "SIDE" 3 "CLASSIC_SIDE" 4 "SIDE_CLASSIC" ;
VAL_ 204 VFC_Obj14A_ClassifiedView 0 "Unknown" 1 "Front" 2 "Rear" 3 "Left" 4 "Right" ;
VAL_ 204 VFC_Obj14A_DirIndicator 0 "Unknown" 1 "No direction indicator" 2 "Left indicator" 3 "Right indicator" 4 "Warning Lights" ;
VAL_ 204 VFC_Obj14A_BrakeLight 0 "Unknown" 1 "No light detected" 2 "One light detected" 3 "Two lights detected" 4 "Three lights detected" 5 "Reserved5" 6 "Reserved6" 7 "Reserved7" ;
VAL_ 206 VFC_Obj15A_ID 0 "INVALID" ;
VAL_ 206 VFC_Obj15A_Type 0 "NOTYPE" 1 "CAR" 2 "TRUCK" 3 "MOTORCYCLIST" 4 "PEDESTRIAN" 5 "CYCLIST" ;
VAL_ 206 VFC_Obj15A_HeadOrientation 0 "N/A" 1 "Head front" 2 "Head left front" 3 "Head left" 4 "Head left back" 5 "Head back" 6 "Head right back" 7 "Head right" 8 "Head right front" 9 "Reserved09" 10 "Reserved10" 11 "Reserved11" 12 "Reserved12" 13 "Reserved13" 14 "Reserved14" 15 "Unknown" ;
VAL_ 206 VFC_Obj15A_CompletelyInImg 0 "not completely measured" 1 "completely measured" ;
VAL_ 206 VFC_Obj15A_Measured 0 "Invalid" 1 "Measured" 2 "Predicted" 3 "Reserved3" ;
VAL_ 206 VFC_Obj15A_VisibleView 0 "UNKNOWN" 1 "CLASSIC" 2 "SIDE" 3 "CLASSIC_SIDE" 4 "SIDE_CLASSIC" ;
VAL_ 206 VFC_Obj15A_ClassifiedView 0 "Unknown" 1 "Front" 2 "Rear" 3 "Left" 4 "Right" ;
VAL_ 206 VFC_Obj15A_DirIndicator 0 "Unknown" 1 "No direction indicator" 2 "Left indicator" 3 "Right indicator" 4 "Warning Lights" ;
VAL_ 206 VFC_Obj15A_BrakeLight 0 "Unknown" 1 "No light detected" 2 "One light detected" 3 "Two lights detected" 4 "Three lights detected" 5 "Reserved5" 6 "Reserved6" 7 "Reserved7" ;
VAL_ 208 VFC_Obj16A_ID 0 "INVALID" ;
VAL_ 208 VFC_Obj16A_Type 0 "NOTYPE" 1 "CAR" 2 "TRUCK" 3 "MOTORCYCLIST" 4 "PEDESTRIAN" 5 "CYCLIST" ;
VAL_ 208 VFC_Obj16A_HeadOrientation 0 "N/A" 1 "Head front" 2 "Head left front" 3 "Head left" 4 "Head left back" 5 "Head back" 6 "Head right back" 7 "Head right" 8 "Head right front" 9 "Reserved09" 10 "Reserved10" 11 "Reserved11" 12 "Reserved12" 13 "Reserved13" 14 "Reserved14" 15 "Unknown" ;
VAL_ 208 VFC_Obj16A_CompletelyInImg 0 "not completely measured" 1 "completely measured" ;
VAL_ 208 VFC_Obj16A_Measured 0 "Invalid" 1 "Measured" 2 "Predicted" 3 "Reserved3" ;
VAL_ 208 VFC_Obj16A_VisibleView 0 "UNKNOWN" 1 "CLASSIC" 2 "SIDE" 3 "CLASSIC_SIDE" 4 "SIDE_CLASSIC" ;
VAL_ 208 VFC_Obj16A_ClassifiedView 0 "Unknown" 1 "Front" 2 "Rear" 3 "Left" 4 "Right" ;
VAL_ 208 VFC_Obj16A_DirIndicator 0 "Unknown" 1 "No direction indicator" 2 "Left indicator" 3 "Right indicator" 4 "Warning Lights" ;
VAL_ 208 VFC_Obj16A_BrakeLight 0 "Unknown" 1 "No light detected" 2 "One light detected" 3 "Two lights detected" 4 "Three lights detected" 5 "Reserved5" 6 "Reserved6" 7 "Reserved7" ;
VAL_ 210 VFC_Obj17A_ID 0 "INVALID" ;
VAL_ 210 VFC_Obj17A_Type 0 "NOTYPE" 1 "CAR" 2 "TRUCK" 3 "MOTORCYCLIST" 4 "PEDESTRIAN" 5 "CYCLIST" ;
VAL_ 210 VFC_Obj17A_HeadOrientation 0 "N/A" 1 "Head front" 2 "Head left front" 3 "Head left" 4 "Head left back" 5 "Head back" 6 "Head right back" 7 "Head right" 8 "Head right front" 9 "Reserved09" 10 "Reserved10" 11 "Reserved11" 12 "Reserved12" 13 "Reserved13" 14 "Reserved14" 15 "Unknown" ;
VAL_ 210 VFC_Obj17A_CompletelyInImg 0 "not completely measured" 1 "completely measured" ;
VAL_ 210 VFC_Obj17A_Measured 0 "Invalid" 1 "Measured" 2 "Predicted" 3 "Reserved3" ;
VAL_ 210 VFC_Obj17A_VisibleView 0 "UNKNOWN" 1 "CLASSIC" 2 "SIDE" 3 "CLASSIC_SIDE" 4 "SIDE_CLASSIC" ;
VAL_ 210 VFC_Obj17A_ClassifiedView 0 "Unknown" 1 "Front" 2 "Rear" 3 "Left" 4 "Right" ;
VAL_ 210 VFC_Obj17A_DirIndicator 0 "Unknown" 1 "No direction indicator" 2 "Left indicator" 3 "Right indicator" 4 "Warning Lights" ;
VAL_ 210 VFC_Obj17A_BrakeLight 0 "Unknown" 1 "No light detected" 2 "One light detected" 3 "Two lights detected" 4 "Three lights detected" 5 "Reserved5" 6 "Reserved6" 7 "Reserved7" ;
VAL_ 212 VFC_Obj18A_ID 0 "INVALID" ;
VAL_ 212 VFC_Obj18A_Type 0 "NOTYPE" 1 "CAR" 2 "TRUCK" 3 "MOTORCYCLIST" 4 "PEDESTRIAN" 5 "CYCLIST" ;
VAL_ 212 VFC_Obj18A_HeadOrientation 0 "N/A" 1 "Head front" 2 "Head left front" 3 "Head left" 4 "Head left back" 5 "Head back" 6 "Head right back" 7 "Head right" 8 "Head right front" 9 "Reserved09" 10 "Reserved10" 11 "Reserved11" 12 "Reserved12" 13 "Reserved13" 14 "Reserved14" 15 "Unknown" ;
VAL_ 212 VFC_Obj18A_CompletelyInImg 0 "not completely measured" 1 "completely measured" ;
VAL_ 212 VFC_Obj18A_Measured 0 "Invalid" 1 "Measured" 2 "Predicted" 3 "Reserved3" ;
VAL_ 212 VFC_Obj18A_VisibleView 0 "UNKNOWN" 1 "CLASSIC" 2 "SIDE" 3 "CLASSIC_SIDE" 4 "SIDE_CLASSIC" ;
VAL_ 212 VFC_Obj18A_ClassifiedView 0 "Unknown" 1 "Front" 2 "Rear" 3 "Left" 4 "Right" ;
VAL_ 212 VFC_Obj18A_DirIndicator 0 "Unknown" 1 "No direction indicator" 2 "Left indicator" 3 "Right indicator" 4 "Warning Lights" ;
VAL_ 212 VFC_Obj18A_BrakeLight 0 "Unknown" 1 "No light detected" 2 "One light detected" 3 "Two lights detected" 4 "Three lights detected" 5 "Reserved5" 6 "Reserved6" 7 "Reserved7" ;
VAL_ 214 VFC_Obj19A_ID 0 "INVALID" ;
VAL_ 214 VFC_Obj19A_Type 0 "NOTYPE" 1 "CAR" 2 "TRUCK" 3 "MOTORCYCLIST" 4 "PEDESTRIAN" 5 "CYCLIST" ;
VAL_ 214 VFC_Obj19A_HeadOrientation 0 "N/A" 1 "Head front" 2 "Head left front" 3 "Head left" 4 "Head left back" 5 "Head back" 6 "Head right back" 7 "Head right" 8 "Head right front" 9 "Reserved09" 10 "Reserved10" 11 "Reserved11" 12 "Reserved12" 13 "Reserved13" 14 "Reserved14" 15 "Unknown" ;
VAL_ 214 VFC_Obj19A_CompletelyInImg 0 "not completely measured" 1 "completely measured" ;
VAL_ 214 VFC_Obj19A_Measured 0 "Invalid" 1 "Measured" 2 "Predicted" 3 "Reserved3" ;
VAL_ 214 VFC_Obj19A_VisibleView 0 "UNKNOWN" 1 "CLASSIC" 2 "SIDE" 3 "CLASSIC_SIDE" 4 "SIDE_CLASSIC" ;
VAL_ 214 VFC_Obj19A_ClassifiedView 0 "Unknown" 1 "Front" 2 "Rear" 3 "Left" 4 "Right" ;
VAL_ 214 VFC_Obj19A_DirIndicator 0 "Unknown" 1 "No direction indicator" 2 "Left indicator" 3 "Right indicator" 4 "Warning Lights" ;
VAL_ 214 VFC_Obj19A_BrakeLight 0 "Unknown" 1 "No light detected" 2 "One light detected" 3 "Two lights detected" 4 "Three lights detected" 5 "Reserved5" 6 "Reserved6" 7 "Reserved7" ;
VAL_ 128 VFC_LaneHdr_State 0 "Off" 1 "On" 2 "Reduced" 3 "HW_Error" 4 "SW_Error" 5 "FID_Active" 6 "Reserved6" 7 "Reserved7" ;
VAL_ 129 VFC_Cloth00_Type 0 "TYPE_SOLID_LINE" 1 "TYPE_DASHED_LINE" 2 "TYPE_DOUBLE_DASHED_DASHED" 3 "TYPE_DOUBLE_DASHED_SOLID" 4 "TYPE_DOUBLE_SOLID_DASHED" 5 "TYPE_DOUBLE_SOLID_SOLID" 6 "TYPE_MULTIPLE" 7 "TYPE_MULTIPLE_WARNING" 8 "TYPE_BOTTS_DOTS" 9 "TYPE_ROAD_EDGE" 10 "TYPE_ROAD_FURNITURE" 11 "TYPE_CURBSTONE" 12 "TYPE_TRAFFIC_STATIC" 13 "TYPE_UNKNOWN_RAISED" 14 "TYPE_UNKNOWN" ;
VAL_ 129 VFC_Cloth00_MeasureType 0 "MTYPE_MEASURED" 1 "MTYPE_VIRTUAL" 2 "MTYPE_INTERPOLATED" 3 "MTYPE_UNKNOWN" ;
VAL_ 129 VFC_Cloth00_ColorClass 0 "COLOR_WHITE" 1 "COLOR_YELLOW" 2 "COLOR_RED" 3 "COLOR_BLUE" 4 "COLOR_GREEN" 5 "RESERVED5" 6 "RESERVED6" 7 "COLOR_UNKNOWN" ;
VAL_ 129 VFC_Cloth00_LineID 0 "No LINE" 1 "LEFT_EGO_LINE" 2 "RIGHT_EGO_LINE" 3 "LEFT_LEFT_LINE" 4 "RIGHT_RIGHT_LINE" 5 "ROAD_EDGE_LEFT" 6 "ROAD_EDGE_RIGHT" 7 "RAISED_LEFT" 8 "RAISED_RIGHT" ;
VAL_ 130 VFC_Cloth01_Type 0 "TYPE_SOLID_LINE" 1 "TYPE_DASHED_LINE" 2 "TYPE_DOUBLE_DASHED_DASHED" 3 "TYPE_DOUBLE_DASHED_SOLID" 4 "TYPE_DOUBLE_SOLID_DASHED" 5 "TYPE_DOUBLE_SOLID_SOLID" 6 "TYPE_MULTIPLE" 7 "TYPE_MULTIPLE_WARNING" 8 "TYPE_BOTTS_DOTS" 9 "TYPE_ROAD_EDGE" 10 "TYPE_ROAD_FURNITURE" 11 "TYPE_CURBSTONE" 12 "TYPE_TRAFFIC_STATIC" 13 "TYPE_UNKNOWN_RAISED" 14 "TYPE_UNKNOWN" ;
VAL_ 130 VFC_Cloth01_MeasureType 0 "MTYPE_MEASURED" 1 "MTYPE_VIRTUAL" 2 "MTYPE_INTERPOLATED" 3 "MTYPE_UNKNOWN" ;
VAL_ 130 VFC_Cloth01_ColorClass 0 "COLOR_WHITE" 1 "COLOR_YELLOW" 2 "COLOR_RED" 3 "COLOR_BLUE" 4 "COLOR_GREEN" 5 "RESERVED5" 6 "RESERVED6" 7 "COLOR_UNKNOWN" ;
VAL_ 130 VFC_Cloth01_LineID 0 "No LINE" 1 "LEFT_EGO_LINE" 2 "RIGHT_EGO_LINE" 3 "LEFT_LEFT_LINE" 4 "RIGHT_RIGHT_LINE" 5 "ROAD_EDGE_LEFT" 6 "ROAD_EDGE_RIGHT" 7 "RAISED_LEFT" 8 "RAISED_RIGHT" ;
VAL_ 131 VFC_Cloth02_Type 0 "TYPE_SOLID_LINE" 1 "TYPE_DASHED_LINE" 2 "TYPE_DOUBLE_DASHED_DASHED" 3 "TYPE_DOUBLE_DASHED_SOLID" 4 "TYPE_DOUBLE_SOLID_DASHED" 5 "TYPE_DOUBLE_SOLID_SOLID" 6 "TYPE_MULTIPLE" 7 "TYPE_MULTIPLE_WARNING" 8 "TYPE_BOTTS_DOTS" 9 "TYPE_ROAD_EDGE" 10 "TYPE_ROAD_FURNITURE" 11 "TYPE_CURBSTONE" 12 "TYPE_TRAFFIC_STATIC" 13 "TYPE_UNKNOWN_RAISED" 14 "TYPE_UNKNOWN" ;
VAL_ 131 VFC_Cloth02_MeasureType 0 "MTYPE_MEASURED" 1 "MTYPE_VIRTUAL" 2 "MTYPE_INTERPOLATED" 3 "MTYPE_UNKNOWN" ;
VAL_ 131 VFC_Cloth02_ColorClass 0 "COLOR_WHITE" 1 "COLOR_YELLOW" 2 "COLOR_RED" 3 "COLOR_BLUE" 4 "COLOR_GREEN" 5 "RESERVED5" 6 "RESERVED6" 7 "COLOR_UNKNOWN" ;
VAL_ 131 VFC_Cloth02_LineID 0 "No LINE" 1 "LEFT_EGO_LINE" 2 "RIGHT_EGO_LINE" 3 "LEFT_LEFT_LINE" 4 "RIGHT_RIGHT_LINE" 5 "ROAD_EDGE_LEFT" 6 "ROAD_EDGE_RIGHT" 7 "RAISED_LEFT" 8 "RAISED_RIGHT" ;
VAL_ 132 VFC_Cloth03_Type 0 "TYPE_SOLID_LINE" 1 "TYPE_DASHED_LINE" 2 "TYPE_DOUBLE_DASHED_DASHED" 3 "TYPE_DOUBLE_DASHED_SOLID" 4 "TYPE_DOUBLE_SOLID_DASHED" 5 "TYPE_DOUBLE_SOLID_SOLID" 6 "TYPE_MULTIPLE" 7 "TYPE_MULTIPLE_WARNING" 8 "TYPE_BOTTS_DOTS" 9 "TYPE_ROAD_EDGE" 10 "TYPE_ROAD_FURNITURE" 11 "TYPE_CURBSTONE" 12 "TYPE_TRAFFIC_STATIC" 13 "TYPE_UNKNOWN_RAISED" 14 "TYPE_UNKNOWN" ;
VAL_ 132 VFC_Cloth03_MeasureType 0 "MTYPE_MEASURED" 1 "MTYPE_VIRTUAL" 2 "MTYPE_INTERPOLATED" 3 "MTYPE_UNKNOWN" ;
VAL_ 132 VFC_Cloth03_ColorClass 0 "COLOR_WHITE" 1 "COLOR_YELLOW" 2 "COLOR_RED" 3 "COLOR_BLUE" 4 "COLOR_GREEN" 5 "RESERVED5" 6 "RESERVED6" 7 "COLOR_UNKNOWN" ;
VAL_ 132 VFC_Cloth03_LineID 0 "No LINE" 1 "LEFT_EGO_LINE" 2 "RIGHT_EGO_LINE" 3 "LEFT_LEFT_LINE" 4 "RIGHT_RIGHT_LINE" 5 "ROAD_EDGE_LEFT" 6 "ROAD_EDGE_RIGHT" 7 "RAISED_LEFT" 8 "RAISED_RIGHT" ;
VAL_ 133 VFC_Cloth04_Type 0 "TYPE_SOLID_LINE" 1 "TYPE_DASHED_LINE" 2 "TYPE_DOUBLE_DASHED_DASHED" 3 "TYPE_DOUBLE_DASHED_SOLID" 4 "TYPE_DOUBLE_SOLID_DASHED" 5 "TYPE_DOUBLE_SOLID_SOLID" 6 "TYPE_MULTIPLE" 7 "TYPE_MULTIPLE_WARNING" 8 "TYPE_BOTTS_DOTS" 9 "TYPE_ROAD_EDGE" 10 "TYPE_ROAD_FURNITURE" 11 "TYPE_CURBSTONE" 12 "TYPE_TRAFFIC_STATIC" 13 "TYPE_UNKNOWN_RAISED" 14 "TYPE_UNKNOWN" ;
VAL_ 133 VFC_Cloth04_MeasureType 0 "MTYPE_MEASURED" 1 "MTYPE_VIRTUAL" 2 "MTYPE_INTERPOLATED" 3 "MTYPE_UNKNOWN" ;
VAL_ 133 VFC_Cloth04_ColorClass 0 "COLOR_WHITE" 1 "COLOR_YELLOW" 2 "COLOR_RED" 3 "COLOR_BLUE" 4 "COLOR_GREEN" 5 "RESERVED5" 6 "RESERVED6" 7 "COLOR_UNKNOWN" ;
VAL_ 133 VFC_Cloth04_LineID 0 "No LINE" 1 "LEFT_EGO_LINE" 2 "RIGHT_EGO_LINE" 3 "LEFT_LEFT_LINE" 4 "RIGHT_RIGHT_LINE" 5 "ROAD_EDGE_LEFT" 6 "ROAD_EDGE_RIGHT" 7 "RAISED_LEFT" 8 "RAISED_RIGHT" ;
VAL_ 134 VFC_Cloth05_Type 0 "TYPE_SOLID_LINE" 1 "TYPE_DASHED_LINE" 2 "TYPE_DOUBLE_DASHED_DASHED" 3 "TYPE_DOUBLE_DASHED_SOLID" 4 "TYPE_DOUBLE_SOLID_DASHED" 5 "TYPE_DOUBLE_SOLID_SOLID" 6 "TYPE_MULTIPLE" 7 "TYPE_MULTIPLE_WARNING" 8 "TYPE_BOTTS_DOTS" 9 "TYPE_ROAD_EDGE" 10 "TYPE_ROAD_FURNITURE" 11 "TYPE_CURBSTONE" 12 "TYPE_TRAFFIC_STATIC" 13 "TYPE_UNKNOWN_RAISED" 14 "TYPE_UNKNOWN" ;
VAL_ 134 VFC_Cloth05_MeasureType 0 "MTYPE_MEASURED" 1 "MTYPE_VIRTUAL" 2 "MTYPE_INTERPOLATED" 3 "MTYPE_UNKNOWN" ;
VAL_ 134 VFC_Cloth05_ColorClass 0 "COLOR_WHITE" 1 "COLOR_YELLOW" 2 "COLOR_RED" 3 "COLOR_BLUE" 4 "COLOR_GREEN" 5 "RESERVED5" 6 "RESERVED6" 7 "COLOR_UNKNOWN" ;
VAL_ 134 VFC_Cloth05_LineID 0 "No LINE" 1 "LEFT_EGO_LINE" 2 "RIGHT_EGO_LINE" 3 "LEFT_LEFT_LINE" 4 "RIGHT_RIGHT_LINE" 5 "ROAD_EDGE_LEFT" 6 "ROAD_EDGE_RIGHT" 7 "RAISED_LEFT" 8 "RAISED_RIGHT" ;
VAL_ 135 VFC_Cloth06_Type 0 "TYPE_SOLID_LINE" 1 "TYPE_DASHED_LINE" 2 "TYPE_DOUBLE_DASHED_DASHED" 3 "TYPE_DOUBLE_DASHED_SOLID" 4 "TYPE_DOUBLE_SOLID_DASHED" 5 "TYPE_DOUBLE_SOLID_SOLID" 6 "TYPE_MULTIPLE" 7 "TYPE_MULTIPLE_WARNING" 8 "TYPE_BOTTS_DOTS" 9 "TYPE_ROAD_EDGE" 10 "TYPE_ROAD_FURNITURE" 11 "TYPE_CURBSTONE" 12 "TYPE_TRAFFIC_STATIC" 13 "TYPE_UNKNOWN_RAISED" 14 "TYPE_UNKNOWN" ;
VAL_ 135 VFC_Cloth06_MeasureType 0 "MTYPE_MEASURED" 1 "MTYPE_VIRTUAL" 2 "MTYPE_INTERPOLATED" 3 "MTYPE_UNKNOWN" ;
VAL_ 135 VFC_Cloth06_ColorClass 0 "COLOR_WHITE" 1 "COLOR_YELLOW" 2 "COLOR_RED" 3 "COLOR_BLUE" 4 "COLOR_GREEN" 5 "RESERVED5" 6 "RESERVED6" 7 "COLOR_UNKNOWN" ;
VAL_ 135 VFC_Cloth06_LineID 0 "No LINE" 1 "LEFT_EGO_LINE" 2 "RIGHT_EGO_LINE" 3 "LEFT_LEFT_LINE" 4 "RIGHT_RIGHT_LINE" 5 "ROAD_EDGE_LEFT" 6 "ROAD_EDGE_RIGHT" 7 "RAISED_LEFT" 8 "RAISED_RIGHT" ;
VAL_ 136 VFC_Cloth07_Type 0 "TYPE_SOLID_LINE" 1 "TYPE_DASHED_LINE" 2 "TYPE_DOUBLE_DASHED_DASHED" 3 "TYPE_DOUBLE_DASHED_SOLID" 4 "TYPE_DOUBLE_SOLID_DASHED" 5 "TYPE_DOUBLE_SOLID_SOLID" 6 "TYPE_MULTIPLE" 7 "TYPE_MULTIPLE_WARNING" 8 "TYPE_BOTTS_DOTS" 9 "TYPE_ROAD_EDGE" 10 "TYPE_ROAD_FURNITURE" 11 "TYPE_CURBSTONE" 12 "TYPE_TRAFFIC_STATIC" 13 "TYPE_UNKNOWN_RAISED" 14 "TYPE_UNKNOWN" ;
VAL_ 136 VFC_Cloth07_MeasureType 0 "MTYPE_MEASURED" 1 "MTYPE_VIRTUAL" 2 "MTYPE_INTERPOLATED" 3 "MTYPE_UNKNOWN" ;
VAL_ 136 VFC_Cloth07_ColorClass 0 "COLOR_WHITE" 1 "COLOR_YELLOW" 2 "COLOR_RED" 3 "COLOR_BLUE" 4 "COLOR_GREEN" 5 "RESERVED5" 6 "RESERVED6" 7 "COLOR_UNKNOWN" ;
VAL_ 136 VFC_Cloth07_LineID 0 "No LINE" 1 "LEFT_EGO_LINE" 2 "RIGHT_EGO_LINE" 3 "LEFT_LEFT_LINE" 4 "RIGHT_RIGHT_LINE" 5 "ROAD_EDGE_LEFT" 6 "ROAD_EDGE_RIGHT" 7 "RAISED_LEFT" 8 "RAISED_RIGHT" ;
VAL_ 272 RFC_DOPTrajValid 0 "Invalid" 1 "Valid" ;
VAL_ 272 RFC_DOPObjInfo_Handle_ub 0 "Invalid" ;
VAL_ 937 VFC_CtrlStopPunishFlag 1 " active" 0 " not active" ;
VAL_ 937 VFC_CtrlStopActiveFlag 1 " active" 0 " not active" ;
