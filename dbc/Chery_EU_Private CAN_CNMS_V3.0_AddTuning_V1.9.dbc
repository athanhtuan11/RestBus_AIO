VERSION ""

NS_ :

BS_:

BU_: RadarFrontCenter RadarFrontSlave DASy MPC3 RadarFrontLeft RadarFrontRight RadarRearLeft RadarRearRight

BO_ 160 VFC_ObjectHdr: 16 MPC3
 SG_ VFC_ObjHdr_CRC : 0|16@1+ (1,0) [0|65535] ""  RadarFrontCenter,DASy
 SG_ VFC_ObjHdr_AliveCtr : 16|8@1+ (1,0) [0|255] ""  RadarFrontCenter,DASy
 SG_ VFC_ObjHdr_ProtBlockCtr : 24|4@1+ (1,0) [0|15] ""  RadarFrontCenter,DASy
 SG_ VFC_ObjHdr_ProtObjCount : 32|6@1+ (1,0) [0|32] ""  RadarFrontCenter,DASy
 SG_ VFC_ObjHdr_State : 40|3@1+ (1,0) [0|7] ""  RadarFrontCenter,DASy
 SG_ VFC_ObjHdr_TimeStampStatus : 56|8@1+ (1,0) [0|255] ""  RadarFrontCenter,DASy
 SG_ VFC_ObjHdr_TimeStamp : 64|26@1+ (1,0) [0|67108863] "ms"  RadarFrontCenter,DASy
 SG_ VFC_ObjHdr_TimeLatency : 96|16@1+ (1,0) [0|65535] "ms"  RadarFrontCenter,DASy

BO_ 176 VFC_Object00A: 64 MPC3
 SG_ VFC_Obj00A_CRC : 0|16@1+ (1,0) [0|65535] ""  RadarFrontCenter,DASy
 SG_ VFC_Obj00A_AliveCtr : 16|8@1+ (1,0) [0|255] ""  RadarFrontCenter,DASy
 SG_ VFC_Obj00A_ProtBlockCtr : 24|4@1+ (1,0) [0|15] ""  RadarFrontCenter,DASy
 SG_ VFC_Obj00A_ID : 32|8@1+ (1,0) [1|255] ""  RadarFrontCenter,DASy
 SG_ VFC_Obj00A_Type : 60|4@1+ (1,0) [0|15] ""  RadarFrontCenter,DASy
 SG_ VFC_Obj00A_TypeProb : 378|6@1+ (2,0) [0|100] "%"  RadarFrontCenter,DASy
 SG_ VFC_Obj00A_Dx : 48|12@1+ (0.05,0) [0|204.75] "m"  RadarFrontCenter,DASy
 SG_ VFC_Obj00A_Dy : 64|14@1+ (0.01,-80) [-80|80] "m"  RadarFrontCenter,DASy
 SG_ VFC_Obj00A_Vx : 80|11@1+ (0.1,-154) [-154|50] "m/s"  RadarFrontCenter,DASy
 SG_ VFC_Obj00A_Vy : 96|10@1+ (0.1,-50) [-50|50] "m/s"  RadarFrontCenter,DASy
 SG_ VFC_Obj00A_Ax : 112|9@1+ (0.1,-16) [-16|16] "m/s^2"  RadarFrontCenter,DASy
 SG_ VFC_Obj00A_Ay : 128|8@1+ (0.1,-12) [-12|12] "m/s^2"  RadarFrontCenter,DASy
 SG_ VFC_Obj00A_DxStdDev : 144|10@1+ (0.05,0) [0|51.15] "m"  RadarFrontCenter,DASy
 SG_ VFC_Obj00A_DyStdDev : 160|10@1+ (0.02,0) [0|20.46] "m"  RadarFrontCenter,DASy
 SG_ VFC_Obj00A_VxStdDev : 176|10@1+ (0.1,0) [0|102.3] "m/s"  RadarFrontCenter,DASy
 SG_ VFC_Obj00A_VyStdDev : 192|9@1+ (0.1,0) [0|51.1] "m/s"  RadarFrontCenter,DASy
 SG_ VFC_Obj00A_AxStdDev : 40|8@1+ (0.1,0) [0|25.5] "m/s^2"  RadarFrontCenter,DASy
 SG_ VFC_Obj00A_AyStdDev : 136|8@1+ (0.1,0) [0|25.5] "m/s^2"  RadarFrontCenter,DASy
 SG_ VFC_Obj00A_Length : 217|9@1+ (0.05,0) [0|25.55] "m"  RadarFrontCenter,DASy
 SG_ VFC_Obj00A_Width : 294|10@1+ (0.01,0) [0|10.23] "m"  RadarFrontCenter,DASy
 SG_ VFC_Obj00A_Height : 208|9@1+ (0.01,0) [0|5.11] "m"  RadarFrontCenter,DASy
 SG_ VFC_Obj00A_LengthStdDev : 384|7@1+ (0.05,0) [0|5] "m"  RadarFrontCenter,DASy
 SG_ VFC_Obj00A_WidthStdDev : 391|7@1+ (0.01,0) [0|1] "m"  RadarFrontCenter,DASy
 SG_ VFC_Obj00A_HeightStdDev : 201|7@1+ (0.01,0) [0|1] "m"  RadarFrontCenter,DASy
 SG_ VFC_Obj00A_EdgeLeft : 411|13@1+ (0.00025,-1) [-1|1] "unitless"  RadarFrontCenter,DASy
 SG_ VFC_Obj00A_EdgeMid : 398|13@1+ (0.00025,-1) [-1|1] "unitless"  RadarFrontCenter,DASy
 SG_ VFC_Obj00A_EdgeRight : 424|13@1+ (0.00025,-1) [-1|1] "unitless"  RadarFrontCenter,DASy
 SG_ VFC_Obj00A_EdgeTop : 448|12@1+ (0.00025,-0.5) [-0.5|0.5] "unitless"  RadarFrontCenter,DASy
 SG_ VFC_Obj00A_EdgeBottom : 269|12@1+ (0.00025,-0.5) [-0.5|0.5] "unitless"  RadarFrontCenter,DASy
 SG_ VFC_Obj00A_EdgeLeftStdDev : 440|8@1+ (0.0002,0) [0|0.051] "unitless"  RadarFrontCenter,DASy
 SG_ VFC_Obj00A_EdgeMidStdDev : 464|8@1+ (0.0002,0) [0|0.051] "unitless"  RadarFrontCenter,DASy
 SG_ VFC_Obj00A_EdgeRightStdDev : 472|8@1+ (0.0002,0) [0|0.051] "unitless"  RadarFrontCenter,DASy
 SG_ VFC_Obj00A_EdgeTopStdDev : 480|8@1+ (0.0002,0) [0|0.051] "unitless"  RadarFrontCenter,DASy
 SG_ VFC_Obj00A_EdgeBottomStdDev : 488|8@1+ (0.0002,0) [0|0.051] "unitless"  RadarFrontCenter,DASy
 SG_ VFC_Obj00A_NormVx : 304|16@1+ (0.001,-40) [-40|25] "1/s"  RadarFrontCenter,DASy
 SG_ VFC_Obj00A_NormAx : 235|13@1+ (0.002,-10) [-10|6] "1/s^2"  RadarFrontCenter,DASy
 SG_ VFC_Obj00A_NormVyEdgeLeft : 256|13@1+ (0.001,-4) [-4|4] "1/s"  RadarFrontCenter,DASy
 SG_ VFC_Obj00A_NormVyEdgeRight : 281|13@1+ (0.001,-4) [-4|4] "1/s"  RadarFrontCenter,DASy
 SG_ VFC_Obj00A_NormVxStdDev : 368|10@1+ (0.001,0) [0|1.023] "1/s"  RadarFrontCenter,DASy
 SG_ VFC_Obj00A_NormAxStdDev : 328|10@1+ (0.0025,0) [0|2.5575] "1/s^2"  RadarFrontCenter,DASy
 SG_ VFC_Obj00A_NormVyEdgeLeftStdDev : 248|8@1+ (0.001,0) [0|0.255] "1/s"  RadarFrontCenter,DASy
 SG_ VFC_Obj00A_NormVyEdgeRightStdDev : 320|8@1+ (0.001,0) [0|0.255] "1/s"  RadarFrontCenter,DASy
 SG_ VFC_Obj00A_ScaleChange : 338|14@1+ (0.0001,0.5) [0.5|2.1383] "unitless"  RadarFrontCenter,DASy
 SG_ VFC_Obj00A_ScaleChngStdDev : 352|10@1+ (0.0001,0) [0|0.1023] "unitless"  RadarFrontCenter,DASy
 SG_ VFC_Obj00A_HeadingAngle : 226|9@1+ (0.01,-1.57) [-1.57|1.57] "rad"  RadarFrontCenter,DASy
 SG_ VFC_Obj00A_HeadingAngleStdDev : 186|6@1+ (0.01,0) [0|0.5] "rad"  RadarFrontCenter,DASy
 SG_ VFC_Obj00A_HeadOrientation : 460|4@1+ (1,0) [0|15] ""  RadarFrontCenter,DASy
 SG_ VFC_Obj00A_CompletelyInImg : 121|1@1+ (1,0) [0|1] ""  RadarFrontCenter,DASy
 SG_ VFC_Obj00A_ProbMovingLat : 154|6@1+ (2,0) [0|100] "%"  RadarFrontCenter,DASy
 SG_ VFC_Obj00A_ProbMovingLong : 170|6@1+ (2,0) [0|100] "%"  RadarFrontCenter,DASy
 SG_ VFC_Obj00A_ProbExist : 122|6@1+ (2,0) [0|100] "%"  RadarFrontCenter,DASy
 SG_ VFC_Obj00A_MeasSource : 91|5@1+ (1,0) [0|31] ""  RadarFrontCenter,DASy
 SG_ VFC_Obj00A_Reliability : 362|6@1+ (1,0) [0|63] ""  RadarFrontCenter,DASy
 SG_ VFC_Obj00A_Measured : 78|2@1+ (1,0) [0|3] ""  RadarFrontCenter,DASy
 SG_ VFC_Obj00A_VisibleView : 437|3@1+ (1,0) [0|4] ""  RadarFrontCenter,DASy
 SG_ VFC_Obj00A_ClassifiedView : 496|3@1+ (1,0) [0|4] ""  RadarFrontCenter,DASy
 SG_ VFC_Obj00A_DirIndicator : 106|3@1+ (1,0) [0|4] ""  RadarFrontCenter,DASy
 SG_ VFC_Obj00A_BrakeLight : 109|3@1+ (1,0) [0|7] ""  RadarFrontCenter,DASy

BO_ 178 VFC_Object01A: 64 MPC3
 SG_ VFC_Obj01A_CRC : 0|16@1+ (1,0) [0|65535] ""  RadarFrontCenter,DASy
 SG_ VFC_Obj01A_AliveCtr : 16|8@1+ (1,0) [0|255] ""  RadarFrontCenter,DASy
 SG_ VFC_Obj01A_ProtBlockCtr : 24|4@1+ (1,0) [0|15] ""  RadarFrontCenter,DASy
 SG_ VFC_Obj01A_ID : 32|8@1+ (1,0) [1|255] ""  RadarFrontCenter,DASy
 SG_ VFC_Obj01A_Type : 60|4@1+ (1,0) [0|15] ""  RadarFrontCenter,DASy
 SG_ VFC_Obj01A_TypeProb : 378|6@1+ (2,0) [0|100] "%"  RadarFrontCenter,DASy
 SG_ VFC_Obj01A_Dx : 48|12@1+ (0.05,0) [0|204.75] "m"  RadarFrontCenter,DASy
 SG_ VFC_Obj01A_Dy : 64|14@1+ (0.01,-80) [-80|80] "m"  RadarFrontCenter,DASy
 SG_ VFC_Obj01A_Vx : 80|11@1+ (0.1,-154) [-154|50] "m/s"  RadarFrontCenter,DASy
 SG_ VFC_Obj01A_Vy : 96|10@1+ (0.1,-50) [-50|50] "m/s"  RadarFrontCenter,DASy
 SG_ VFC_Obj01A_Ax : 112|9@1+ (0.1,-16) [-16|16] "m/s^2"  RadarFrontCenter,DASy
 SG_ VFC_Obj01A_Ay : 128|8@1+ (0.1,-12) [-12|12] "m/s^2"  RadarFrontCenter,DASy
 SG_ VFC_Obj01A_DxStdDev : 144|10@1+ (0.05,0) [0|51.15] "m"  RadarFrontCenter,DASy
 SG_ VFC_Obj01A_DyStdDev : 160|10@1+ (0.02,0) [0|20.46] "m"  RadarFrontCenter,DASy
 SG_ VFC_Obj01A_VxStdDev : 176|10@1+ (0.1,0) [0|102.3] "m/s"  RadarFrontCenter,DASy
 SG_ VFC_Obj01A_VyStdDev : 192|9@1+ (0.1,0) [0|51.1] "m/s"  RadarFrontCenter,DASy
 SG_ VFC_Obj01A_AxStdDev : 40|8@1+ (0.1,0) [0|25.5] "m/s^2"  RadarFrontCenter,DASy
 SG_ VFC_Obj01A_AyStdDev : 136|8@1+ (0.1,0) [0|25.5] "m/s^2"  RadarFrontCenter,DASy
 SG_ VFC_Obj01A_Length : 217|9@1+ (0.05,0) [0|25.55] "m"  RadarFrontCenter,DASy
 SG_ VFC_Obj01A_Width : 294|10@1+ (0.01,0) [0|10.23] "m"  RadarFrontCenter,DASy
 SG_ VFC_Obj01A_Height : 208|9@1+ (0.01,0) [0|5.11] "m"  RadarFrontCenter,DASy
 SG_ VFC_Obj01A_LengthStdDev : 384|7@1+ (0.05,0) [0|5] "m"  RadarFrontCenter,DASy
 SG_ VFC_Obj01A_WidthStdDev : 391|7@1+ (0.01,0) [0|1] "m"  RadarFrontCenter,DASy
 SG_ VFC_Obj01A_HeightStdDev : 201|7@1+ (0.01,0) [0|1] "m"  RadarFrontCenter,DASy
 SG_ VFC_Obj01A_EdgeLeft : 411|13@1+ (0.00025,-1) [-1|1] "unitless"  RadarFrontCenter,DASy
 SG_ VFC_Obj01A_EdgeMid : 398|13@1+ (0.00025,-1) [-1|1] "unitless"  RadarFrontCenter,DASy
 SG_ VFC_Obj01A_EdgeRight : 424|13@1+ (0.00025,-1) [-1|1] "unitless"  RadarFrontCenter,DASy
 SG_ VFC_Obj01A_EdgeTop : 448|12@1+ (0.00025,-0.5) [-0.5|0.5] "unitless"  RadarFrontCenter,DASy
 SG_ VFC_Obj01A_EdgeBottom : 269|12@1+ (0.00025,-0.5) [-0.5|0.5] "unitless"  RadarFrontCenter,DASy
 SG_ VFC_Obj01A_EdgeLeftStdDev : 440|8@1+ (0.0002,0) [0|0.051] "unitless"  RadarFrontCenter,DASy
 SG_ VFC_Obj01A_EdgeMidStdDev : 464|8@1+ (0.0002,0) [0|0.051] "unitless"  RadarFrontCenter,DASy
 SG_ VFC_Obj01A_EdgeRightStdDev : 472|8@1+ (0.0002,0) [0|0.051] "unitless"  RadarFrontCenter,DASy
 SG_ VFC_Obj01A_EdgeTopStdDev : 480|8@1+ (0.0002,0) [0|0.051] "unitless"  RadarFrontCenter,DASy
 SG_ VFC_Obj01A_EdgeBottomStdDev : 488|8@1+ (0.0002,0) [0|0.051] "unitless"  RadarFrontCenter,DASy
 SG_ VFC_Obj01A_NormVx : 304|16@1+ (0.001,-40) [-40|25] "1/s"  RadarFrontCenter,DASy
 SG_ VFC_Obj01A_NormAx : 235|13@1+ (0.002,-10) [-10|6] "1/s^2"  RadarFrontCenter,DASy
 SG_ VFC_Obj01A_NormVyEdgeLeft : 256|13@1+ (0.001,-4) [-4|4] "1/s"  RadarFrontCenter,DASy
 SG_ VFC_Obj01A_NormVyEdgeRight : 281|13@1+ (0.001,-4) [-4|4] "1/s"  RadarFrontCenter,DASy
 SG_ VFC_Obj01A_NormVxStdDev : 368|10@1+ (0.001,0) [0|1.023] "1/s"  RadarFrontCenter,DASy
 SG_ VFC_Obj01A_NormAxStdDev : 328|10@1+ (0.0025,0) [0|2.5575] "1/s^2"  RadarFrontCenter,DASy
 SG_ VFC_Obj01A_NormVyEdgeLeftStdDev : 248|8@1+ (0.001,0) [0|0.255] "1/s"  RadarFrontCenter,DASy
 SG_ VFC_Obj01A_NormVyEdgeRightStdDev : 320|8@1+ (0.001,0) [0|0.255] "1/s"  RadarFrontCenter,DASy
 SG_ VFC_Obj01A_ScaleChange : 338|14@1+ (0.0001,0.5) [0.5|2.1383] "unitless"  RadarFrontCenter,DASy
 SG_ VFC_Obj01A_ScaleChngStdDev : 352|10@1+ (0.0001,0) [0|0.1023] "unitless"  RadarFrontCenter,DASy
 SG_ VFC_Obj01A_HeadingAngle : 226|9@1+ (0.01,-1.57) [-1.57|1.57] "rad"  RadarFrontCenter,DASy
 SG_ VFC_Obj01A_HeadingAngleStdDev : 186|6@1+ (0.01,0) [0|0.5] "rad"  RadarFrontCenter,DASy
 SG_ VFC_Obj01A_HeadOrientation : 460|4@1+ (1,0) [0|15] ""  RadarFrontCenter,DASy
 SG_ VFC_Obj01A_CompletelyInImg : 121|1@1+ (1,0) [0|1] ""  RadarFrontCenter,DASy
 SG_ VFC_Obj01A_ProbMovingLat : 154|6@1+ (2,0) [0|100] "%"  RadarFrontCenter,DASy
 SG_ VFC_Obj01A_ProbMovingLong : 170|6@1+ (2,0) [0|100] "%"  RadarFrontCenter,DASy
 SG_ VFC_Obj01A_ProbExist : 122|6@1+ (2,0) [0|100] "%"  RadarFrontCenter,DASy
 SG_ VFC_Obj01A_MeasSource : 91|5@1+ (1,0) [0|31] ""  RadarFrontCenter,DASy
 SG_ VFC_Obj01A_Reliability : 362|6@1+ (1,0) [0|63] ""  RadarFrontCenter,DASy
 SG_ VFC_Obj01A_Measured : 78|2@1+ (1,0) [0|3] ""  RadarFrontCenter,DASy
 SG_ VFC_Obj01A_VisibleView : 437|3@1+ (1,0) [0|4] ""  RadarFrontCenter,DASy
 SG_ VFC_Obj01A_ClassifiedView : 496|3@1+ (1,0) [0|4] ""  RadarFrontCenter,DASy
 SG_ VFC_Obj01A_DirIndicator : 106|3@1+ (1,0) [0|4] ""  RadarFrontCenter,DASy
 SG_ VFC_Obj01A_BrakeLight : 109|3@1+ (1,0) [0|7] ""  RadarFrontCenter,DASy

BO_ 180 VFC_Object02A: 64 MPC3
 SG_ VFC_Obj02A_CRC : 0|16@1+ (1,0) [0|65535] ""  RadarFrontCenter,DASy
 SG_ VFC_Obj02A_AliveCtr : 16|8@1+ (1,0) [0|255] ""  RadarFrontCenter,DASy
 SG_ VFC_Obj02A_ProtBlockCtr : 24|4@1+ (1,0) [0|15] ""  RadarFrontCenter,DASy
 SG_ VFC_Obj02A_ID : 32|8@1+ (1,0) [1|255] ""  RadarFrontCenter,DASy
 SG_ VFC_Obj02A_Type : 60|4@1+ (1,0) [0|15] ""  RadarFrontCenter,DASy
 SG_ VFC_Obj02A_TypeProb : 378|6@1+ (2,0) [0|100] "%"  RadarFrontCenter,DASy
 SG_ VFC_Obj02A_Dx : 48|12@1+ (0.05,0) [0|204.75] "m"  RadarFrontCenter,DASy
 SG_ VFC_Obj02A_Dy : 64|14@1+ (0.01,-80) [-80|80] "m"  RadarFrontCenter,DASy
 SG_ VFC_Obj02A_Vx : 80|11@1+ (0.1,-154) [-154|50] "m/s"  RadarFrontCenter,DASy
 SG_ VFC_Obj02A_Vy : 96|10@1+ (0.1,-50) [-50|50] "m/s"  RadarFrontCenter,DASy
 SG_ VFC_Obj02A_Ax : 112|9@1+ (0.1,-16) [-16|16] "m/s^2"  RadarFrontCenter,DASy
 SG_ VFC_Obj02A_Ay : 128|8@1+ (0.1,-12) [-12|12] "m/s^2"  RadarFrontCenter,DASy
 SG_ VFC_Obj02A_DxStdDev : 144|10@1+ (0.05,0) [0|51.15] "m"  RadarFrontCenter,DASy
 SG_ VFC_Obj02A_DyStdDev : 160|10@1+ (0.02,0) [0|20.46] "m"  RadarFrontCenter,DASy
 SG_ VFC_Obj02A_VxStdDev : 176|10@1+ (0.1,0) [0|102.3] "m/s"  RadarFrontCenter,DASy
 SG_ VFC_Obj02A_VyStdDev : 192|9@1+ (0.1,0) [0|51.1] "m/s"  RadarFrontCenter,DASy
 SG_ VFC_Obj02A_AxStdDev : 40|8@1+ (0.1,0) [0|25.5] "m/s^2"  RadarFrontCenter,DASy
 SG_ VFC_Obj02A_AyStdDev : 136|8@1+ (0.1,0) [0|25.5] "m/s^2"  RadarFrontCenter,DASy
 SG_ VFC_Obj02A_Length : 217|9@1+ (0.05,0) [0|25.55] "m"  RadarFrontCenter,DASy
 SG_ VFC_Obj02A_Width : 294|10@1+ (0.01,0) [0|10.23] "m"  RadarFrontCenter,DASy
 SG_ VFC_Obj02A_Height : 208|9@1+ (0.01,0) [0|5.11] "m"  RadarFrontCenter,DASy
 SG_ VFC_Obj02A_LengthStdDev : 384|7@1+ (0.05,0) [0|5] "m"  RadarFrontCenter,DASy
 SG_ VFC_Obj02A_WidthStdDev : 391|7@1+ (0.01,0) [0|1] "m"  RadarFrontCenter,DASy
 SG_ VFC_Obj02A_HeightStdDev : 201|7@1+ (0.01,0) [0|1] "m"  RadarFrontCenter,DASy
 SG_ VFC_Obj02A_EdgeLeft : 411|13@1+ (0.00025,-1) [-1|1] "unitless"  RadarFrontCenter,DASy
 SG_ VFC_Obj02A_EdgeMid : 398|13@1+ (0.00025,-1) [-1|1] "unitless"  RadarFrontCenter,DASy
 SG_ VFC_Obj02A_EdgeRight : 424|13@1+ (0.00025,-1) [-1|1] "unitless"  RadarFrontCenter,DASy
 SG_ VFC_Obj02A_EdgeTop : 448|12@1+ (0.00025,-0.5) [-0.5|0.5] "unitless"  RadarFrontCenter,DASy
 SG_ VFC_Obj02A_EdgeBottom : 269|12@1+ (0.00025,-0.5) [-0.5|0.5] "unitless"  RadarFrontCenter,DASy
 SG_ VFC_Obj02A_EdgeLeftStdDev : 440|8@1+ (0.0002,0) [0|0.051] "unitless"  RadarFrontCenter,DASy
 SG_ VFC_Obj02A_EdgeMidStdDev : 464|8@1+ (0.0002,0) [0|0.051] "unitless"  RadarFrontCenter,DASy
 SG_ VFC_Obj02A_EdgeRightStdDev : 472|8@1+ (0.0002,0) [0|0.051] "unitless"  RadarFrontCenter,DASy
 SG_ VFC_Obj02A_EdgeTopStdDev : 480|8@1+ (0.0002,0) [0|0.051] "unitless"  RadarFrontCenter,DASy
 SG_ VFC_Obj02A_EdgeBottomStdDev : 488|8@1+ (0.0002,0) [0|0.051] "unitless"  RadarFrontCenter,DASy
 SG_ VFC_Obj02A_NormVx : 304|16@1+ (0.001,-40) [-40|25] "1/s"  RadarFrontCenter,DASy
 SG_ VFC_Obj02A_NormAx : 235|13@1+ (0.002,-10) [-10|6] "1/s^2"  RadarFrontCenter,DASy
 SG_ VFC_Obj02A_NormVyEdgeLeft : 256|13@1+ (0.001,-4) [-4|4] "1/s"  RadarFrontCenter,DASy
 SG_ VFC_Obj02A_NormVyEdgeRight : 281|13@1+ (0.001,-4) [-4|4] "1/s"  RadarFrontCenter,DASy
 SG_ VFC_Obj02A_NormVxStdDev : 368|10@1+ (0.001,0) [0|1.023] "1/s"  RadarFrontCenter,DASy
 SG_ VFC_Obj02A_NormAxStdDev : 328|10@1+ (0.0025,0) [0|2.5575] "1/s^2"  RadarFrontCenter,DASy
 SG_ VFC_Obj02A_NormVyEdgeLeftStdDev : 248|8@1+ (0.001,0) [0|0.255] "1/s"  RadarFrontCenter,DASy
 SG_ VFC_Obj02A_NormVyEdgeRightStdDev : 320|8@1+ (0.001,0) [0|0.255] "1/s"  RadarFrontCenter,DASy
 SG_ VFC_Obj02A_ScaleChange : 338|14@1+ (0.0001,0.5) [0.5|2.1383] "unitless"  RadarFrontCenter,DASy
 SG_ VFC_Obj02A_ScaleChngStdDev : 352|10@1+ (0.0001,0) [0|0.1023] "unitless"  RadarFrontCenter,DASy
 SG_ VFC_Obj02A_HeadingAngle : 226|9@1+ (0.01,-1.57) [-1.57|1.57] "rad"  RadarFrontCenter,DASy
 SG_ VFC_Obj02A_HeadingAngleStdDev : 186|6@1+ (0.01,0) [0|0.5] "rad"  RadarFrontCenter,DASy
 SG_ VFC_Obj02A_HeadOrientation : 460|4@1+ (1,0) [0|15] ""  RadarFrontCenter,DASy
 SG_ VFC_Obj02A_CompletelyInImg : 121|1@1+ (1,0) [0|1] ""  RadarFrontCenter,DASy
 SG_ VFC_Obj02A_ProbMovingLat : 154|6@1+ (2,0) [0|100] "%"  RadarFrontCenter,DASy
 SG_ VFC_Obj02A_ProbMovingLong : 170|6@1+ (2,0) [0|100] "%"  RadarFrontCenter,DASy
 SG_ VFC_Obj02A_ProbExist : 122|6@1+ (2,0) [0|100] "%"  RadarFrontCenter,DASy
 SG_ VFC_Obj02A_MeasSource : 91|5@1+ (1,0) [0|31] ""  RadarFrontCenter,DASy
 SG_ VFC_Obj02A_Reliability : 362|6@1+ (1,0) [0|63] ""  RadarFrontCenter,DASy
 SG_ VFC_Obj02A_Measured : 78|2@1+ (1,0) [0|3] ""  RadarFrontCenter,DASy
 SG_ VFC_Obj02A_VisibleView : 437|3@1+ (1,0) [0|4] ""  RadarFrontCenter,DASy
 SG_ VFC_Obj02A_ClassifiedView : 496|3@1+ (1,0) [0|4] ""  RadarFrontCenter,DASy
 SG_ VFC_Obj02A_DirIndicator : 106|3@1+ (1,0) [0|4] ""  RadarFrontCenter,DASy
 SG_ VFC_Obj02A_BrakeLight : 109|3@1+ (1,0) [0|7] ""  RadarFrontCenter,DASy

BO_ 182 VFC_Object03A: 64 MPC3
 SG_ VFC_Obj03A_CRC : 0|16@1+ (1,0) [0|65535] ""  RadarFrontCenter,DASy
 SG_ VFC_Obj03A_AliveCtr : 16|8@1+ (1,0) [0|255] ""  RadarFrontCenter,DASy
 SG_ VFC_Obj03A_ProtBlockCtr : 24|4@1+ (1,0) [0|15] ""  RadarFrontCenter,DASy
 SG_ VFC_Obj03A_ID : 32|8@1+ (1,0) [1|255] ""  RadarFrontCenter,DASy
 SG_ VFC_Obj03A_Type : 60|4@1+ (1,0) [0|15] ""  RadarFrontCenter,DASy
 SG_ VFC_Obj03A_TypeProb : 378|6@1+ (2,0) [0|100] "%"  RadarFrontCenter,DASy
 SG_ VFC_Obj03A_Dx : 48|12@1+ (0.05,0) [0|204.75] "m"  RadarFrontCenter,DASy
 SG_ VFC_Obj03A_Dy : 64|14@1+ (0.01,-80) [-80|80] "m"  RadarFrontCenter,DASy
 SG_ VFC_Obj03A_Vx : 80|11@1+ (0.1,-154) [-154|50] "m/s"  RadarFrontCenter,DASy
 SG_ VFC_Obj03A_Vy : 96|10@1+ (0.1,-50) [-50|50] "m/s"  RadarFrontCenter,DASy
 SG_ VFC_Obj03A_Ax : 112|9@1+ (0.1,-16) [-16|16] "m/s^2"  RadarFrontCenter,DASy
 SG_ VFC_Obj03A_Ay : 128|8@1+ (0.1,-12) [-12|12] "m/s^2"  RadarFrontCenter,DASy
 SG_ VFC_Obj03A_DxStdDev : 144|10@1+ (0.05,0) [0|51.15] "m"  RadarFrontCenter,DASy
 SG_ VFC_Obj03A_DyStdDev : 160|10@1+ (0.02,0) [0|20.46] "m"  RadarFrontCenter,DASy
 SG_ VFC_Obj03A_VxStdDev : 176|10@1+ (0.1,0) [0|102.3] "m/s"  RadarFrontCenter,DASy
 SG_ VFC_Obj03A_VyStdDev : 192|9@1+ (0.1,0) [0|51.1] "m/s"  RadarFrontCenter,DASy
 SG_ VFC_Obj03A_AxStdDev : 40|8@1+ (0.1,0) [0|25.5] "m/s^2"  RadarFrontCenter,DASy
 SG_ VFC_Obj03A_AyStdDev : 136|8@1+ (0.1,0) [0|25.5] "m/s^2"  RadarFrontCenter,DASy
 SG_ VFC_Obj03A_Length : 217|9@1+ (0.05,0) [0|25.55] "m"  RadarFrontCenter,DASy
 SG_ VFC_Obj03A_Width : 294|10@1+ (0.01,0) [0|10.23] "m"  RadarFrontCenter,DASy
 SG_ VFC_Obj03A_Height : 208|9@1+ (0.01,0) [0|5.11] "m"  RadarFrontCenter,DASy
 SG_ VFC_Obj03A_LengthStdDev : 384|7@1+ (0.05,0) [0|5] "m"  RadarFrontCenter,DASy
 SG_ VFC_Obj03A_WidthStdDev : 391|7@1+ (0.01,0) [0|1] "m"  RadarFrontCenter,DASy
 SG_ VFC_Obj03A_HeightStdDev : 201|7@1+ (0.01,0) [0|1] "m"  RadarFrontCenter,DASy
 SG_ VFC_Obj03A_EdgeLeft : 411|13@1+ (0.00025,-1) [-1|1] "unitless"  RadarFrontCenter,DASy
 SG_ VFC_Obj03A_EdgeMid : 398|13@1+ (0.00025,-1) [-1|1] "unitless"  RadarFrontCenter,DASy
 SG_ VFC_Obj03A_EdgeRight : 424|13@1+ (0.00025,-1) [-1|1] "unitless"  RadarFrontCenter,DASy
 SG_ VFC_Obj03A_EdgeTop : 448|12@1+ (0.00025,-0.5) [-0.5|0.5] "unitless"  RadarFrontCenter,DASy
 SG_ VFC_Obj03A_EdgeBottom : 269|12@1+ (0.00025,-0.5) [-0.5|0.5] "unitless"  RadarFrontCenter,DASy
 SG_ VFC_Obj03A_EdgeLeftStdDev : 440|8@1+ (0.0002,0) [0|0.051] "unitless"  RadarFrontCenter,DASy
 SG_ VFC_Obj03A_EdgeMidStdDev : 464|8@1+ (0.0002,0) [0|0.051] "unitless"  RadarFrontCenter,DASy
 SG_ VFC_Obj03A_EdgeRightStdDev : 472|8@1+ (0.0002,0) [0|0.051] "unitless"  RadarFrontCenter,DASy
 SG_ VFC_Obj03A_EdgeTopStdDev : 480|8@1+ (0.0002,0) [0|0.051] "unitless"  RadarFrontCenter,DASy
 SG_ VFC_Obj03A_EdgeBottomStdDev : 488|8@1+ (0.0002,0) [0|0.051] "unitless"  RadarFrontCenter,DASy
 SG_ VFC_Obj03A_NormVx : 304|16@1+ (0.001,-40) [-40|25] "1/s"  RadarFrontCenter,DASy
 SG_ VFC_Obj03A_NormAx : 235|13@1+ (0.002,-10) [-10|6] "1/s^2"  RadarFrontCenter,DASy
 SG_ VFC_Obj03A_NormVyEdgeLeft : 256|13@1+ (0.001,-4) [-4|4] "1/s"  RadarFrontCenter,DASy
 SG_ VFC_Obj03A_NormVyEdgeRight : 281|13@1+ (0.001,-4) [-4|4] "1/s"  RadarFrontCenter,DASy
 SG_ VFC_Obj03A_NormVxStdDev : 368|10@1+ (0.001,0) [0|1.023] "1/s"  RadarFrontCenter,DASy
 SG_ VFC_Obj03A_NormAxStdDev : 328|10@1+ (0.0025,0) [0|2.5575] "1/s^2"  RadarFrontCenter,DASy
 SG_ VFC_Obj03A_NormVyEdgeLeftStdDev : 248|8@1+ (0.001,0) [0|0.255] "1/s"  RadarFrontCenter,DASy
 SG_ VFC_Obj03A_NormVyEdgeRightStdDev : 320|8@1+ (0.001,0) [0|0.255] "1/s"  RadarFrontCenter,DASy
 SG_ VFC_Obj03A_ScaleChange : 338|14@1+ (0.0001,0.5) [0.5|2.1383] "unitless"  RadarFrontCenter,DASy
 SG_ VFC_Obj03A_ScaleChngStdDev : 352|10@1+ (0.0001,0) [0|0.1023] "unitless"  RadarFrontCenter,DASy
 SG_ VFC_Obj03A_HeadingAngle : 226|9@1+ (0.01,-1.57) [-1.57|1.57] "rad"  RadarFrontCenter,DASy
 SG_ VFC_Obj03A_HeadingAngleStdDev : 186|6@1+ (0.01,0) [0|0.5] "rad"  RadarFrontCenter,DASy
 SG_ VFC_Obj03A_HeadOrientation : 460|4@1+ (1,0) [0|15] ""  RadarFrontCenter,DASy
 SG_ VFC_Obj03A_CompletelyInImg : 121|1@1+ (1,0) [0|1] ""  RadarFrontCenter,DASy
 SG_ VFC_Obj03A_ProbMovingLat : 154|6@1+ (2,0) [0|100] "%"  RadarFrontCenter,DASy
 SG_ VFC_Obj03A_ProbMovingLong : 170|6@1+ (2,0) [0|100] "%"  RadarFrontCenter,DASy
 SG_ VFC_Obj03A_ProbExist : 122|6@1+ (2,0) [0|100] "%"  RadarFrontCenter,DASy
 SG_ VFC_Obj03A_MeasSource : 91|5@1+ (1,0) [0|31] ""  RadarFrontCenter,DASy
 SG_ VFC_Obj03A_Reliability : 362|6@1+ (1,0) [0|63] ""  RadarFrontCenter,DASy
 SG_ VFC_Obj03A_Measured : 78|2@1+ (1,0) [0|3] ""  RadarFrontCenter,DASy
 SG_ VFC_Obj03A_VisibleView : 437|3@1+ (1,0) [0|4] ""  RadarFrontCenter,DASy
 SG_ VFC_Obj03A_ClassifiedView : 496|3@1+ (1,0) [0|4] ""  RadarFrontCenter,DASy
 SG_ VFC_Obj03A_DirIndicator : 106|3@1+ (1,0) [0|4] ""  RadarFrontCenter,DASy
 SG_ VFC_Obj03A_BrakeLight : 109|3@1+ (1,0) [0|7] ""  RadarFrontCenter,DASy

BO_ 184 VFC_Object04A: 64 MPC3
 SG_ VFC_Obj04A_CRC : 0|16@1+ (1,0) [0|65535] ""  RadarFrontCenter,DASy
 SG_ VFC_Obj04A_AliveCtr : 16|8@1+ (1,0) [0|255] ""  RadarFrontCenter,DASy
 SG_ VFC_Obj04A_ProtBlockCtr : 24|4@1+ (1,0) [0|15] ""  RadarFrontCenter,DASy
 SG_ VFC_Obj04A_ID : 32|8@1+ (1,0) [1|255] ""  RadarFrontCenter,DASy
 SG_ VFC_Obj04A_Type : 60|4@1+ (1,0) [0|15] ""  RadarFrontCenter,DASy
 SG_ VFC_Obj04A_TypeProb : 378|6@1+ (2,0) [0|100] "%"  RadarFrontCenter,DASy
 SG_ VFC_Obj04A_Dx : 48|12@1+ (0.05,0) [0|204.75] "m"  RadarFrontCenter,DASy
 SG_ VFC_Obj04A_Dy : 64|14@1+ (0.01,-80) [-80|80] "m"  RadarFrontCenter,DASy
 SG_ VFC_Obj04A_Vx : 80|11@1+ (0.1,-154) [-154|50] "m/s"  RadarFrontCenter,DASy
 SG_ VFC_Obj04A_Vy : 96|10@1+ (0.1,-50) [-50|50] "m/s"  RadarFrontCenter,DASy
 SG_ VFC_Obj04A_Ax : 112|9@1+ (0.1,-16) [-16|16] "m/s^2"  RadarFrontCenter,DASy
 SG_ VFC_Obj04A_Ay : 128|8@1+ (0.1,-12) [-12|12] "m/s^2"  RadarFrontCenter,DASy
 SG_ VFC_Obj04A_DxStdDev : 144|10@1+ (0.05,0) [0|51.15] "m"  RadarFrontCenter,DASy
 SG_ VFC_Obj04A_DyStdDev : 160|10@1+ (0.02,0) [0|20.46] "m"  RadarFrontCenter,DASy
 SG_ VFC_Obj04A_VxStdDev : 176|10@1+ (0.1,0) [0|102.3] "m/s"  RadarFrontCenter,DASy
 SG_ VFC_Obj04A_VyStdDev : 192|9@1+ (0.1,0) [0|51.1] "m/s"  RadarFrontCenter,DASy
 SG_ VFC_Obj04A_AxStdDev : 40|8@1+ (0.1,0) [0|25.5] "m/s^2"  RadarFrontCenter,DASy
 SG_ VFC_Obj04A_AyStdDev : 136|8@1+ (0.1,0) [0|25.5] "m/s^2"  RadarFrontCenter,DASy
 SG_ VFC_Obj04A_Length : 217|9@1+ (0.05,0) [0|25.55] "m"  RadarFrontCenter,DASy
 SG_ VFC_Obj04A_Width : 294|10@1+ (0.01,0) [0|10.23] "m"  RadarFrontCenter,DASy
 SG_ VFC_Obj04A_Height : 208|9@1+ (0.01,0) [0|5.11] "m"  RadarFrontCenter,DASy
 SG_ VFC_Obj04A_LengthStdDev : 384|7@1+ (0.05,0) [0|5] "m"  RadarFrontCenter,DASy
 SG_ VFC_Obj04A_WidthStdDev : 391|7@1+ (0.01,0) [0|1] "m"  RadarFrontCenter,DASy
 SG_ VFC_Obj04A_HeightStdDev : 201|7@1+ (0.01,0) [0|1] "m"  RadarFrontCenter,DASy
 SG_ VFC_Obj04A_EdgeLeft : 411|13@1+ (0.00025,-1) [-1|1] "unitless"  RadarFrontCenter,DASy
 SG_ VFC_Obj04A_EdgeMid : 398|13@1+ (0.00025,-1) [-1|1] "unitless"  RadarFrontCenter,DASy
 SG_ VFC_Obj04A_EdgeRight : 424|13@1+ (0.00025,-1) [-1|1] "unitless"  RadarFrontCenter,DASy
 SG_ VFC_Obj04A_EdgeTop : 448|12@1+ (0.00025,-0.5) [-0.5|0.5] "unitless"  RadarFrontCenter,DASy
 SG_ VFC_Obj04A_EdgeBottom : 269|12@1+ (0.00025,-0.5) [-0.5|0.5] "unitless"  RadarFrontCenter,DASy
 SG_ VFC_Obj04A_EdgeLeftStdDev : 440|8@1+ (0.0002,0) [0|0.051] "unitless"  RadarFrontCenter,DASy
 SG_ VFC_Obj04A_EdgeMidStdDev : 464|8@1+ (0.0002,0) [0|0.051] "unitless"  RadarFrontCenter,DASy
 SG_ VFC_Obj04A_EdgeRightStdDev : 472|8@1+ (0.0002,0) [0|0.051] "unitless"  RadarFrontCenter,DASy
 SG_ VFC_Obj04A_EdgeTopStdDev : 480|8@1+ (0.0002,0) [0|0.051] "unitless"  RadarFrontCenter,DASy
 SG_ VFC_Obj04A_EdgeBottomStdDev : 488|8@1+ (0.0002,0) [0|0.051] "unitless"  RadarFrontCenter,DASy
 SG_ VFC_Obj04A_NormVx : 304|16@1+ (0.001,-40) [-40|25] "1/s"  RadarFrontCenter,DASy
 SG_ VFC_Obj04A_NormAx : 235|13@1+ (0.002,-10) [-10|6] "1/s^2"  RadarFrontCenter,DASy
 SG_ VFC_Obj04A_NormVyEdgeLeft : 256|13@1+ (0.001,-4) [-4|4] "1/s"  RadarFrontCenter,DASy
 SG_ VFC_Obj04A_NormVyEdgeRight : 281|13@1+ (0.001,-4) [-4|4] "1/s"  RadarFrontCenter,DASy
 SG_ VFC_Obj04A_NormVxStdDev : 368|10@1+ (0.001,0) [0|1.023] "1/s"  RadarFrontCenter,DASy
 SG_ VFC_Obj04A_NormAxStdDev : 328|10@1+ (0.0025,0) [0|2.5575] "1/s^2"  RadarFrontCenter,DASy
 SG_ VFC_Obj04A_NormVyEdgeLeftStdDev : 248|8@1+ (0.001,0) [0|0.255] "1/s"  RadarFrontCenter,DASy
 SG_ VFC_Obj04A_NormVyEdgeRightStdDev : 320|8@1+ (0.001,0) [0|0.255] "1/s"  RadarFrontCenter,DASy
 SG_ VFC_Obj04A_ScaleChange : 338|14@1+ (0.0001,0.5) [0.5|2.1383] "unitless"  RadarFrontCenter,DASy
 SG_ VFC_Obj04A_ScaleChngStdDev : 352|10@1+ (0.0001,0) [0|0.1023] "unitless"  RadarFrontCenter,DASy
 SG_ VFC_Obj04A_HeadingAngle : 226|9@1+ (0.01,-1.57) [-1.57|1.57] "rad"  RadarFrontCenter,DASy
 SG_ VFC_Obj04A_HeadingAngleStdDev : 186|6@1+ (0.01,0) [0|0.5] "rad"  RadarFrontCenter,DASy
 SG_ VFC_Obj04A_HeadOrientation : 460|4@1+ (1,0) [0|15] ""  RadarFrontCenter,DASy
 SG_ VFC_Obj04A_CompletelyInImg : 121|1@1+ (1,0) [0|1] ""  RadarFrontCenter,DASy
 SG_ VFC_Obj04A_ProbMovingLat : 154|6@1+ (2,0) [0|100] "%"  RadarFrontCenter,DASy
 SG_ VFC_Obj04A_ProbMovingLong : 170|6@1+ (2,0) [0|100] "%"  RadarFrontCenter,DASy
 SG_ VFC_Obj04A_ProbExist : 122|6@1+ (2,0) [0|100] "%"  RadarFrontCenter,DASy
 SG_ VFC_Obj04A_MeasSource : 91|5@1+ (1,0) [0|31] ""  RadarFrontCenter,DASy
 SG_ VFC_Obj04A_Reliability : 362|6@1+ (1,0) [0|63] ""  RadarFrontCenter,DASy
 SG_ VFC_Obj04A_Measured : 78|2@1+ (1,0) [0|3] ""  RadarFrontCenter,DASy
 SG_ VFC_Obj04A_VisibleView : 437|3@1+ (1,0) [0|4] ""  RadarFrontCenter,DASy
 SG_ VFC_Obj04A_ClassifiedView : 496|3@1+ (1,0) [0|4] ""  RadarFrontCenter,DASy
 SG_ VFC_Obj04A_DirIndicator : 106|3@1+ (1,0) [0|4] ""  RadarFrontCenter,DASy
 SG_ VFC_Obj04A_BrakeLight : 109|3@1+ (1,0) [0|7] ""  RadarFrontCenter,DASy

BO_ 186 VFC_Object05A: 64 MPC3
 SG_ VFC_Obj05A_CRC : 0|16@1+ (1,0) [0|65535] ""  RadarFrontCenter,DASy
 SG_ VFC_Obj05A_AliveCtr : 16|8@1+ (1,0) [0|255] ""  RadarFrontCenter,DASy
 SG_ VFC_Obj05A_ProtBlockCtr : 24|4@1+ (1,0) [0|15] ""  RadarFrontCenter,DASy
 SG_ VFC_Obj05A_ID : 32|8@1+ (1,0) [1|255] ""  RadarFrontCenter,DASy
 SG_ VFC_Obj05A_Type : 60|4@1+ (1,0) [0|15] ""  RadarFrontCenter,DASy
 SG_ VFC_Obj05A_TypeProb : 378|6@1+ (2,0) [0|100] "%"  RadarFrontCenter,DASy
 SG_ VFC_Obj05A_Dx : 48|12@1+ (0.05,0) [0|204.75] "m"  RadarFrontCenter,DASy
 SG_ VFC_Obj05A_Dy : 64|14@1+ (0.01,-80) [-80|80] "m"  RadarFrontCenter,DASy
 SG_ VFC_Obj05A_Vx : 80|11@1+ (0.1,-154) [-154|50] "m/s"  RadarFrontCenter,DASy
 SG_ VFC_Obj05A_Vy : 96|10@1+ (0.1,-50) [-50|50] "m/s"  RadarFrontCenter,DASy
 SG_ VFC_Obj05A_Ax : 112|9@1+ (0.1,-16) [-16|16] "m/s^2"  RadarFrontCenter,DASy
 SG_ VFC_Obj05A_Ay : 128|8@1+ (0.1,-12) [-12|12] "m/s^2"  RadarFrontCenter,DASy
 SG_ VFC_Obj05A_DxStdDev : 144|10@1+ (0.05,0) [0|51.15] "m"  RadarFrontCenter,DASy
 SG_ VFC_Obj05A_DyStdDev : 160|10@1+ (0.02,0) [0|20.46] "m"  RadarFrontCenter,DASy
 SG_ VFC_Obj05A_VxStdDev : 176|10@1+ (0.1,0) [0|102.3] "m/s"  RadarFrontCenter,DASy
 SG_ VFC_Obj05A_VyStdDev : 192|9@1+ (0.1,0) [0|51.1] "m/s"  RadarFrontCenter,DASy
 SG_ VFC_Obj05A_AxStdDev : 40|8@1+ (0.1,0) [0|25.5] "m/s^2"  RadarFrontCenter,DASy
 SG_ VFC_Obj05A_AyStdDev : 136|8@1+ (0.1,0) [0|25.5] "m/s^2"  RadarFrontCenter,DASy
 SG_ VFC_Obj05A_Length : 217|9@1+ (0.05,0) [0|25.55] "m"  RadarFrontCenter,DASy
 SG_ VFC_Obj05A_Width : 294|10@1+ (0.01,0) [0|10.23] "m"  RadarFrontCenter,DASy
 SG_ VFC_Obj05A_Height : 208|9@1+ (0.01,0) [0|5.11] "m"  RadarFrontCenter,DASy
 SG_ VFC_Obj05A_LengthStdDev : 384|7@1+ (0.05,0) [0|5] "m"  RadarFrontCenter,DASy
 SG_ VFC_Obj05A_WidthStdDev : 391|7@1+ (0.01,0) [0|1] "m"  RadarFrontCenter,DASy
 SG_ VFC_Obj05A_HeightStdDev : 201|7@1+ (0.01,0) [0|1] "m"  RadarFrontCenter,DASy
 SG_ VFC_Obj05A_EdgeLeft : 411|13@1+ (0.00025,-1) [-1|1] "unitless"  RadarFrontCenter,DASy
 SG_ VFC_Obj05A_EdgeMid : 398|13@1+ (0.00025,-1) [-1|1] "unitless"  RadarFrontCenter,DASy
 SG_ VFC_Obj05A_EdgeRight : 424|13@1+ (0.00025,-1) [-1|1] "unitless"  RadarFrontCenter,DASy
 SG_ VFC_Obj05A_EdgeTop : 448|12@1+ (0.00025,-0.5) [-0.5|0.5] "unitless"  RadarFrontCenter,DASy
 SG_ VFC_Obj05A_EdgeBottom : 269|12@1+ (0.00025,-0.5) [-0.5|0.5] "unitless"  RadarFrontCenter,DASy
 SG_ VFC_Obj05A_EdgeLeftStdDev : 440|8@1+ (0.0002,0) [0|0.051] "unitless"  RadarFrontCenter,DASy
 SG_ VFC_Obj05A_EdgeMidStdDev : 464|8@1+ (0.0002,0) [0|0.051] "unitless"  RadarFrontCenter,DASy
 SG_ VFC_Obj05A_EdgeRightStdDev : 472|8@1+ (0.0002,0) [0|0.051] "unitless"  RadarFrontCenter,DASy
 SG_ VFC_Obj05A_EdgeTopStdDev : 480|8@1+ (0.0002,0) [0|0.051] "unitless"  RadarFrontCenter,DASy
 SG_ VFC_Obj05A_EdgeBottomStdDev : 488|8@1+ (0.0002,0) [0|0.051] "unitless"  RadarFrontCenter,DASy
 SG_ VFC_Obj05A_NormVx : 304|16@1+ (0.001,-40) [-40|25] "1/s"  RadarFrontCenter,DASy
 SG_ VFC_Obj05A_NormAx : 235|13@1+ (0.002,-10) [-10|6] "1/s^2"  RadarFrontCenter,DASy
 SG_ VFC_Obj05A_NormVyEdgeLeft : 256|13@1+ (0.001,-4) [-4|4] "1/s"  RadarFrontCenter,DASy
 SG_ VFC_Obj05A_NormVyEdgeRight : 281|13@1+ (0.001,-4) [-4|4] "1/s"  RadarFrontCenter,DASy
 SG_ VFC_Obj05A_NormVxStdDev : 368|10@1+ (0.001,0) [0|1.023] "1/s"  RadarFrontCenter,DASy
 SG_ VFC_Obj05A_NormAxStdDev : 328|10@1+ (0.0025,0) [0|2.5575] "1/s^2"  RadarFrontCenter,DASy
 SG_ VFC_Obj05A_NormVyEdgeLeftStdDev : 248|8@1+ (0.001,0) [0|0.255] "1/s"  RadarFrontCenter,DASy
 SG_ VFC_Obj05A_NormVyEdgeRightStdDev : 320|8@1+ (0.001,0) [0|0.255] "1/s"  RadarFrontCenter,DASy
 SG_ VFC_Obj05A_ScaleChange : 338|14@1+ (0.0001,0.5) [0.5|2.1383] "unitless"  RadarFrontCenter,DASy
 SG_ VFC_Obj05A_ScaleChngStdDev : 352|10@1+ (0.0001,0) [0|0.1023] "unitless"  RadarFrontCenter,DASy
 SG_ VFC_Obj05A_HeadingAngle : 226|9@1+ (0.01,-1.57) [-1.57|1.57] "rad"  RadarFrontCenter,DASy
 SG_ VFC_Obj05A_HeadingAngleStdDev : 186|6@1+ (0.01,0) [0|0.5] "rad"  RadarFrontCenter,DASy
 SG_ VFC_Obj05A_HeadOrientation : 460|4@1+ (1,0) [0|15] ""  RadarFrontCenter,DASy
 SG_ VFC_Obj05A_CompletelyInImg : 121|1@1+ (1,0) [0|1] ""  RadarFrontCenter,DASy
 SG_ VFC_Obj05A_ProbMovingLat : 154|6@1+ (2,0) [0|100] "%"  RadarFrontCenter,DASy
 SG_ VFC_Obj05A_ProbMovingLong : 170|6@1+ (2,0) [0|100] "%"  RadarFrontCenter,DASy
 SG_ VFC_Obj05A_ProbExist : 122|6@1+ (2,0) [0|100] "%"  RadarFrontCenter,DASy
 SG_ VFC_Obj05A_MeasSource : 91|5@1+ (1,0) [0|31] ""  RadarFrontCenter,DASy
 SG_ VFC_Obj05A_Reliability : 362|6@1+ (1,0) [0|63] ""  RadarFrontCenter,DASy
 SG_ VFC_Obj05A_Measured : 78|2@1+ (1,0) [0|3] ""  RadarFrontCenter,DASy
 SG_ VFC_Obj05A_VisibleView : 437|3@1+ (1,0) [0|4] ""  RadarFrontCenter,DASy
 SG_ VFC_Obj05A_ClassifiedView : 496|3@1+ (1,0) [0|4] ""  RadarFrontCenter,DASy
 SG_ VFC_Obj05A_DirIndicator : 106|3@1+ (1,0) [0|4] ""  RadarFrontCenter,DASy
 SG_ VFC_Obj05A_BrakeLight : 109|3@1+ (1,0) [0|7] ""  RadarFrontCenter,DASy

BO_ 188 VFC_Object06A: 64 MPC3
 SG_ VFC_Obj06A_CRC : 0|16@1+ (1,0) [0|65535] ""  RadarFrontCenter,DASy
 SG_ VFC_Obj06A_AliveCtr : 16|8@1+ (1,0) [0|255] ""  RadarFrontCenter,DASy
 SG_ VFC_Obj06A_ProtBlockCtr : 24|4@1+ (1,0) [0|15] ""  RadarFrontCenter,DASy
 SG_ VFC_Obj06A_ID : 32|8@1+ (1,0) [1|255] ""  RadarFrontCenter,DASy
 SG_ VFC_Obj06A_Type : 60|4@1+ (1,0) [0|15] ""  RadarFrontCenter,DASy
 SG_ VFC_Obj06A_TypeProb : 378|6@1+ (2,0) [0|100] "%"  RadarFrontCenter,DASy
 SG_ VFC_Obj06A_Dx : 48|12@1+ (0.05,0) [0|204.75] "m"  RadarFrontCenter,DASy
 SG_ VFC_Obj06A_Dy : 64|14@1+ (0.01,-80) [-80|80] "m"  RadarFrontCenter,DASy
 SG_ VFC_Obj06A_Vx : 80|11@1+ (0.1,-154) [-154|50] "m/s"  RadarFrontCenter,DASy
 SG_ VFC_Obj06A_Vy : 96|10@1+ (0.1,-50) [-50|50] "m/s"  RadarFrontCenter,DASy
 SG_ VFC_Obj06A_Ax : 112|9@1+ (0.1,-16) [-16|16] "m/s^2"  RadarFrontCenter,DASy
 SG_ VFC_Obj06A_Ay : 128|8@1+ (0.1,-12) [-12|12] "m/s^2"  RadarFrontCenter,DASy
 SG_ VFC_Obj06A_DxStdDev : 144|10@1+ (0.05,0) [0|51.15] "m"  RadarFrontCenter,DASy
 SG_ VFC_Obj06A_DyStdDev : 160|10@1+ (0.02,0) [0|20.46] "m"  RadarFrontCenter,DASy
 SG_ VFC_Obj06A_VxStdDev : 176|10@1+ (0.1,0) [0|102.3] "m/s"  RadarFrontCenter,DASy
 SG_ VFC_Obj06A_VyStdDev : 192|9@1+ (0.1,0) [0|51.1] "m/s"  RadarFrontCenter,DASy
 SG_ VFC_Obj06A_AxStdDev : 40|8@1+ (0.1,0) [0|25.5] "m/s^2"  RadarFrontCenter,DASy
 SG_ VFC_Obj06A_AyStdDev : 136|8@1+ (0.1,0) [0|25.5] "m/s^2"  RadarFrontCenter,DASy
 SG_ VFC_Obj06A_Length : 217|9@1+ (0.05,0) [0|25.55] "m"  RadarFrontCenter,DASy
 SG_ VFC_Obj06A_Width : 294|10@1+ (0.01,0) [0|10.23] "m"  RadarFrontCenter,DASy
 SG_ VFC_Obj06A_Height : 208|9@1+ (0.01,0) [0|5.11] "m"  RadarFrontCenter,DASy
 SG_ VFC_Obj06A_LengthStdDev : 384|7@1+ (0.05,0) [0|5] "m"  RadarFrontCenter,DASy
 SG_ VFC_Obj06A_WidthStdDev : 391|7@1+ (0.01,0) [0|1] "m"  RadarFrontCenter,DASy
 SG_ VFC_Obj06A_HeightStdDev : 201|7@1+ (0.01,0) [0|1] "m"  RadarFrontCenter,DASy
 SG_ VFC_Obj06A_EdgeLeft : 411|13@1+ (0.00025,-1) [-1|1] "unitless"  RadarFrontCenter,DASy
 SG_ VFC_Obj06A_EdgeMid : 398|13@1+ (0.00025,-1) [-1|1] "unitless"  RadarFrontCenter,DASy
 SG_ VFC_Obj06A_EdgeRight : 424|13@1+ (0.00025,-1) [-1|1] "unitless"  RadarFrontCenter,DASy
 SG_ VFC_Obj06A_EdgeTop : 448|12@1+ (0.00025,-0.5) [-0.5|0.5] "unitless"  RadarFrontCenter,DASy
 SG_ VFC_Obj06A_EdgeBottom : 269|12@1+ (0.00025,-0.5) [-0.5|0.5] "unitless"  RadarFrontCenter,DASy
 SG_ VFC_Obj06A_EdgeLeftStdDev : 440|8@1+ (0.0002,0) [0|0.051] "unitless"  RadarFrontCenter,DASy
 SG_ VFC_Obj06A_EdgeMidStdDev : 464|8@1+ (0.0002,0) [0|0.051] "unitless"  RadarFrontCenter,DASy
 SG_ VFC_Obj06A_EdgeRightStdDev : 472|8@1+ (0.0002,0) [0|0.051] "unitless"  RadarFrontCenter,DASy
 SG_ VFC_Obj06A_EdgeTopStdDev : 480|8@1+ (0.0002,0) [0|0.051] "unitless"  RadarFrontCenter,DASy
 SG_ VFC_Obj06A_EdgeBottomStdDev : 488|8@1+ (0.0002,0) [0|0.051] "unitless"  RadarFrontCenter,DASy
 SG_ VFC_Obj06A_NormVx : 304|16@1+ (0.001,-40) [-40|25] "1/s"  RadarFrontCenter,DASy
 SG_ VFC_Obj06A_NormAx : 235|13@1+ (0.002,-10) [-10|6] "1/s^2"  RadarFrontCenter,DASy
 SG_ VFC_Obj06A_NormVyEdgeLeft : 256|13@1+ (0.001,-4) [-4|4] "1/s"  RadarFrontCenter,DASy
 SG_ VFC_Obj06A_NormVyEdgeRight : 281|13@1+ (0.001,-4) [-4|4] "1/s"  RadarFrontCenter,DASy
 SG_ VFC_Obj06A_NormVxStdDev : 368|10@1+ (0.001,0) [0|1.023] "1/s"  RadarFrontCenter,DASy
 SG_ VFC_Obj06A_NormAxStdDev : 328|10@1+ (0.0025,0) [0|2.5575] "1/s^2"  RadarFrontCenter,DASy
 SG_ VFC_Obj06A_NormVyEdgeLeftStdDev : 248|8@1+ (0.001,0) [0|0.255] "1/s"  RadarFrontCenter,DASy
 SG_ VFC_Obj06A_NormVyEdgeRightStdDev : 320|8@1+ (0.001,0) [0|0.255] "1/s"  RadarFrontCenter,DASy
 SG_ VFC_Obj06A_ScaleChange : 338|14@1+ (0.0001,0.5) [0.5|2.1383] "unitless"  RadarFrontCenter,DASy
 SG_ VFC_Obj06A_ScaleChngStdDev : 352|10@1+ (0.0001,0) [0|0.1023] "unitless"  RadarFrontCenter,DASy
 SG_ VFC_Obj06A_HeadingAngle : 226|9@1+ (0.01,-1.57) [-1.57|1.57] "rad"  RadarFrontCenter,DASy
 SG_ VFC_Obj06A_HeadingAngleStdDev : 186|6@1+ (0.01,0) [0|0.5] "rad"  RadarFrontCenter,DASy
 SG_ VFC_Obj06A_HeadOrientation : 460|4@1+ (1,0) [0|15] ""  RadarFrontCenter,DASy
 SG_ VFC_Obj06A_CompletelyInImg : 121|1@1+ (1,0) [0|1] ""  RadarFrontCenter,DASy
 SG_ VFC_Obj06A_ProbMovingLat : 154|6@1+ (2,0) [0|100] "%"  RadarFrontCenter,DASy
 SG_ VFC_Obj06A_ProbMovingLong : 170|6@1+ (2,0) [0|100] "%"  RadarFrontCenter,DASy
 SG_ VFC_Obj06A_ProbExist : 122|6@1+ (2,0) [0|100] "%"  RadarFrontCenter,DASy
 SG_ VFC_Obj06A_MeasSource : 91|5@1+ (1,0) [0|31] ""  RadarFrontCenter,DASy
 SG_ VFC_Obj06A_Reliability : 362|6@1+ (1,0) [0|63] ""  RadarFrontCenter,DASy
 SG_ VFC_Obj06A_Measured : 78|2@1+ (1,0) [0|3] ""  RadarFrontCenter,DASy
 SG_ VFC_Obj06A_VisibleView : 437|3@1+ (1,0) [0|4] ""  RadarFrontCenter,DASy
 SG_ VFC_Obj06A_ClassifiedView : 496|3@1+ (1,0) [0|4] ""  RadarFrontCenter,DASy
 SG_ VFC_Obj06A_DirIndicator : 106|3@1+ (1,0) [0|4] ""  RadarFrontCenter,DASy
 SG_ VFC_Obj06A_BrakeLight : 109|3@1+ (1,0) [0|7] ""  RadarFrontCenter,DASy

BO_ 190 VFC_Object07A: 64 MPC3
 SG_ VFC_Obj07A_CRC : 0|16@1+ (1,0) [0|65535] ""  RadarFrontCenter,DASy
 SG_ VFC_Obj07A_AliveCtr : 16|8@1+ (1,0) [0|255] ""  RadarFrontCenter,DASy
 SG_ VFC_Obj07A_ProtBlockCtr : 24|4@1+ (1,0) [0|15] ""  RadarFrontCenter,DASy
 SG_ VFC_Obj07A_ID : 32|8@1+ (1,0) [1|255] ""  RadarFrontCenter,DASy
 SG_ VFC_Obj07A_Type : 60|4@1+ (1,0) [0|15] ""  RadarFrontCenter,DASy
 SG_ VFC_Obj07A_TypeProb : 378|6@1+ (2,0) [0|100] "%"  RadarFrontCenter,DASy
 SG_ VFC_Obj07A_Dx : 48|12@1+ (0.05,0) [0|204.75] "m"  RadarFrontCenter,DASy
 SG_ VFC_Obj07A_Dy : 64|14@1+ (0.01,-80) [-80|80] "m"  RadarFrontCenter,DASy
 SG_ VFC_Obj07A_Vx : 80|11@1+ (0.1,-154) [-154|50] "m/s"  RadarFrontCenter,DASy
 SG_ VFC_Obj07A_Vy : 96|10@1+ (0.1,-50) [-50|50] "m/s"  RadarFrontCenter,DASy
 SG_ VFC_Obj07A_Ax : 112|9@1+ (0.1,-16) [-16|16] "m/s^2"  RadarFrontCenter,DASy
 SG_ VFC_Obj07A_Ay : 128|8@1+ (0.1,-12) [-12|12] "m/s^2"  RadarFrontCenter,DASy
 SG_ VFC_Obj07A_DxStdDev : 144|10@1+ (0.05,0) [0|51.15] "m"  RadarFrontCenter,DASy
 SG_ VFC_Obj07A_DyStdDev : 160|10@1+ (0.02,0) [0|20.46] "m"  RadarFrontCenter,DASy
 SG_ VFC_Obj07A_VxStdDev : 176|10@1+ (0.1,0) [0|102.3] "m/s"  RadarFrontCenter,DASy
 SG_ VFC_Obj07A_VyStdDev : 192|9@1+ (0.1,0) [0|51.1] "m/s"  RadarFrontCenter,DASy
 SG_ VFC_Obj07A_AxStdDev : 40|8@1+ (0.1,0) [0|25.5] "m/s^2"  RadarFrontCenter,DASy
 SG_ VFC_Obj07A_AyStdDev : 136|8@1+ (0.1,0) [0|25.5] "m/s^2"  RadarFrontCenter,DASy
 SG_ VFC_Obj07A_Length : 217|9@1+ (0.05,0) [0|25.55] "m"  RadarFrontCenter,DASy
 SG_ VFC_Obj07A_Width : 294|10@1+ (0.01,0) [0|10.23] "m"  RadarFrontCenter,DASy
 SG_ VFC_Obj07A_Height : 208|9@1+ (0.01,0) [0|5.11] "m"  RadarFrontCenter,DASy
 SG_ VFC_Obj07A_LengthStdDev : 384|7@1+ (0.05,0) [0|5] "m"  RadarFrontCenter,DASy
 SG_ VFC_Obj07A_WidthStdDev : 391|7@1+ (0.01,0) [0|1] "m"  RadarFrontCenter,DASy
 SG_ VFC_Obj07A_HeightStdDev : 201|7@1+ (0.01,0) [0|1] "m"  RadarFrontCenter,DASy
 SG_ VFC_Obj07A_EdgeLeft : 411|13@1+ (0.00025,-1) [-1|1] "unitless"  RadarFrontCenter,DASy
 SG_ VFC_Obj07A_EdgeMid : 398|13@1+ (0.00025,-1) [-1|1] "unitless"  RadarFrontCenter,DASy
 SG_ VFC_Obj07A_EdgeRight : 424|13@1+ (0.00025,-1) [-1|1] "unitless"  RadarFrontCenter,DASy
 SG_ VFC_Obj07A_EdgeTop : 448|12@1+ (0.00025,-0.5) [-0.5|0.5] "unitless"  RadarFrontCenter,DASy
 SG_ VFC_Obj07A_EdgeBottom : 269|12@1+ (0.00025,-0.5) [-0.5|0.5] "unitless"  RadarFrontCenter,DASy
 SG_ VFC_Obj07A_EdgeLeftStdDev : 440|8@1+ (0.0002,0) [0|0.051] "unitless"  RadarFrontCenter,DASy
 SG_ VFC_Obj07A_EdgeMidStdDev : 464|8@1+ (0.0002,0) [0|0.051] "unitless"  RadarFrontCenter,DASy
 SG_ VFC_Obj07A_EdgeRightStdDev : 472|8@1+ (0.0002,0) [0|0.051] "unitless"  RadarFrontCenter,DASy
 SG_ VFC_Obj07A_EdgeTopStdDev : 480|8@1+ (0.0002,0) [0|0.051] "unitless"  RadarFrontCenter,DASy
 SG_ VFC_Obj07A_EdgeBottomStdDev : 488|8@1+ (0.0002,0) [0|0.051] "unitless"  RadarFrontCenter,DASy
 SG_ VFC_Obj07A_NormVx : 304|16@1+ (0.001,-40) [-40|25] "1/s"  RadarFrontCenter,DASy
 SG_ VFC_Obj07A_NormAx : 235|13@1+ (0.002,-10) [-10|6] "1/s^2"  RadarFrontCenter,DASy
 SG_ VFC_Obj07A_NormVyEdgeLeft : 256|13@1+ (0.001,-4) [-4|4] "1/s"  RadarFrontCenter,DASy
 SG_ VFC_Obj07A_NormVyEdgeRight : 281|13@1+ (0.001,-4) [-4|4] "1/s"  RadarFrontCenter,DASy
 SG_ VFC_Obj07A_NormVxStdDev : 368|10@1+ (0.001,0) [0|1.023] "1/s"  RadarFrontCenter,DASy
 SG_ VFC_Obj07A_NormAxStdDev : 328|10@1+ (0.0025,0) [0|2.5575] "1/s^2"  RadarFrontCenter,DASy
 SG_ VFC_Obj07A_NormVyEdgeLeftStdDev : 248|8@1+ (0.001,0) [0|0.255] "1/s"  RadarFrontCenter,DASy
 SG_ VFC_Obj07A_NormVyEdgeRightStdDev : 320|8@1+ (0.001,0) [0|0.255] "1/s"  RadarFrontCenter,DASy
 SG_ VFC_Obj07A_ScaleChange : 338|14@1+ (0.0001,0.5) [0.5|2.1383] "unitless"  RadarFrontCenter,DASy
 SG_ VFC_Obj07A_ScaleChngStdDev : 352|10@1+ (0.0001,0) [0|0.1023] "unitless"  RadarFrontCenter,DASy
 SG_ VFC_Obj07A_HeadingAngle : 226|9@1+ (0.01,-1.57) [-1.57|1.57] "rad"  RadarFrontCenter,DASy
 SG_ VFC_Obj07A_HeadingAngleStdDev : 186|6@1+ (0.01,0) [0|0.5] "rad"  RadarFrontCenter,DASy
 SG_ VFC_Obj07A_HeadOrientation : 460|4@1+ (1,0) [0|15] ""  RadarFrontCenter,DASy
 SG_ VFC_Obj07A_CompletelyInImg : 121|1@1+ (1,0) [0|1] ""  RadarFrontCenter,DASy
 SG_ VFC_Obj07A_ProbMovingLat : 154|6@1+ (2,0) [0|100] "%"  RadarFrontCenter,DASy
 SG_ VFC_Obj07A_ProbMovingLong : 170|6@1+ (2,0) [0|100] "%"  RadarFrontCenter,DASy
 SG_ VFC_Obj07A_ProbExist : 122|6@1+ (2,0) [0|100] "%"  RadarFrontCenter,DASy
 SG_ VFC_Obj07A_MeasSource : 91|5@1+ (1,0) [0|31] ""  RadarFrontCenter,DASy
 SG_ VFC_Obj07A_Reliability : 362|6@1+ (1,0) [0|63] ""  RadarFrontCenter,DASy
 SG_ VFC_Obj07A_Measured : 78|2@1+ (1,0) [0|3] ""  RadarFrontCenter,DASy
 SG_ VFC_Obj07A_VisibleView : 437|3@1+ (1,0) [0|4] ""  RadarFrontCenter,DASy
 SG_ VFC_Obj07A_ClassifiedView : 496|3@1+ (1,0) [0|4] ""  RadarFrontCenter,DASy
 SG_ VFC_Obj07A_DirIndicator : 106|3@1+ (1,0) [0|4] ""  RadarFrontCenter,DASy
 SG_ VFC_Obj07A_BrakeLight : 109|3@1+ (1,0) [0|7] ""  RadarFrontCenter,DASy

BO_ 192 VFC_Object08A: 64 MPC3
 SG_ VFC_Obj08A_CRC : 0|16@1+ (1,0) [0|65535] ""  RadarFrontCenter,DASy
 SG_ VFC_Obj08A_AliveCtr : 16|8@1+ (1,0) [0|255] ""  RadarFrontCenter,DASy
 SG_ VFC_Obj08A_ProtBlockCtr : 24|4@1+ (1,0) [0|15] ""  RadarFrontCenter,DASy
 SG_ VFC_Obj08A_ID : 32|8@1+ (1,0) [1|255] ""  RadarFrontCenter,DASy
 SG_ VFC_Obj08A_Type : 60|4@1+ (1,0) [0|15] ""  RadarFrontCenter,DASy
 SG_ VFC_Obj08A_TypeProb : 378|6@1+ (2,0) [0|100] "%"  RadarFrontCenter,DASy
 SG_ VFC_Obj08A_Dx : 48|12@1+ (0.05,0) [0|204.75] "m"  RadarFrontCenter,DASy
 SG_ VFC_Obj08A_Dy : 64|14@1+ (0.01,-80) [-80|80] "m"  RadarFrontCenter,DASy
 SG_ VFC_Obj08A_Vx : 80|11@1+ (0.1,-154) [-154|50] "m/s"  RadarFrontCenter,DASy
 SG_ VFC_Obj08A_Vy : 96|10@1+ (0.1,-50) [-50|50] "m/s"  RadarFrontCenter,DASy
 SG_ VFC_Obj08A_Ax : 112|9@1+ (0.1,-16) [-16|16] "m/s^2"  RadarFrontCenter,DASy
 SG_ VFC_Obj08A_Ay : 128|8@1+ (0.1,-12) [-12|12] "m/s^2"  RadarFrontCenter,DASy
 SG_ VFC_Obj08A_DxStdDev : 144|10@1+ (0.05,0) [0|51.15] "m"  RadarFrontCenter,DASy
 SG_ VFC_Obj08A_DyStdDev : 160|10@1+ (0.02,0) [0|20.46] "m"  RadarFrontCenter,DASy
 SG_ VFC_Obj08A_VxStdDev : 176|10@1+ (0.1,0) [0|102.3] "m/s"  RadarFrontCenter,DASy
 SG_ VFC_Obj08A_VyStdDev : 192|9@1+ (0.1,0) [0|51.1] "m/s"  RadarFrontCenter,DASy
 SG_ VFC_Obj08A_AxStdDev : 40|8@1+ (0.1,0) [0|25.5] "m/s^2"  RadarFrontCenter,DASy
 SG_ VFC_Obj08A_AyStdDev : 136|8@1+ (0.1,0) [0|25.5] "m/s^2"  RadarFrontCenter,DASy
 SG_ VFC_Obj08A_Length : 217|9@1+ (0.05,0) [0|25.55] "m"  RadarFrontCenter,DASy
 SG_ VFC_Obj08A_Width : 294|10@1+ (0.01,0) [0|10.23] "m"  RadarFrontCenter,DASy
 SG_ VFC_Obj08A_Height : 208|9@1+ (0.01,0) [0|5.11] "m"  RadarFrontCenter,DASy
 SG_ VFC_Obj08A_LengthStdDev : 384|7@1+ (0.05,0) [0|5] "m"  RadarFrontCenter,DASy
 SG_ VFC_Obj08A_WidthStdDev : 391|7@1+ (0.01,0) [0|1] "m"  RadarFrontCenter,DASy
 SG_ VFC_Obj08A_HeightStdDev : 201|7@1+ (0.01,0) [0|1] "m"  RadarFrontCenter,DASy
 SG_ VFC_Obj08A_EdgeLeft : 411|13@1+ (0.00025,-1) [-1|1] "unitless"  RadarFrontCenter,DASy
 SG_ VFC_Obj08A_EdgeMid : 398|13@1+ (0.00025,-1) [-1|1] "unitless"  RadarFrontCenter,DASy
 SG_ VFC_Obj08A_EdgeRight : 424|13@1+ (0.00025,-1) [-1|1] "unitless"  RadarFrontCenter,DASy
 SG_ VFC_Obj08A_EdgeTop : 448|12@1+ (0.00025,-0.5) [-0.5|0.5] "unitless"  RadarFrontCenter,DASy
 SG_ VFC_Obj08A_EdgeBottom : 269|12@1+ (0.00025,-0.5) [-0.5|0.5] "unitless"  RadarFrontCenter,DASy
 SG_ VFC_Obj08A_EdgeLeftStdDev : 440|8@1+ (0.0002,0) [0|0.051] "unitless"  RadarFrontCenter,DASy
 SG_ VFC_Obj08A_EdgeMidStdDev : 464|8@1+ (0.0002,0) [0|0.051] "unitless"  RadarFrontCenter,DASy
 SG_ VFC_Obj08A_EdgeRightStdDev : 472|8@1+ (0.0002,0) [0|0.051] "unitless"  RadarFrontCenter,DASy
 SG_ VFC_Obj08A_EdgeTopStdDev : 480|8@1+ (0.0002,0) [0|0.051] "unitless"  RadarFrontCenter,DASy
 SG_ VFC_Obj08A_EdgeBottomStdDev : 488|8@1+ (0.0002,0) [0|0.051] "unitless"  RadarFrontCenter,DASy
 SG_ VFC_Obj08A_NormVx : 304|16@1+ (0.001,-40) [-40|25] "1/s"  RadarFrontCenter,DASy
 SG_ VFC_Obj08A_NormAx : 235|13@1+ (0.002,-10) [-10|6] "1/s^2"  RadarFrontCenter,DASy
 SG_ VFC_Obj08A_NormVyEdgeLeft : 256|13@1+ (0.001,-4) [-4|4] "1/s"  RadarFrontCenter,DASy
 SG_ VFC_Obj08A_NormVyEdgeRight : 281|13@1+ (0.001,-4) [-4|4] "1/s"  RadarFrontCenter,DASy
 SG_ VFC_Obj08A_NormVxStdDev : 368|10@1+ (0.001,0) [0|1.023] "1/s"  RadarFrontCenter,DASy
 SG_ VFC_Obj08A_NormAxStdDev : 328|10@1+ (0.0025,0) [0|2.5575] "1/s^2"  RadarFrontCenter,DASy
 SG_ VFC_Obj08A_NormVyEdgeLeftStdDev : 248|8@1+ (0.001,0) [0|0.255] "1/s"  RadarFrontCenter,DASy
 SG_ VFC_Obj08A_NormVyEdgeRightStdDev : 320|8@1+ (0.001,0) [0|0.255] "1/s"  RadarFrontCenter,DASy
 SG_ VFC_Obj08A_ScaleChange : 338|14@1+ (0.0001,0.5) [0.5|2.1383] "unitless"  RadarFrontCenter,DASy
 SG_ VFC_Obj08A_ScaleChngStdDev : 352|10@1+ (0.0001,0) [0|0.1023] "unitless"  RadarFrontCenter,DASy
 SG_ VFC_Obj08A_HeadingAngle : 226|9@1+ (0.01,-1.57) [-1.57|1.57] "rad"  RadarFrontCenter,DASy
 SG_ VFC_Obj08A_HeadingAngleStdDev : 186|6@1+ (0.01,0) [0|0.5] "rad"  RadarFrontCenter,DASy
 SG_ VFC_Obj08A_HeadOrientation : 460|4@1+ (1,0) [0|15] ""  RadarFrontCenter,DASy
 SG_ VFC_Obj08A_CompletelyInImg : 121|1@1+ (1,0) [0|1] ""  RadarFrontCenter,DASy
 SG_ VFC_Obj08A_ProbMovingLat : 154|6@1+ (2,0) [0|100] "%"  RadarFrontCenter,DASy
 SG_ VFC_Obj08A_ProbMovingLong : 170|6@1+ (2,0) [0|100] "%"  RadarFrontCenter,DASy
 SG_ VFC_Obj08A_ProbExist : 122|6@1+ (2,0) [0|100] "%"  RadarFrontCenter,DASy
 SG_ VFC_Obj08A_MeasSource : 91|5@1+ (1,0) [0|31] ""  RadarFrontCenter,DASy
 SG_ VFC_Obj08A_Reliability : 362|6@1+ (1,0) [0|63] ""  RadarFrontCenter,DASy
 SG_ VFC_Obj08A_Measured : 78|2@1+ (1,0) [0|3] ""  RadarFrontCenter,DASy
 SG_ VFC_Obj08A_VisibleView : 437|3@1+ (1,0) [0|4] ""  RadarFrontCenter,DASy
 SG_ VFC_Obj08A_ClassifiedView : 496|3@1+ (1,0) [0|4] ""  RadarFrontCenter,DASy
 SG_ VFC_Obj08A_DirIndicator : 106|3@1+ (1,0) [0|4] ""  RadarFrontCenter,DASy
 SG_ VFC_Obj08A_BrakeLight : 109|3@1+ (1,0) [0|7] ""  RadarFrontCenter,DASy

BO_ 194 VFC_Object09A: 64 MPC3
 SG_ VFC_Obj09A_CRC : 0|16@1+ (1,0) [0|65535] ""  RadarFrontCenter,DASy
 SG_ VFC_Obj09A_AliveCtr : 16|8@1+ (1,0) [0|255] ""  RadarFrontCenter,DASy
 SG_ VFC_Obj09A_ProtBlockCtr : 24|4@1+ (1,0) [0|15] ""  RadarFrontCenter,DASy
 SG_ VFC_Obj09A_ID : 32|8@1+ (1,0) [1|255] ""  RadarFrontCenter,DASy
 SG_ VFC_Obj09A_Type : 60|4@1+ (1,0) [0|15] ""  RadarFrontCenter,DASy
 SG_ VFC_Obj09A_TypeProb : 378|6@1+ (2,0) [0|100] "%"  RadarFrontCenter,DASy
 SG_ VFC_Obj09A_Dx : 48|12@1+ (0.05,0) [0|204.75] "m"  RadarFrontCenter,DASy
 SG_ VFC_Obj09A_Dy : 64|14@1+ (0.01,-80) [-80|80] "m"  RadarFrontCenter,DASy
 SG_ VFC_Obj09A_Vx : 80|11@1+ (0.1,-154) [-154|50] "m/s"  RadarFrontCenter,DASy
 SG_ VFC_Obj09A_Vy : 96|10@1+ (0.1,-50) [-50|50] "m/s"  RadarFrontCenter,DASy
 SG_ VFC_Obj09A_Ax : 112|9@1+ (0.1,-16) [-16|16] "m/s^2"  RadarFrontCenter,DASy
 SG_ VFC_Obj09A_Ay : 128|8@1+ (0.1,-12) [-12|12] "m/s^2"  RadarFrontCenter,DASy
 SG_ VFC_Obj09A_DxStdDev : 144|10@1+ (0.05,0) [0|51.15] "m"  RadarFrontCenter,DASy
 SG_ VFC_Obj09A_DyStdDev : 160|10@1+ (0.02,0) [0|20.46] "m"  RadarFrontCenter,DASy
 SG_ VFC_Obj09A_VxStdDev : 176|10@1+ (0.1,0) [0|102.3] "m/s"  RadarFrontCenter,DASy
 SG_ VFC_Obj09A_VyStdDev : 192|9@1+ (0.1,0) [0|51.1] "m/s"  RadarFrontCenter,DASy
 SG_ VFC_Obj09A_AxStdDev : 40|8@1+ (0.1,0) [0|25.5] "m/s^2"  RadarFrontCenter,DASy
 SG_ VFC_Obj09A_AyStdDev : 136|8@1+ (0.1,0) [0|25.5] "m/s^2"  RadarFrontCenter,DASy
 SG_ VFC_Obj09A_Length : 217|9@1+ (0.05,0) [0|25.55] "m"  RadarFrontCenter,DASy
 SG_ VFC_Obj09A_Width : 294|10@1+ (0.01,0) [0|10.23] "m"  RadarFrontCenter,DASy
 SG_ VFC_Obj09A_Height : 208|9@1+ (0.01,0) [0|5.11] "m"  RadarFrontCenter,DASy
 SG_ VFC_Obj09A_LengthStdDev : 384|7@1+ (0.05,0) [0|5] "m"  RadarFrontCenter,DASy
 SG_ VFC_Obj09A_WidthStdDev : 391|7@1+ (0.01,0) [0|1] "m"  RadarFrontCenter,DASy
 SG_ VFC_Obj09A_HeightStdDev : 201|7@1+ (0.01,0) [0|1] "m"  RadarFrontCenter,DASy
 SG_ VFC_Obj09A_EdgeLeft : 411|13@1+ (0.00025,-1) [-1|1] "unitless"  RadarFrontCenter,DASy
 SG_ VFC_Obj09A_EdgeMid : 398|13@1+ (0.00025,-1) [-1|1] "unitless"  RadarFrontCenter,DASy
 SG_ VFC_Obj09A_EdgeRight : 424|13@1+ (0.00025,-1) [-1|1] "unitless"  RadarFrontCenter,DASy
 SG_ VFC_Obj09A_EdgeTop : 448|12@1+ (0.00025,-0.5) [-0.5|0.5] "unitless"  RadarFrontCenter,DASy
 SG_ VFC_Obj09A_EdgeBottom : 269|12@1+ (0.00025,-0.5) [-0.5|0.5] "unitless"  RadarFrontCenter,DASy
 SG_ VFC_Obj09A_EdgeLeftStdDev : 440|8@1+ (0.0002,0) [0|0.051] "unitless"  RadarFrontCenter,DASy
 SG_ VFC_Obj09A_EdgeMidStdDev : 464|8@1+ (0.0002,0) [0|0.051] "unitless"  RadarFrontCenter,DASy
 SG_ VFC_Obj09A_EdgeRightStdDev : 472|8@1+ (0.0002,0) [0|0.051] "unitless"  RadarFrontCenter,DASy
 SG_ VFC_Obj09A_EdgeTopStdDev : 480|8@1+ (0.0002,0) [0|0.051] "unitless"  RadarFrontCenter,DASy
 SG_ VFC_Obj09A_EdgeBottomStdDev : 488|8@1+ (0.0002,0) [0|0.051] "unitless"  RadarFrontCenter,DASy
 SG_ VFC_Obj09A_NormVx : 304|16@1+ (0.001,-40) [-40|25] "1/s"  RadarFrontCenter,DASy
 SG_ VFC_Obj09A_NormAx : 235|13@1+ (0.002,-10) [-10|6] "1/s^2"  RadarFrontCenter,DASy
 SG_ VFC_Obj09A_NormVyEdgeLeft : 256|13@1+ (0.001,-4) [-4|4] "1/s"  RadarFrontCenter,DASy
 SG_ VFC_Obj09A_NormVyEdgeRight : 281|13@1+ (0.001,-4) [-4|4] "1/s"  RadarFrontCenter,DASy
 SG_ VFC_Obj09A_NormVxStdDev : 368|10@1+ (0.001,0) [0|1.023] "1/s"  RadarFrontCenter,DASy
 SG_ VFC_Obj09A_NormAxStdDev : 328|10@1+ (0.0025,0) [0|2.5575] "1/s^2"  RadarFrontCenter,DASy
 SG_ VFC_Obj09A_NormVyEdgeLeftStdDev : 248|8@1+ (0.001,0) [0|0.255] "1/s"  RadarFrontCenter,DASy
 SG_ VFC_Obj09A_NormVyEdgeRightStdDev : 320|8@1+ (0.001,0) [0|0.255] "1/s"  RadarFrontCenter,DASy
 SG_ VFC_Obj09A_ScaleChange : 338|14@1+ (0.0001,0.5) [0.5|2.1383] "unitless"  RadarFrontCenter,DASy
 SG_ VFC_Obj09A_ScaleChngStdDev : 352|10@1+ (0.0001,0) [0|0.1023] "unitless"  RadarFrontCenter,DASy
 SG_ VFC_Obj09A_HeadingAngle : 226|9@1+ (0.01,-1.57) [-1.57|1.57] "rad"  RadarFrontCenter,DASy
 SG_ VFC_Obj09A_HeadingAngleStdDev : 186|6@1+ (0.01,0) [0|0.5] "rad"  RadarFrontCenter,DASy
 SG_ VFC_Obj09A_HeadOrientation : 460|4@1+ (1,0) [0|15] ""  RadarFrontCenter,DASy
 SG_ VFC_Obj09A_CompletelyInImg : 121|1@1+ (1,0) [0|1] ""  RadarFrontCenter,DASy
 SG_ VFC_Obj09A_ProbMovingLat : 154|6@1+ (2,0) [0|100] "%"  RadarFrontCenter,DASy
 SG_ VFC_Obj09A_ProbMovingLong : 170|6@1+ (2,0) [0|100] "%"  RadarFrontCenter,DASy
 SG_ VFC_Obj09A_ProbExist : 122|6@1+ (2,0) [0|100] "%"  RadarFrontCenter,DASy
 SG_ VFC_Obj09A_MeasSource : 91|5@1+ (1,0) [0|31] ""  RadarFrontCenter,DASy
 SG_ VFC_Obj09A_Reliability : 362|6@1+ (1,0) [0|63] ""  RadarFrontCenter,DASy
 SG_ VFC_Obj09A_Measured : 78|2@1+ (1,0) [0|3] ""  RadarFrontCenter,DASy
 SG_ VFC_Obj09A_VisibleView : 437|3@1+ (1,0) [0|4] ""  RadarFrontCenter,DASy
 SG_ VFC_Obj09A_ClassifiedView : 496|3@1+ (1,0) [0|4] ""  RadarFrontCenter,DASy
 SG_ VFC_Obj09A_DirIndicator : 106|3@1+ (1,0) [0|4] ""  RadarFrontCenter,DASy
 SG_ VFC_Obj09A_BrakeLight : 109|3@1+ (1,0) [0|7] ""  RadarFrontCenter,DASy

BO_ 196 VFC_Object10A: 64 MPC3
 SG_ VFC_Obj10A_CRC : 0|16@1+ (1,0) [0|65535] ""  RadarFrontCenter,DASy
 SG_ VFC_Obj10A_AliveCtr : 16|8@1+ (1,0) [0|255] ""  RadarFrontCenter,DASy
 SG_ VFC_Obj10A_ProtBlockCtr : 24|4@1+ (1,0) [0|15] ""  RadarFrontCenter,DASy
 SG_ VFC_Obj10A_ID : 32|8@1+ (1,0) [1|255] ""  RadarFrontCenter,DASy
 SG_ VFC_Obj10A_Type : 60|4@1+ (1,0) [0|15] ""  RadarFrontCenter,DASy
 SG_ VFC_Obj10A_TypeProb : 378|6@1+ (2,0) [0|100] "%"  RadarFrontCenter,DASy
 SG_ VFC_Obj10A_Dx : 48|12@1+ (0.05,0) [0|204.75] "m"  RadarFrontCenter,DASy
 SG_ VFC_Obj10A_Dy : 64|14@1+ (0.01,-80) [-80|80] "m"  RadarFrontCenter,DASy
 SG_ VFC_Obj10A_Vx : 80|11@1+ (0.1,-154) [-154|50] "m/s"  RadarFrontCenter,DASy
 SG_ VFC_Obj10A_Vy : 96|10@1+ (0.1,-50) [-50|50] "m/s"  RadarFrontCenter,DASy
 SG_ VFC_Obj10A_Ax : 112|9@1+ (0.1,-16) [-16|16] "m/s^2"  RadarFrontCenter,DASy
 SG_ VFC_Obj10A_Ay : 128|8@1+ (0.1,-12) [-12|12] "m/s^2"  RadarFrontCenter,DASy
 SG_ VFC_Obj10A_DxStdDev : 144|10@1+ (0.05,0) [0|51.15] "m"  RadarFrontCenter,DASy
 SG_ VFC_Obj10A_DyStdDev : 160|10@1+ (0.02,0) [0|20.46] "m"  RadarFrontCenter,DASy
 SG_ VFC_Obj10A_VxStdDev : 176|10@1+ (0.1,0) [0|102.3] "m/s"  RadarFrontCenter,DASy
 SG_ VFC_Obj10A_VyStdDev : 192|9@1+ (0.1,0) [0|51.1] "m/s"  RadarFrontCenter,DASy
 SG_ VFC_Obj10A_AxStdDev : 40|8@1+ (0.1,0) [0|25.5] "m/s^2"  RadarFrontCenter,DASy
 SG_ VFC_Obj10A_AyStdDev : 136|8@1+ (0.1,0) [0|25.5] "m/s^2"  RadarFrontCenter,DASy
 SG_ VFC_Obj10A_Length : 217|9@1+ (0.05,0) [0|25.55] "m"  RadarFrontCenter,DASy
 SG_ VFC_Obj10A_Width : 294|10@1+ (0.01,0) [0|10.23] "m"  RadarFrontCenter,DASy
 SG_ VFC_Obj10A_Height : 208|9@1+ (0.01,0) [0|5.11] "m"  RadarFrontCenter,DASy
 SG_ VFC_Obj10A_LengthStdDev : 384|7@1+ (0.05,0) [0|5] "m"  RadarFrontCenter,DASy
 SG_ VFC_Obj10A_WidthStdDev : 391|7@1+ (0.01,0) [0|1] "m"  RadarFrontCenter,DASy
 SG_ VFC_Obj10A_HeightStdDev : 201|7@1+ (0.01,0) [0|1] "m"  RadarFrontCenter,DASy
 SG_ VFC_Obj10A_EdgeLeft : 411|13@1+ (0.00025,-1) [-1|1] "unitless"  RadarFrontCenter,DASy
 SG_ VFC_Obj10A_EdgeMid : 398|13@1+ (0.00025,-1) [-1|1] "unitless"  RadarFrontCenter,DASy
 SG_ VFC_Obj10A_EdgeRight : 424|13@1+ (0.00025,-1) [-1|1] "unitless"  RadarFrontCenter,DASy
 SG_ VFC_Obj10A_EdgeTop : 448|12@1+ (0.00025,-0.5) [-0.5|0.5] "unitless"  RadarFrontCenter,DASy
 SG_ VFC_Obj10A_EdgeBottom : 269|12@1+ (0.00025,-0.5) [-0.5|0.5] "unitless"  RadarFrontCenter,DASy
 SG_ VFC_Obj10A_EdgeLeftStdDev : 440|8@1+ (0.0002,0) [0|0.051] "unitless"  RadarFrontCenter,DASy
 SG_ VFC_Obj10A_EdgeMidStdDev : 464|8@1+ (0.0002,0) [0|0.051] "unitless"  RadarFrontCenter,DASy
 SG_ VFC_Obj10A_EdgeRightStdDev : 472|8@1+ (0.0002,0) [0|0.051] "unitless"  RadarFrontCenter,DASy
 SG_ VFC_Obj10A_EdgeTopStdDev : 480|8@1+ (0.0002,0) [0|0.051] "unitless"  RadarFrontCenter,DASy
 SG_ VFC_Obj10A_EdgeBottomStdDev : 488|8@1+ (0.0002,0) [0|0.051] "unitless"  RadarFrontCenter,DASy
 SG_ VFC_Obj10A_NormVx : 304|16@1+ (0.001,-40) [-40|25] "1/s"  RadarFrontCenter,DASy
 SG_ VFC_Obj10A_NormAx : 235|13@1+ (0.002,-10) [-10|6] "1/s^2"  RadarFrontCenter,DASy
 SG_ VFC_Obj10A_NormVyEdgeLeft : 256|13@1+ (0.001,-4) [-4|4] "1/s"  RadarFrontCenter,DASy
 SG_ VFC_Obj10A_NormVyEdgeRight : 281|13@1+ (0.001,-4) [-4|4] "1/s"  RadarFrontCenter,DASy
 SG_ VFC_Obj10A_NormVxStdDev : 368|10@1+ (0.001,0) [0|1.023] "1/s"  RadarFrontCenter,DASy
 SG_ VFC_Obj10A_NormAxStdDev : 328|10@1+ (0.0025,0) [0|2.5575] "1/s^2"  RadarFrontCenter,DASy
 SG_ VFC_Obj10A_NormVyEdgeLeftStdDev : 248|8@1+ (0.001,0) [0|0.255] "1/s"  RadarFrontCenter,DASy
 SG_ VFC_Obj10A_NormVyEdgeRightStdDev : 320|8@1+ (0.001,0) [0|0.255] "1/s"  RadarFrontCenter,DASy
 SG_ VFC_Obj10A_ScaleChange : 338|14@1+ (0.0001,0.5) [0.5|2.1383] "unitless"  RadarFrontCenter,DASy
 SG_ VFC_Obj10A_ScaleChngStdDev : 352|10@1+ (0.0001,0) [0|0.1023] "unitless"  RadarFrontCenter,DASy
 SG_ VFC_Obj10A_HeadingAngle : 226|9@1+ (0.01,-1.57) [-1.57|1.57] "rad"  RadarFrontCenter,DASy
 SG_ VFC_Obj10A_HeadingAngleStdDev : 186|6@1+ (0.01,0) [0|0.5] "rad"  RadarFrontCenter,DASy
 SG_ VFC_Obj10A_HeadOrientation : 460|4@1+ (1,0) [0|15] ""  RadarFrontCenter,DASy
 SG_ VFC_Obj10A_CompletelyInImg : 121|1@1+ (1,0) [0|1] ""  RadarFrontCenter,DASy
 SG_ VFC_Obj10A_ProbMovingLat : 154|6@1+ (2,0) [0|100] "%"  RadarFrontCenter,DASy
 SG_ VFC_Obj10A_ProbMovingLong : 170|6@1+ (2,0) [0|100] "%"  RadarFrontCenter,DASy
 SG_ VFC_Obj10A_ProbExist : 122|6@1+ (2,0) [0|100] "%"  RadarFrontCenter,DASy
 SG_ VFC_Obj10A_MeasSource : 91|5@1+ (1,0) [0|31] ""  RadarFrontCenter,DASy
 SG_ VFC_Obj10A_Reliability : 362|6@1+ (1,0) [0|63] ""  RadarFrontCenter,DASy
 SG_ VFC_Obj10A_Measured : 78|2@1+ (1,0) [0|3] ""  RadarFrontCenter,DASy
 SG_ VFC_Obj10A_VisibleView : 437|3@1+ (1,0) [0|4] ""  RadarFrontCenter,DASy
 SG_ VFC_Obj10A_ClassifiedView : 496|3@1+ (1,0) [0|4] ""  RadarFrontCenter,DASy
 SG_ VFC_Obj10A_DirIndicator : 106|3@1+ (1,0) [0|4] ""  RadarFrontCenter,DASy
 SG_ VFC_Obj10A_BrakeLight : 109|3@1+ (1,0) [0|7] ""  RadarFrontCenter,DASy

BO_ 198 VFC_Object11A: 64 MPC3
 SG_ VFC_Obj11A_CRC : 0|16@1+ (1,0) [0|65535] ""  RadarFrontCenter,DASy
 SG_ VFC_Obj11A_AliveCtr : 16|8@1+ (1,0) [0|255] ""  RadarFrontCenter,DASy
 SG_ VFC_Obj11A_ProtBlockCtr : 24|4@1+ (1,0) [0|15] ""  RadarFrontCenter,DASy
 SG_ VFC_Obj11A_ID : 32|8@1+ (1,0) [1|255] ""  RadarFrontCenter,DASy
 SG_ VFC_Obj11A_Type : 60|4@1+ (1,0) [0|15] ""  RadarFrontCenter,DASy
 SG_ VFC_Obj11A_TypeProb : 378|6@1+ (2,0) [0|100] "%"  RadarFrontCenter,DASy
 SG_ VFC_Obj11A_Dx : 48|12@1+ (0.05,0) [0|204.75] "m"  RadarFrontCenter,DASy
 SG_ VFC_Obj11A_Dy : 64|14@1+ (0.01,-80) [-80|80] "m"  RadarFrontCenter,DASy
 SG_ VFC_Obj11A_Vx : 80|11@1+ (0.1,-154) [-154|50] "m/s"  RadarFrontCenter,DASy
 SG_ VFC_Obj11A_Vy : 96|10@1+ (0.1,-50) [-50|50] "m/s"  RadarFrontCenter,DASy
 SG_ VFC_Obj11A_Ax : 112|9@1+ (0.1,-16) [-16|16] "m/s^2"  RadarFrontCenter,DASy
 SG_ VFC_Obj11A_Ay : 128|8@1+ (0.1,-12) [-12|12] "m/s^2"  RadarFrontCenter,DASy
 SG_ VFC_Obj11A_DxStdDev : 144|10@1+ (0.05,0) [0|51.15] "m"  RadarFrontCenter,DASy
 SG_ VFC_Obj11A_DyStdDev : 160|10@1+ (0.02,0) [0|20.46] "m"  RadarFrontCenter,DASy
 SG_ VFC_Obj11A_VxStdDev : 176|10@1+ (0.1,0) [0|102.3] "m/s"  RadarFrontCenter,DASy
 SG_ VFC_Obj11A_VyStdDev : 192|9@1+ (0.1,0) [0|51.1] "m/s"  RadarFrontCenter,DASy
 SG_ VFC_Obj11A_AxStdDev : 40|8@1+ (0.1,0) [0|25.5] "m/s^2"  RadarFrontCenter,DASy
 SG_ VFC_Obj11A_AyStdDev : 136|8@1+ (0.1,0) [0|25.5] "m/s^2"  RadarFrontCenter,DASy
 SG_ VFC_Obj11A_Length : 217|9@1+ (0.05,0) [0|25.55] "m"  RadarFrontCenter,DASy
 SG_ VFC_Obj11A_Width : 294|10@1+ (0.01,0) [0|10.23] "m"  RadarFrontCenter,DASy
 SG_ VFC_Obj11A_Height : 208|9@1+ (0.01,0) [0|5.11] "m"  RadarFrontCenter,DASy
 SG_ VFC_Obj11A_LengthStdDev : 384|7@1+ (0.05,0) [0|5] "m"  RadarFrontCenter,DASy
 SG_ VFC_Obj11A_WidthStdDev : 391|7@1+ (0.01,0) [0|1] "m"  RadarFrontCenter,DASy
 SG_ VFC_Obj11A_HeightStdDev : 201|7@1+ (0.01,0) [0|1] "m"  RadarFrontCenter,DASy
 SG_ VFC_Obj11A_EdgeLeft : 411|13@1+ (0.00025,-1) [-1|1] "unitless"  RadarFrontCenter,DASy
 SG_ VFC_Obj11A_EdgeMid : 398|13@1+ (0.00025,-1) [-1|1] "unitless"  RadarFrontCenter,DASy
 SG_ VFC_Obj11A_EdgeRight : 424|13@1+ (0.00025,-1) [-1|1] "unitless"  RadarFrontCenter,DASy
 SG_ VFC_Obj11A_EdgeTop : 448|12@1+ (0.00025,-0.5) [-0.5|0.5] "unitless"  RadarFrontCenter,DASy
 SG_ VFC_Obj11A_EdgeBottom : 269|12@1+ (0.00025,-0.5) [-0.5|0.5] "unitless"  RadarFrontCenter,DASy
 SG_ VFC_Obj11A_EdgeLeftStdDev : 440|8@1+ (0.0002,0) [0|0.051] "unitless"  RadarFrontCenter,DASy
 SG_ VFC_Obj11A_EdgeMidStdDev : 464|8@1+ (0.0002,0) [0|0.051] "unitless"  RadarFrontCenter,DASy
 SG_ VFC_Obj11A_EdgeRightStdDev : 472|8@1+ (0.0002,0) [0|0.051] "unitless"  RadarFrontCenter,DASy
 SG_ VFC_Obj11A_EdgeTopStdDev : 480|8@1+ (0.0002,0) [0|0.051] "unitless"  RadarFrontCenter,DASy
 SG_ VFC_Obj11A_EdgeBottomStdDev : 488|8@1+ (0.0002,0) [0|0.051] "unitless"  RadarFrontCenter,DASy
 SG_ VFC_Obj11A_NormVx : 304|16@1+ (0.001,-40) [-40|25] "1/s"  RadarFrontCenter,DASy
 SG_ VFC_Obj11A_NormAx : 235|13@1+ (0.002,-10) [-10|6] "1/s^2"  RadarFrontCenter,DASy
 SG_ VFC_Obj11A_NormVyEdgeLeft : 256|13@1+ (0.001,-4) [-4|4] "1/s"  RadarFrontCenter,DASy
 SG_ VFC_Obj11A_NormVyEdgeRight : 281|13@1+ (0.001,-4) [-4|4] "1/s"  RadarFrontCenter,DASy
 SG_ VFC_Obj11A_NormVxStdDev : 368|10@1+ (0.001,0) [0|1.023] "1/s"  RadarFrontCenter,DASy
 SG_ VFC_Obj11A_NormAxStdDev : 328|10@1+ (0.0025,0) [0|2.5575] "1/s^2"  RadarFrontCenter,DASy
 SG_ VFC_Obj11A_NormVyEdgeLeftStdDev : 248|8@1+ (0.001,0) [0|0.255] "1/s"  RadarFrontCenter,DASy
 SG_ VFC_Obj11A_NormVyEdgeRightStdDev : 320|8@1+ (0.001,0) [0|0.255] "1/s"  RadarFrontCenter,DASy
 SG_ VFC_Obj11A_ScaleChange : 338|14@1+ (0.0001,0.5) [0.5|2.1383] "unitless"  RadarFrontCenter,DASy
 SG_ VFC_Obj11A_ScaleChngStdDev : 352|10@1+ (0.0001,0) [0|0.1023] "unitless"  RadarFrontCenter,DASy
 SG_ VFC_Obj11A_HeadingAngle : 226|9@1+ (0.01,-1.57) [-1.57|1.57] "rad"  RadarFrontCenter,DASy
 SG_ VFC_Obj11A_HeadingAngleStdDev : 186|6@1+ (0.01,0) [0|0.5] "rad"  RadarFrontCenter,DASy
 SG_ VFC_Obj11A_HeadOrientation : 460|4@1+ (1,0) [0|15] ""  RadarFrontCenter,DASy
 SG_ VFC_Obj11A_CompletelyInImg : 121|1@1+ (1,0) [0|1] ""  RadarFrontCenter,DASy
 SG_ VFC_Obj11A_ProbMovingLat : 154|6@1+ (2,0) [0|100] "%"  RadarFrontCenter,DASy
 SG_ VFC_Obj11A_ProbMovingLong : 170|6@1+ (2,0) [0|100] "%"  RadarFrontCenter,DASy
 SG_ VFC_Obj11A_ProbExist : 122|6@1+ (2,0) [0|100] "%"  RadarFrontCenter,DASy
 SG_ VFC_Obj11A_MeasSource : 91|5@1+ (1,0) [0|31] ""  RadarFrontCenter,DASy
 SG_ VFC_Obj11A_Reliability : 362|6@1+ (1,0) [0|63] ""  RadarFrontCenter,DASy
 SG_ VFC_Obj11A_Measured : 78|2@1+ (1,0) [0|3] ""  RadarFrontCenter,DASy
 SG_ VFC_Obj11A_VisibleView : 437|3@1+ (1,0) [0|4] ""  RadarFrontCenter,DASy
 SG_ VFC_Obj11A_ClassifiedView : 496|3@1+ (1,0) [0|4] ""  RadarFrontCenter,DASy
 SG_ VFC_Obj11A_DirIndicator : 106|3@1+ (1,0) [0|4] ""  RadarFrontCenter,DASy
 SG_ VFC_Obj11A_BrakeLight : 109|3@1+ (1,0) [0|7] ""  RadarFrontCenter,DASy

CM_ SG_ 160 VFC_ObjHdr_CRC "CRC - Autosar E2E Profile 5";
CM_ SG_ 160 VFC_ObjHdr_AliveCtr "Alive counter - Autosar E2E Profile 5";
CM_ SG_ 160 VFC_ObjHdr_ProtBlockCtr "Protocol-Signal: Block-Counter";
CM_ SG_ 160 VFC_ObjHdr_ProtObjCount "Protocol-Signal: count of all objects";
CM_ SG_ 160 VFC_ObjHdr_State "Informs the system of the current state of the camera";
CM_ SG_ 160 VFC_ObjHdr_TimeStampStatus "Autosar StbM_TimeBaseStatusType bitfield with extension:
Bit 0: TIMEOUT
Bit 1: Reserved1
Bit 2: SYNC_TO_GATEWAY
Bit 3: GLOBAL_TIME_BASE
Bit 4: TIMELEAP_FUTURE
Bit 5: TIMELEAP_PAST
Bit 6: Reserved6
Bit 7: Extension: GENERAL_ERROR";
CM_ SG_ 160 VFC_ObjHdr_TimeStamp "AUTOSAR TimeStamp of Objects";
CM_ SG_ 160 VFC_ObjHdr_TimeLatency "Absolute time gap, i.e. latency, between measurement time and sending time";
CM_ SG_ 176 VFC_Obj00A_CRC "CRC - Autosar E2E Profile 5";
CM_ SG_ 176 VFC_Obj00A_AliveCtr "Alive counter - Autosar E2E Profile 5";
CM_ SG_ 176 VFC_Obj00A_ProtBlockCtr "Protocol-Signal: Block-Counter";
CM_ SG_ 176 VFC_Obj00A_ID "Unique Object ID";
CM_ SG_ 176 VFC_Obj00A_Type "Classification of the object";
CM_ SG_ 176 VFC_Obj00A_TypeProb "Probability of the classified object type";
CM_ SG_ 176 VFC_Obj00A_Dx "Object distance in longitudinal direction";
CM_ SG_ 176 VFC_Obj00A_Dy "Object distance in lateral direction";
CM_ SG_ 176 VFC_Obj00A_Vx "Object velocity in longitudinal direction";
CM_ SG_ 176 VFC_Obj00A_Vy "Object velocity in lateral direction";
CM_ SG_ 176 VFC_Obj00A_Ax "Object acceleration in longitudinal direction";
CM_ SG_ 176 VFC_Obj00A_Ay "Object acceleration in lateral direction";
CM_ SG_ 176 VFC_Obj00A_DxStdDev "Standard deviation of Object distance in longitudinal direction";
CM_ SG_ 176 VFC_Obj00A_DyStdDev "Standard deviation of Object distance in lateral direction";
CM_ SG_ 176 VFC_Obj00A_VxStdDev "Standard deviation of Object velocity in longitudinal direction";
CM_ SG_ 176 VFC_Obj00A_VyStdDev "Standard deviation of Object velocity in lateral direction";
CM_ SG_ 176 VFC_Obj00A_AxStdDev "Standard deviation of Object acceleration in longitudinal direction";
CM_ SG_ 176 VFC_Obj00A_AyStdDev "Standard deviation of Object acceleration in lateral direction";
CM_ SG_ 176 VFC_Obj00A_Length "Length of the object";
CM_ SG_ 176 VFC_Obj00A_Width "Width of the object";
CM_ SG_ 176 VFC_Obj00A_Height "Height of the object";
CM_ SG_ 176 VFC_Obj00A_LengthStdDev "Standard deviation of object length";
CM_ SG_ 176 VFC_Obj00A_WidthStdDev "Standard deviation of object width";
CM_ SG_ 176 VFC_Obj00A_HeightStdDev "Standard deviation of object height";
CM_ SG_ 176 VFC_Obj00A_EdgeLeft "In ACCS coordinates; corresponds to tan(viewing angle of left object edge)";
CM_ SG_ 176 VFC_Obj00A_EdgeMid "In ACCS coordinates; corresponds to tan(viewing angle of middle object edge)";
CM_ SG_ 176 VFC_Obj00A_EdgeRight "In ACCS coordinates; corresponds to tan(viewing angle of right object edge)";
CM_ SG_ 176 VFC_Obj00A_EdgeTop "In ACCS coordinates; corresponds to tan(viewing angle of top object edge)";
CM_ SG_ 176 VFC_Obj00A_EdgeBottom "In ACCS coordinates; corresponds to tan(viewing angle of bottom object edge)";
CM_ SG_ 176 VFC_Obj00A_EdgeLeftStdDev "Standard deviation of the ACCS left object edge";
CM_ SG_ 176 VFC_Obj00A_EdgeMidStdDev "Standard deviation of the ACCS middle object edge";
CM_ SG_ 176 VFC_Obj00A_EdgeRightStdDev "Standard deviation of the ACCS right object edge";
CM_ SG_ 176 VFC_Obj00A_EdgeTopStdDev "Standard deviation of the ACCS top object edge";
CM_ SG_ 176 VFC_Obj00A_EdgeBottomStdDev "Standard deviation of the ACCS bottom object edge";
CM_ SG_ 176 VFC_Obj00A_NormVx "Normalised Object velocity in longitudinal direction";
CM_ SG_ 176 VFC_Obj00A_NormAx "Normalised Object acceleration in longitudinal direction";
CM_ SG_ 176 VFC_Obj00A_NormVyEdgeLeft "Normalised velocity of the ACCS left object edge in lateral direction";
CM_ SG_ 176 VFC_Obj00A_NormVyEdgeRight "Normalised velocity of the ACCS right object edge in lateral direction";
CM_ SG_ 176 VFC_Obj00A_NormVxStdDev "Standard deviation of Normalised Object velocity in longitudinal direction";
CM_ SG_ 176 VFC_Obj00A_NormAxStdDev "Standard deviation of Normalised Object acceleration in longitudinal direction";
CM_ SG_ 176 VFC_Obj00A_NormVyEdgeLeftStdDev "Standard deviation of Normalised velocity of the ACCS left object edge in lateral direction";
CM_ SG_ 176 VFC_Obj00A_NormVyEdgeRightStdDev "Standard deviation of Normalised velocity of the ACCS right object edge in lateral direction";
CM_ SG_ 176 VFC_Obj00A_ScaleChange "A scale change of of the detected object";
CM_ SG_ 176 VFC_Obj00A_ScaleChngStdDev "Standard deviation of object scale change";
CM_ SG_ 176 VFC_Obj00A_HeadingAngle "Heading angle of the object";
CM_ SG_ 176 VFC_Obj00A_HeadingAngleStdDev "Standard deviation of object Heading angle";
CM_ SG_ 176 VFC_Obj00A_HeadOrientation "The orientation of the head of cyclists or pedestrians that are detected";
CM_ SG_ 176 VFC_Obj00A_CompletelyInImg "indicator if the object is completely measured in the image";
CM_ SG_ 176 VFC_Obj00A_ProbMovingLat "Probability of object moving laterally";
CM_ SG_ 176 VFC_Obj00A_ProbMovingLong "Probability of object moving longitudinally";
CM_ SG_ 176 VFC_Obj00A_ProbExist "Object existence probability";
CM_ SG_ 176 VFC_Obj00A_MeasSource "Bitfield for the measurement programs from which this object originates
Bit 0: MOD
Bit 1: PDET
Bit 2: OFT
Bit 3: OLS
Bit 4: RESERVED";
CM_ SG_ 176 VFC_Obj00A_Reliability "The bitfield shows if the signal quality is assumed to be sufficient for functions with safety target -no false positives-
Bit 0: DYNAMIC
Bit 1: SEMSEG_SURFACE
Bit 2: WDD_CRITICAL
Bit 3: GOD_CONFIRMED
Bit 4: RESTRICTED
Bit 5: ISO26262_SAFE";
CM_ SG_ 176 VFC_Obj00A_Measured "Indicator if the object detected is measured or predicted";
CM_ SG_ 176 VFC_Obj00A_VisibleView "The visible view of the detected object";
CM_ SG_ 176 VFC_Obj00A_ClassifiedView "The classified view of object to be used in connection with Heading angle";
CM_ SG_ 176 VFC_Obj00A_DirIndicator "The detected direction indicator lights";
CM_ SG_ 176 VFC_Obj00A_BrakeLight "The number of detected lights. More confident if more lights are detected.";
CM_ SG_ 178 VFC_Obj01A_CRC "CRC - Autosar E2E Profile 5";
CM_ SG_ 178 VFC_Obj01A_AliveCtr "Alive counter - Autosar E2E Profile 5";
CM_ SG_ 178 VFC_Obj01A_ProtBlockCtr "Protocol-Signal: Block-Counter";
CM_ SG_ 178 VFC_Obj01A_ID "Unique Object ID";
CM_ SG_ 178 VFC_Obj01A_Type "Classification of the object";
CM_ SG_ 178 VFC_Obj01A_TypeProb "Probability of the classified object type";
CM_ SG_ 178 VFC_Obj01A_Dx "Object distance in longitudinal direction";
CM_ SG_ 178 VFC_Obj01A_Dy "Object distance in lateral direction";
CM_ SG_ 178 VFC_Obj01A_Vx "Object velocity in longitudinal direction";
CM_ SG_ 178 VFC_Obj01A_Vy "Object velocity in lateral direction";
CM_ SG_ 178 VFC_Obj01A_Ax "Object acceleration in longitudinal direction";
CM_ SG_ 178 VFC_Obj01A_Ay "Object acceleration in lateral direction";
CM_ SG_ 178 VFC_Obj01A_DxStdDev "Standard deviation of Object distance in longitudinal direction";
CM_ SG_ 178 VFC_Obj01A_DyStdDev "Standard deviation of Object distance in lateral direction";
CM_ SG_ 178 VFC_Obj01A_VxStdDev "Standard deviation of Object velocity in longitudinal direction";
CM_ SG_ 178 VFC_Obj01A_VyStdDev "Standard deviation of Object velocity in lateral direction";
CM_ SG_ 178 VFC_Obj01A_AxStdDev "Standard deviation of Object acceleration in longitudinal direction";
CM_ SG_ 178 VFC_Obj01A_AyStdDev "Standard deviation of Object acceleration in lateral direction";
CM_ SG_ 178 VFC_Obj01A_Length "Length of the object";
CM_ SG_ 178 VFC_Obj01A_Width "Width of the object";
CM_ SG_ 178 VFC_Obj01A_Height "Height of the object";
CM_ SG_ 178 VFC_Obj01A_LengthStdDev "Standard deviation of object length";
CM_ SG_ 178 VFC_Obj01A_WidthStdDev "Standard deviation of object width";
CM_ SG_ 178 VFC_Obj01A_HeightStdDev "Standard deviation of object height";
CM_ SG_ 178 VFC_Obj01A_EdgeLeft "In ACCS coordinates; corresponds to tan(viewing angle of left object edge)";
CM_ SG_ 178 VFC_Obj01A_EdgeMid "In ACCS coordinates; corresponds to tan(viewing angle of middle object edge)";
CM_ SG_ 178 VFC_Obj01A_EdgeRight "In ACCS coordinates; corresponds to tan(viewing angle of right object edge)";
CM_ SG_ 178 VFC_Obj01A_EdgeTop "In ACCS coordinates; corresponds to tan(viewing angle of top object edge)";
CM_ SG_ 178 VFC_Obj01A_EdgeBottom "In ACCS coordinates; corresponds to tan(viewing angle of bottom object edge)";
CM_ SG_ 178 VFC_Obj01A_EdgeLeftStdDev "Standard deviation of the ACCS left object edge";
CM_ SG_ 178 VFC_Obj01A_EdgeMidStdDev "Standard deviation of the ACCS middle object edge";
CM_ SG_ 178 VFC_Obj01A_EdgeRightStdDev "Standard deviation of the ACCS right object edge";
CM_ SG_ 178 VFC_Obj01A_EdgeTopStdDev "Standard deviation of the ACCS top object edge";
CM_ SG_ 178 VFC_Obj01A_EdgeBottomStdDev "Standard deviation of the ACCS bottom object edge";
CM_ SG_ 178 VFC_Obj01A_NormVx "Normalised Object velocity in longitudinal direction";
CM_ SG_ 178 VFC_Obj01A_NormAx "Normalised Object acceleration in longitudinal direction";
CM_ SG_ 178 VFC_Obj01A_NormVyEdgeLeft "Normalised velocity of the ACCS left object edge in lateral direction";
CM_ SG_ 178 VFC_Obj01A_NormVyEdgeRight "Normalised velocity of the ACCS right object edge in lateral direction";
CM_ SG_ 178 VFC_Obj01A_NormVxStdDev "Standard deviation of Normalised Object velocity in longitudinal direction";
CM_ SG_ 178 VFC_Obj01A_NormAxStdDev "Standard deviation of Normalised Object acceleration in longitudinal direction";
CM_ SG_ 178 VFC_Obj01A_NormVyEdgeLeftStdDev "Standard deviation of Normalised velocity of the ACCS left object edge in lateral direction";
CM_ SG_ 178 VFC_Obj01A_NormVyEdgeRightStdDev "Standard deviation of Normalised velocity of the ACCS right object edge in lateral direction";
CM_ SG_ 178 VFC_Obj01A_ScaleChange "A scale change of of the detected object";
CM_ SG_ 178 VFC_Obj01A_ScaleChngStdDev "Standard deviation of object scale change";
CM_ SG_ 178 VFC_Obj01A_HeadingAngle "Heading angle of the object";
CM_ SG_ 178 VFC_Obj01A_HeadingAngleStdDev "Standard deviation of object Heading angle";
CM_ SG_ 178 VFC_Obj01A_HeadOrientation "The orientation of the head of cyclists or pedestrians that are detected";
CM_ SG_ 178 VFC_Obj01A_CompletelyInImg "indicator if the object is completely measured in the image";
CM_ SG_ 178 VFC_Obj01A_ProbMovingLat "Probability of object moving laterally";
CM_ SG_ 178 VFC_Obj01A_ProbMovingLong "Probability of object moving longitudinally";
CM_ SG_ 178 VFC_Obj01A_ProbExist "Object existence probability";
CM_ SG_ 178 VFC_Obj01A_MeasSource "Bitfield for the measurement programs from which this object originates
Bit 0: MOD
Bit 1: PDET
Bit 2: OFT
Bit 3: OLS
Bit 4: RESERVED";
CM_ SG_ 178 VFC_Obj01A_Reliability "The bitfield shows if the signal quality is assumed to be sufficient for functions with safety target -no false positives- 
Bit 0: DYNAMIC
Bit 1: SEMSEG_SURFACE
Bit 2: WDD_CRITICAL
Bit 3: GOD_CONFIRMED
Bit 4: RESTRICTED
Bit 5: ISO26262_SAFE";
CM_ SG_ 178 VFC_Obj01A_Measured "Indicator if the object detected is measured or predicted";
CM_ SG_ 178 VFC_Obj01A_VisibleView "The visible view of the detected object";
CM_ SG_ 178 VFC_Obj01A_ClassifiedView "The classified view of object to be used in connection with Heading angle";
CM_ SG_ 178 VFC_Obj01A_DirIndicator "The detected direction indicator lights";
CM_ SG_ 178 VFC_Obj01A_BrakeLight "The number of detected lights. More confident if more lights are detected.";
CM_ SG_ 180 VFC_Obj02A_CRC "CRC - Autosar E2E Profile 5";
CM_ SG_ 180 VFC_Obj02A_AliveCtr "Alive counter - Autosar E2E Profile 5";
CM_ SG_ 180 VFC_Obj02A_ProtBlockCtr "Protocol-Signal: Block-Counter";
CM_ SG_ 180 VFC_Obj02A_ID "Unique Object ID";
CM_ SG_ 180 VFC_Obj02A_Type "Classification of the object";
CM_ SG_ 180 VFC_Obj02A_TypeProb "Probability of the classified object type";
CM_ SG_ 180 VFC_Obj02A_Dx "Object distance in longitudinal direction";
CM_ SG_ 180 VFC_Obj02A_Dy "Object distance in lateral direction";
CM_ SG_ 180 VFC_Obj02A_Vx "Object velocity in longitudinal direction";
CM_ SG_ 180 VFC_Obj02A_Vy "Object velocity in lateral direction";
CM_ SG_ 180 VFC_Obj02A_Ax "Object acceleration in longitudinal direction";
CM_ SG_ 180 VFC_Obj02A_Ay "Object acceleration in lateral direction";
CM_ SG_ 180 VFC_Obj02A_DxStdDev "Standard deviation of Object distance in longitudinal direction";
CM_ SG_ 180 VFC_Obj02A_DyStdDev "Standard deviation of Object distance in lateral direction";
CM_ SG_ 180 VFC_Obj02A_VxStdDev "Standard deviation of Object velocity in longitudinal direction";
CM_ SG_ 180 VFC_Obj02A_VyStdDev "Standard deviation of Object velocity in lateral direction";
CM_ SG_ 180 VFC_Obj02A_AxStdDev "Standard deviation of Object acceleration in longitudinal direction";
CM_ SG_ 180 VFC_Obj02A_AyStdDev "Standard deviation of Object acceleration in lateral direction";
CM_ SG_ 180 VFC_Obj02A_Length "Length of the object";
CM_ SG_ 180 VFC_Obj02A_Width "Width of the object";
CM_ SG_ 180 VFC_Obj02A_Height "Height of the object";
CM_ SG_ 180 VFC_Obj02A_LengthStdDev "Standard deviation of object length";
CM_ SG_ 180 VFC_Obj02A_WidthStdDev "Standard deviation of object width";
CM_ SG_ 180 VFC_Obj02A_HeightStdDev "Standard deviation of object height";
CM_ SG_ 180 VFC_Obj02A_EdgeLeft "In ACCS coordinates; corresponds to tan(viewing angle of left object edge)";
CM_ SG_ 180 VFC_Obj02A_EdgeMid "In ACCS coordinates; corresponds to tan(viewing angle of middle object edge)";
CM_ SG_ 180 VFC_Obj02A_EdgeRight "In ACCS coordinates; corresponds to tan(viewing angle of right object edge)";
CM_ SG_ 180 VFC_Obj02A_EdgeTop "In ACCS coordinates; corresponds to tan(viewing angle of top object edge)";
CM_ SG_ 180 VFC_Obj02A_EdgeBottom "In ACCS coordinates; corresponds to tan(viewing angle of bottom object edge)";
CM_ SG_ 180 VFC_Obj02A_EdgeLeftStdDev "Standard deviation of the ACCS left object edge";
CM_ SG_ 180 VFC_Obj02A_EdgeMidStdDev "Standard deviation of the ACCS middle object edge";
CM_ SG_ 180 VFC_Obj02A_EdgeRightStdDev "Standard deviation of the ACCS right object edge";
CM_ SG_ 180 VFC_Obj02A_EdgeTopStdDev "Standard deviation of the ACCS top object edge";
CM_ SG_ 180 VFC_Obj02A_EdgeBottomStdDev "Standard deviation of the ACCS bottom object edge";
CM_ SG_ 180 VFC_Obj02A_NormVx "Normalised Object velocity in longitudinal direction";
CM_ SG_ 180 VFC_Obj02A_NormAx "Normalised Object acceleration in longitudinal direction";
CM_ SG_ 180 VFC_Obj02A_NormVyEdgeLeft "Normalised velocity of the ACCS left object edge in lateral direction";
CM_ SG_ 180 VFC_Obj02A_NormVyEdgeRight "Normalised velocity of the ACCS right object edge in lateral direction";
CM_ SG_ 180 VFC_Obj02A_NormVxStdDev "Standard deviation of Normalised Object velocity in longitudinal direction";
CM_ SG_ 180 VFC_Obj02A_NormAxStdDev "Standard deviation of Normalised Object acceleration in longitudinal direction";
CM_ SG_ 180 VFC_Obj02A_NormVyEdgeLeftStdDev "Standard deviation of Normalised velocity of the ACCS left object edge in lateral direction";
CM_ SG_ 180 VFC_Obj02A_NormVyEdgeRightStdDev "Standard deviation of Normalised velocity of the ACCS right object edge in lateral direction";
CM_ SG_ 180 VFC_Obj02A_ScaleChange "A scale change of of the detected object";
CM_ SG_ 180 VFC_Obj02A_ScaleChngStdDev "Standard deviation of object scale change";
CM_ SG_ 180 VFC_Obj02A_HeadingAngle "Heading angle of the object";
CM_ SG_ 180 VFC_Obj02A_HeadingAngleStdDev "Standard deviation of object Heading angle";
CM_ SG_ 180 VFC_Obj02A_HeadOrientation "The orientation of the head of cyclists or pedestrians that are detected";
CM_ SG_ 180 VFC_Obj02A_CompletelyInImg "indicator if the object is completely measured in the image";
CM_ SG_ 180 VFC_Obj02A_ProbMovingLat "Probability of object moving laterally";
CM_ SG_ 180 VFC_Obj02A_ProbMovingLong "Probability of object moving longitudinally";
CM_ SG_ 180 VFC_Obj02A_ProbExist "Object existence probability";
CM_ SG_ 180 VFC_Obj02A_MeasSource "Bitfield for the measurement programs from which this object originates
Bit 0: MOD
Bit 1: PDET
Bit 2: OFT
Bit 3: OLS
Bit 4: RESERVED";
CM_ SG_ 180 VFC_Obj02A_Reliability "The bitfield shows if the signal quality is assumed to be sufficient for functions with safety target -no false positives-
Bit 0: DYNAMIC
Bit 1: SEMSEG_SURFACE
Bit 2: WDD_CRITICAL
Bit 3: GOD_CONFIRMED
Bit 4: RESTRICTED
Bit 5: ISO26262_SAFE";
CM_ SG_ 180 VFC_Obj02A_Measured "Indicator if the object detected is measured or predicted";
CM_ SG_ 180 VFC_Obj02A_VisibleView "The visible view of the detected object";
CM_ SG_ 180 VFC_Obj02A_ClassifiedView "The classified view of object to be used in connection with Heading angle";
CM_ SG_ 180 VFC_Obj02A_DirIndicator "The detected direction indicator lights";
CM_ SG_ 180 VFC_Obj02A_BrakeLight "The number of detected lights. More confident if more lights are detected.";
CM_ SG_ 182 VFC_Obj03A_CRC "CRC - Autosar E2E Profile 5";
CM_ SG_ 182 VFC_Obj03A_AliveCtr "Alive counter - Autosar E2E Profile 5";
CM_ SG_ 182 VFC_Obj03A_ProtBlockCtr "Protocol-Signal: Block-Counter";
CM_ SG_ 182 VFC_Obj03A_ID "Unique Object ID";
CM_ SG_ 182 VFC_Obj03A_Type "Classification of the object";
CM_ SG_ 182 VFC_Obj03A_TypeProb "Probability of the classified object type";
CM_ SG_ 182 VFC_Obj03A_Dx "Object distance in longitudinal direction";
CM_ SG_ 182 VFC_Obj03A_Dy "Object distance in lateral direction";
CM_ SG_ 182 VFC_Obj03A_Vx "Object velocity in longitudinal direction";
CM_ SG_ 182 VFC_Obj03A_Vy "Object velocity in lateral direction";
CM_ SG_ 182 VFC_Obj03A_Ax "Object acceleration in longitudinal direction";
CM_ SG_ 182 VFC_Obj03A_Ay "Object acceleration in lateral direction";
CM_ SG_ 182 VFC_Obj03A_DxStdDev "Standard deviation of Object distance in longitudinal direction";
CM_ SG_ 182 VFC_Obj03A_DyStdDev "Standard deviation of Object distance in lateral direction";
CM_ SG_ 182 VFC_Obj03A_VxStdDev "Standard deviation of Object velocity in longitudinal direction";
CM_ SG_ 182 VFC_Obj03A_VyStdDev "Standard deviation of Object velocity in lateral direction";
CM_ SG_ 182 VFC_Obj03A_AxStdDev "Standard deviation of Object acceleration in longitudinal direction";
CM_ SG_ 182 VFC_Obj03A_AyStdDev "Standard deviation of Object acceleration in lateral direction";
CM_ SG_ 182 VFC_Obj03A_Length "Length of the object";
CM_ SG_ 182 VFC_Obj03A_Width "Width of the object";
CM_ SG_ 182 VFC_Obj03A_Height "Height of the object";
CM_ SG_ 182 VFC_Obj03A_LengthStdDev "Standard deviation of object length";
CM_ SG_ 182 VFC_Obj03A_WidthStdDev "Standard deviation of object width";
CM_ SG_ 182 VFC_Obj03A_HeightStdDev "Standard deviation of object height";
CM_ SG_ 182 VFC_Obj03A_EdgeLeft "In ACCS coordinates; corresponds to tan(viewing angle of left object edge)";
CM_ SG_ 182 VFC_Obj03A_EdgeMid "In ACCS coordinates; corresponds to tan(viewing angle of middle object edge)";
CM_ SG_ 182 VFC_Obj03A_EdgeRight "In ACCS coordinates; corresponds to tan(viewing angle of right object edge)";
CM_ SG_ 182 VFC_Obj03A_EdgeTop "In ACCS coordinates; corresponds to tan(viewing angle of top object edge)";
CM_ SG_ 182 VFC_Obj03A_EdgeBottom "In ACCS coordinates; corresponds to tan(viewing angle of bottom object edge)";
CM_ SG_ 182 VFC_Obj03A_EdgeLeftStdDev "Standard deviation of the ACCS left object edge";
CM_ SG_ 182 VFC_Obj03A_EdgeMidStdDev "Standard deviation of the ACCS middle object edge";
CM_ SG_ 182 VFC_Obj03A_EdgeRightStdDev "Standard deviation of the ACCS right object edge";
CM_ SG_ 182 VFC_Obj03A_EdgeTopStdDev "Standard deviation of the ACCS top object edge";
CM_ SG_ 182 VFC_Obj03A_EdgeBottomStdDev "Standard deviation of the ACCS bottom object edge";
CM_ SG_ 182 VFC_Obj03A_NormVx "Normalised Object velocity in longitudinal direction";
CM_ SG_ 182 VFC_Obj03A_NormAx "Normalised Object acceleration in longitudinal direction";
CM_ SG_ 182 VFC_Obj03A_NormVyEdgeLeft "Normalised velocity of the ACCS left object edge in lateral direction";
CM_ SG_ 182 VFC_Obj03A_NormVyEdgeRight "Normalised velocity of the ACCS right object edge in lateral direction";
CM_ SG_ 182 VFC_Obj03A_NormVxStdDev "Standard deviation of Normalised Object velocity in longitudinal direction";
CM_ SG_ 182 VFC_Obj03A_NormAxStdDev "Standard deviation of Normalised Object acceleration in longitudinal direction";
CM_ SG_ 182 VFC_Obj03A_NormVyEdgeLeftStdDev "Standard deviation of Normalised velocity of the ACCS left object edge in lateral direction";
CM_ SG_ 182 VFC_Obj03A_NormVyEdgeRightStdDev "Standard deviation of Normalised velocity of the ACCS right object edge in lateral direction";
CM_ SG_ 182 VFC_Obj03A_ScaleChange "A scale change of of the detected object";
CM_ SG_ 182 VFC_Obj03A_ScaleChngStdDev "Standard deviation of object scale change";
CM_ SG_ 182 VFC_Obj03A_HeadingAngle "Heading angle of the object";
CM_ SG_ 182 VFC_Obj03A_HeadingAngleStdDev "Standard deviation of object Heading angle";
CM_ SG_ 182 VFC_Obj03A_HeadOrientation "The orientation of the head of cyclists or pedestrians that are detected";
CM_ SG_ 182 VFC_Obj03A_CompletelyInImg "indicator if the object is completely measured in the image";
CM_ SG_ 182 VFC_Obj03A_ProbMovingLat "Probability of object moving laterally";
CM_ SG_ 182 VFC_Obj03A_ProbMovingLong "Probability of object moving longitudinally";
CM_ SG_ 182 VFC_Obj03A_ProbExist "Object existence probability";
CM_ SG_ 182 VFC_Obj03A_MeasSource "Bitfield for the measurement programs from which this object originates
Bit 0: MOD
Bit 1: PDET
Bit 2: OFT
Bit 3: OLS
Bit 4: RESERVED";
CM_ SG_ 182 VFC_Obj03A_Reliability "The bitfield shows if the signal quality is assumed to be sufficient for functions with safety target -no false positives-
Bit 0: DYNAMIC
Bit 1: SEMSEG_SURFACE
Bit 2: WDD_CRITICAL
Bit 3: GOD_CONFIRMED
Bit 4: RESTRICTED
Bit 5: ISO26262_SAFE";
CM_ SG_ 182 VFC_Obj03A_Measured "Indicator if the object detected is measured or predicted";
CM_ SG_ 182 VFC_Obj03A_VisibleView "The visible view of the detected object";
CM_ SG_ 182 VFC_Obj03A_ClassifiedView "The classified view of object to be used in connection with Heading angle";
CM_ SG_ 182 VFC_Obj03A_DirIndicator "The detected direction indicator lights";
CM_ SG_ 182 VFC_Obj03A_BrakeLight "The number of detected lights. More confident if more lights are detected.";
CM_ SG_ 184 VFC_Obj04A_CRC "CRC - Autosar E2E Profile 5";
CM_ SG_ 184 VFC_Obj04A_AliveCtr "Alive counter - Autosar E2E Profile 5";
CM_ SG_ 184 VFC_Obj04A_ProtBlockCtr "Protocol-Signal: Block-Counter";
CM_ SG_ 184 VFC_Obj04A_ID "Unique Object ID";
CM_ SG_ 184 VFC_Obj04A_Type "Classification of the object";
CM_ SG_ 184 VFC_Obj04A_TypeProb "Probability of the classified object type";
CM_ SG_ 184 VFC_Obj04A_Dx "Object distance in longitudinal direction";
CM_ SG_ 184 VFC_Obj04A_Dy "Object distance in lateral direction";
CM_ SG_ 184 VFC_Obj04A_Vx "Object velocity in longitudinal direction";
CM_ SG_ 184 VFC_Obj04A_Vy "Object velocity in lateral direction";
CM_ SG_ 184 VFC_Obj04A_Ax "Object acceleration in longitudinal direction";
CM_ SG_ 184 VFC_Obj04A_Ay "Object acceleration in lateral direction";
CM_ SG_ 184 VFC_Obj04A_DxStdDev "Standard deviation of Object distance in longitudinal direction";
CM_ SG_ 184 VFC_Obj04A_DyStdDev "Standard deviation of Object distance in lateral direction";
CM_ SG_ 184 VFC_Obj04A_VxStdDev "Standard deviation of Object velocity in longitudinal direction";
CM_ SG_ 184 VFC_Obj04A_VyStdDev "Standard deviation of Object velocity in lateral direction";
CM_ SG_ 184 VFC_Obj04A_AxStdDev "Standard deviation of Object acceleration in longitudinal direction";
CM_ SG_ 184 VFC_Obj04A_AyStdDev "Standard deviation of Object acceleration in lateral direction";
CM_ SG_ 184 VFC_Obj04A_Length "Length of the object";
CM_ SG_ 184 VFC_Obj04A_Width "Width of the object";
CM_ SG_ 184 VFC_Obj04A_Height "Height of the object";
CM_ SG_ 184 VFC_Obj04A_LengthStdDev "Standard deviation of object length";
CM_ SG_ 184 VFC_Obj04A_WidthStdDev "Standard deviation of object width";
CM_ SG_ 184 VFC_Obj04A_HeightStdDev "Standard deviation of object height";
CM_ SG_ 184 VFC_Obj04A_EdgeLeft "In ACCS coordinates; corresponds to tan(viewing angle of left object edge)";
CM_ SG_ 184 VFC_Obj04A_EdgeMid "In ACCS coordinates; corresponds to tan(viewing angle of middle object edge)";
CM_ SG_ 184 VFC_Obj04A_EdgeRight "In ACCS coordinates; corresponds to tan(viewing angle of right object edge)";
CM_ SG_ 184 VFC_Obj04A_EdgeTop "In ACCS coordinates; corresponds to tan(viewing angle of top object edge)";
CM_ SG_ 184 VFC_Obj04A_EdgeBottom "In ACCS coordinates; corresponds to tan(viewing angle of bottom object edge)";
CM_ SG_ 184 VFC_Obj04A_EdgeLeftStdDev "Standard deviation of the ACCS left object edge";
CM_ SG_ 184 VFC_Obj04A_EdgeMidStdDev "Standard deviation of the ACCS middle object edge";
CM_ SG_ 184 VFC_Obj04A_EdgeRightStdDev "Standard deviation of the ACCS right object edge";
CM_ SG_ 184 VFC_Obj04A_EdgeTopStdDev "Standard deviation of the ACCS top object edge";
CM_ SG_ 184 VFC_Obj04A_EdgeBottomStdDev "Standard deviation of the ACCS bottom object edge";
CM_ SG_ 184 VFC_Obj04A_NormVx "Normalised Object velocity in longitudinal direction";
CM_ SG_ 184 VFC_Obj04A_NormAx "Normalised Object acceleration in longitudinal direction";
CM_ SG_ 184 VFC_Obj04A_NormVyEdgeLeft "Normalised velocity of the ACCS left object edge in lateral direction";
CM_ SG_ 184 VFC_Obj04A_NormVyEdgeRight "Normalised velocity of the ACCS right object edge in lateral direction";
CM_ SG_ 184 VFC_Obj04A_NormVxStdDev "Standard deviation of Normalised Object velocity in longitudinal direction";
CM_ SG_ 184 VFC_Obj04A_NormAxStdDev "Standard deviation of Normalised Object acceleration in longitudinal direction";
CM_ SG_ 184 VFC_Obj04A_NormVyEdgeLeftStdDev "Standard deviation of Normalised velocity of the ACCS left object edge in lateral direction";
CM_ SG_ 184 VFC_Obj04A_NormVyEdgeRightStdDev "Standard deviation of Normalised velocity of the ACCS right object edge in lateral direction";
CM_ SG_ 184 VFC_Obj04A_ScaleChange "A scale change of of the detected object";
CM_ SG_ 184 VFC_Obj04A_ScaleChngStdDev "Standard deviation of object scale change";
CM_ SG_ 184 VFC_Obj04A_HeadingAngle "Heading angle of the object";
CM_ SG_ 184 VFC_Obj04A_HeadingAngleStdDev "Standard deviation of object Heading angle";
CM_ SG_ 184 VFC_Obj04A_HeadOrientation "The orientation of the head of cyclists or pedestrians that are detected";
CM_ SG_ 184 VFC_Obj04A_CompletelyInImg "indicator if the object is completely measured in the image";
CM_ SG_ 184 VFC_Obj04A_ProbMovingLat "Probability of object moving laterally";
CM_ SG_ 184 VFC_Obj04A_ProbMovingLong "Probability of object moving longitudinally";
CM_ SG_ 184 VFC_Obj04A_ProbExist "Object existence probability";
CM_ SG_ 184 VFC_Obj04A_MeasSource "Bitfield for the measurement programs from which this object originates
Bit 0: MOD
Bit 1: PDET
Bit 2: OFT
Bit 3: OLS
Bit 4: RESERVED";
CM_ SG_ 184 VFC_Obj04A_Reliability "The bitfield shows if the signal quality is assumed to be sufficient for functions with safety target -no false positives-
Bit 0: DYNAMIC
Bit 1: SEMSEG_SURFACE
Bit 2: WDD_CRITICAL
Bit 3: GOD_CONFIRMED
Bit 4: RESTRICTED
Bit 5: ISO26262_SAFE";
CM_ SG_ 184 VFC_Obj04A_Measured "Indicator if the object detected is measured or predicted";
CM_ SG_ 184 VFC_Obj04A_VisibleView "The visible view of the detected object";
CM_ SG_ 184 VFC_Obj04A_ClassifiedView "The classified view of object to be used in connection with Heading angle";
CM_ SG_ 184 VFC_Obj04A_DirIndicator "The detected direction indicator lights";
CM_ SG_ 184 VFC_Obj04A_BrakeLight "The number of detected lights. More confident if more lights are detected.";
CM_ SG_ 186 VFC_Obj05A_CRC "CRC - Autosar E2E Profile 5";
CM_ SG_ 186 VFC_Obj05A_AliveCtr "Alive counter - Autosar E2E Profile 5";
CM_ SG_ 186 VFC_Obj05A_ProtBlockCtr "Protocol-Signal: Block-Counter";
CM_ SG_ 186 VFC_Obj05A_ID "Unique Object ID";
CM_ SG_ 186 VFC_Obj05A_Type "Classification of the object";
CM_ SG_ 186 VFC_Obj05A_TypeProb "Probability of the classified object type";
CM_ SG_ 186 VFC_Obj05A_Dx "Object distance in longitudinal direction";
CM_ SG_ 186 VFC_Obj05A_Dy "Object distance in lateral direction";
CM_ SG_ 186 VFC_Obj05A_Vx "Object velocity in longitudinal direction";
CM_ SG_ 186 VFC_Obj05A_Vy "Object velocity in lateral direction";
CM_ SG_ 186 VFC_Obj05A_Ax "Object acceleration in longitudinal direction";
CM_ SG_ 186 VFC_Obj05A_Ay "Object acceleration in lateral direction";
CM_ SG_ 186 VFC_Obj05A_DxStdDev "Standard deviation of Object distance in longitudinal direction";
CM_ SG_ 186 VFC_Obj05A_DyStdDev "Standard deviation of Object distance in lateral direction";
CM_ SG_ 186 VFC_Obj05A_VxStdDev "Standard deviation of Object velocity in longitudinal direction";
CM_ SG_ 186 VFC_Obj05A_VyStdDev "Standard deviation of Object velocity in lateral direction";
CM_ SG_ 186 VFC_Obj05A_AxStdDev "Standard deviation of Object acceleration in longitudinal direction";
CM_ SG_ 186 VFC_Obj05A_AyStdDev "Standard deviation of Object acceleration in lateral direction";
CM_ SG_ 186 VFC_Obj05A_Length "Length of the object";
CM_ SG_ 186 VFC_Obj05A_Width "Width of the object";
CM_ SG_ 186 VFC_Obj05A_Height "Height of the object";
CM_ SG_ 186 VFC_Obj05A_LengthStdDev "Standard deviation of object length";
CM_ SG_ 186 VFC_Obj05A_WidthStdDev "Standard deviation of object width";
CM_ SG_ 186 VFC_Obj05A_HeightStdDev "Standard deviation of object height";
CM_ SG_ 186 VFC_Obj05A_EdgeLeft "In ACCS coordinates; corresponds to tan(viewing angle of left object edge)";
CM_ SG_ 186 VFC_Obj05A_EdgeMid "In ACCS coordinates; corresponds to tan(viewing angle of middle object edge)";
CM_ SG_ 186 VFC_Obj05A_EdgeRight "In ACCS coordinates; corresponds to tan(viewing angle of right object edge)";
CM_ SG_ 186 VFC_Obj05A_EdgeTop "In ACCS coordinates; corresponds to tan(viewing angle of top object edge)";
CM_ SG_ 186 VFC_Obj05A_EdgeBottom "In ACCS coordinates; corresponds to tan(viewing angle of bottom object edge)";
CM_ SG_ 186 VFC_Obj05A_EdgeLeftStdDev "Standard deviation of the ACCS left object edge";
CM_ SG_ 186 VFC_Obj05A_EdgeMidStdDev "Standard deviation of the ACCS middle object edge";
CM_ SG_ 186 VFC_Obj05A_EdgeRightStdDev "Standard deviation of the ACCS right object edge";
CM_ SG_ 186 VFC_Obj05A_EdgeTopStdDev "Standard deviation of the ACCS top object edge";
CM_ SG_ 186 VFC_Obj05A_EdgeBottomStdDev "Standard deviation of the ACCS bottom object edge";
CM_ SG_ 186 VFC_Obj05A_NormVx "Normalised Object velocity in longitudinal direction";
CM_ SG_ 186 VFC_Obj05A_NormAx "Normalised Object acceleration in longitudinal direction";
CM_ SG_ 186 VFC_Obj05A_NormVyEdgeLeft "Normalised velocity of the ACCS left object edge in lateral direction";
CM_ SG_ 186 VFC_Obj05A_NormVyEdgeRight "Normalised velocity of the ACCS right object edge in lateral direction";
CM_ SG_ 186 VFC_Obj05A_NormVxStdDev "Standard deviation of Normalised Object velocity in longitudinal direction";
CM_ SG_ 186 VFC_Obj05A_NormAxStdDev "Standard deviation of Normalised Object acceleration in longitudinal direction";
CM_ SG_ 186 VFC_Obj05A_NormVyEdgeLeftStdDev "Standard deviation of Normalised velocity of the ACCS left object edge in lateral direction";
CM_ SG_ 186 VFC_Obj05A_NormVyEdgeRightStdDev "Standard deviation of Normalised velocity of the ACCS right object edge in lateral direction";
CM_ SG_ 186 VFC_Obj05A_ScaleChange "A scale change of of the detected object";
CM_ SG_ 186 VFC_Obj05A_ScaleChngStdDev "Standard deviation of object scale change";
CM_ SG_ 186 VFC_Obj05A_HeadingAngle "Heading angle of the object";
CM_ SG_ 186 VFC_Obj05A_HeadingAngleStdDev "Standard deviation of object Heading angle";
CM_ SG_ 186 VFC_Obj05A_HeadOrientation "The orientation of the head of cyclists or pedestrians that are detected";
CM_ SG_ 186 VFC_Obj05A_CompletelyInImg "indicator if the object is completely measured in the image";
CM_ SG_ 186 VFC_Obj05A_ProbMovingLat "Probability of object moving laterally";
CM_ SG_ 186 VFC_Obj05A_ProbMovingLong "Probability of object moving longitudinally";
CM_ SG_ 186 VFC_Obj05A_ProbExist "Object existence probability";
CM_ SG_ 186 VFC_Obj05A_MeasSource "Bitfield for the measurement programs from which this object originates
Bit 0: MOD
Bit 1: PDET
Bit 2: OFT
Bit 3: OLS
Bit 4: RESERVED";
CM_ SG_ 186 VFC_Obj05A_Reliability "The bitfield shows if the signal quality is assumed to be sufficient for functions with safety target -no false positives-
Bit 0: DYNAMIC
Bit 1: SEMSEG_SURFACE
Bit 2: WDD_CRITICAL
Bit 3: GOD_CONFIRMED
Bit 4: RESTRICTED
Bit 5: ISO26262_SAFE";
CM_ SG_ 186 VFC_Obj05A_Measured "Indicator if the object detected is measured or predicted";
CM_ SG_ 186 VFC_Obj05A_VisibleView "The visible view of the detected object";
CM_ SG_ 186 VFC_Obj05A_ClassifiedView "The classified view of object to be used in connection with Heading angle";
CM_ SG_ 186 VFC_Obj05A_DirIndicator "The detected direction indicator lights";
CM_ SG_ 186 VFC_Obj05A_BrakeLight "The number of detected lights. More confident if more lights are detected.";
CM_ SG_ 188 VFC_Obj06A_CRC "CRC - Autosar E2E Profile 5";
CM_ SG_ 188 VFC_Obj06A_AliveCtr "Alive counter - Autosar E2E Profile 5";
CM_ SG_ 188 VFC_Obj06A_ProtBlockCtr "Protocol-Signal: Block-Counter";
CM_ SG_ 188 VFC_Obj06A_ID "Unique Object ID";
CM_ SG_ 188 VFC_Obj06A_Type "Classification of the object";
CM_ SG_ 188 VFC_Obj06A_TypeProb "Probability of the classified object type";
CM_ SG_ 188 VFC_Obj06A_Dx "Object distance in longitudinal direction";
CM_ SG_ 188 VFC_Obj06A_Dy "Object distance in lateral direction";
CM_ SG_ 188 VFC_Obj06A_Vx "Object velocity in longitudinal direction";
CM_ SG_ 188 VFC_Obj06A_Vy "Object velocity in lateral direction";
CM_ SG_ 188 VFC_Obj06A_Ax "Object acceleration in longitudinal direction";
CM_ SG_ 188 VFC_Obj06A_Ay "Object acceleration in lateral direction";
CM_ SG_ 188 VFC_Obj06A_DxStdDev "Standard deviation of Object distance in longitudinal direction";
CM_ SG_ 188 VFC_Obj06A_DyStdDev "Standard deviation of Object distance in lateral direction";
CM_ SG_ 188 VFC_Obj06A_VxStdDev "Standard deviation of Object velocity in longitudinal direction";
CM_ SG_ 188 VFC_Obj06A_VyStdDev "Standard deviation of Object velocity in lateral direction";
CM_ SG_ 188 VFC_Obj06A_AxStdDev "Standard deviation of Object acceleration in longitudinal direction";
CM_ SG_ 188 VFC_Obj06A_AyStdDev "Standard deviation of Object acceleration in lateral direction";
CM_ SG_ 188 VFC_Obj06A_Length "Length of the object";
CM_ SG_ 188 VFC_Obj06A_Width "Width of the object";
CM_ SG_ 188 VFC_Obj06A_Height "Height of the object";
CM_ SG_ 188 VFC_Obj06A_LengthStdDev "Standard deviation of object length";
CM_ SG_ 188 VFC_Obj06A_WidthStdDev "Standard deviation of object width";
CM_ SG_ 188 VFC_Obj06A_HeightStdDev "Standard deviation of object height";
CM_ SG_ 188 VFC_Obj06A_EdgeLeft "In ACCS coordinates; corresponds to tan(viewing angle of left object edge)";
CM_ SG_ 188 VFC_Obj06A_EdgeMid "In ACCS coordinates; corresponds to tan(viewing angle of middle object edge)";
CM_ SG_ 188 VFC_Obj06A_EdgeRight "In ACCS coordinates; corresponds to tan(viewing angle of right object edge)";
CM_ SG_ 188 VFC_Obj06A_EdgeTop "In ACCS coordinates; corresponds to tan(viewing angle of top object edge)";
CM_ SG_ 188 VFC_Obj06A_EdgeBottom "In ACCS coordinates; corresponds to tan(viewing angle of bottom object edge)";
CM_ SG_ 188 VFC_Obj06A_EdgeLeftStdDev "Standard deviation of the ACCS left object edge";
CM_ SG_ 188 VFC_Obj06A_EdgeMidStdDev "Standard deviation of the ACCS middle object edge";
CM_ SG_ 188 VFC_Obj06A_EdgeRightStdDev "Standard deviation of the ACCS right object edge";
CM_ SG_ 188 VFC_Obj06A_EdgeTopStdDev "Standard deviation of the ACCS top object edge";
CM_ SG_ 188 VFC_Obj06A_EdgeBottomStdDev "Standard deviation of the ACCS bottom object edge";
CM_ SG_ 188 VFC_Obj06A_NormVx "Normalised Object velocity in longitudinal direction";
CM_ SG_ 188 VFC_Obj06A_NormAx "Normalised Object acceleration in longitudinal direction";
CM_ SG_ 188 VFC_Obj06A_NormVyEdgeLeft "Normalised velocity of the ACCS left object edge in lateral direction";
CM_ SG_ 188 VFC_Obj06A_NormVyEdgeRight "Normalised velocity of the ACCS right object edge in lateral direction";
CM_ SG_ 188 VFC_Obj06A_NormVxStdDev "Standard deviation of Normalised Object velocity in longitudinal direction";
CM_ SG_ 188 VFC_Obj06A_NormAxStdDev "Standard deviation of Normalised Object acceleration in longitudinal direction";
CM_ SG_ 188 VFC_Obj06A_NormVyEdgeLeftStdDev "Standard deviation of Normalised velocity of the ACCS left object edge in lateral direction";
CM_ SG_ 188 VFC_Obj06A_NormVyEdgeRightStdDev "Standard deviation of Normalised velocity of the ACCS right object edge in lateral direction";
CM_ SG_ 188 VFC_Obj06A_ScaleChange "A scale change of of the detected object";
CM_ SG_ 188 VFC_Obj06A_ScaleChngStdDev "Standard deviation of object scale change";
CM_ SG_ 188 VFC_Obj06A_HeadingAngle "Heading angle of the object";
CM_ SG_ 188 VFC_Obj06A_HeadingAngleStdDev "Standard deviation of object Heading angle";
CM_ SG_ 188 VFC_Obj06A_HeadOrientation "The orientation of the head of cyclists or pedestrians that are detected";
CM_ SG_ 188 VFC_Obj06A_CompletelyInImg "indicator if the object is completely measured in the image";
CM_ SG_ 188 VFC_Obj06A_ProbMovingLat "Probability of object moving laterally";
CM_ SG_ 188 VFC_Obj06A_ProbMovingLong "Probability of object moving longitudinally";
CM_ SG_ 188 VFC_Obj06A_ProbExist "Object existence probability";
CM_ SG_ 188 VFC_Obj06A_MeasSource "Bitfield for the measurement programs from which this object originates
Bit 0: MOD
Bit 1: PDET
Bit 2: OFT
Bit 3: OLS
Bit 4: RESERVED";
CM_ SG_ 188 VFC_Obj06A_Reliability "The bitfield shows if the signal quality is assumed to be sufficient for functions with safety target -no false positives-
Bit 0: DYNAMIC
Bit 1: SEMSEG_SURFACE
Bit 2: WDD_CRITICAL
Bit 3: GOD_CONFIRMED
Bit 4: RESTRICTED
Bit 5: ISO26262_SAFE";
CM_ SG_ 188 VFC_Obj06A_Measured "Indicator if the object detected is measured or predicted";
CM_ SG_ 188 VFC_Obj06A_VisibleView "The visible view of the detected object";
CM_ SG_ 188 VFC_Obj06A_ClassifiedView "The classified view of object to be used in connection with Heading angle";
CM_ SG_ 188 VFC_Obj06A_DirIndicator "The detected direction indicator lights";
CM_ SG_ 188 VFC_Obj06A_BrakeLight "The number of detected lights. More confident if more lights are detected.";
CM_ SG_ 190 VFC_Obj07A_CRC "CRC - Autosar E2E Profile 5";
CM_ SG_ 190 VFC_Obj07A_AliveCtr "Alive counter - Autosar E2E Profile 5";
CM_ SG_ 190 VFC_Obj07A_ProtBlockCtr "Protocol-Signal: Block-Counter";
CM_ SG_ 190 VFC_Obj07A_ID "Unique Object ID";
CM_ SG_ 190 VFC_Obj07A_Type "Classification of the object";
CM_ SG_ 190 VFC_Obj07A_TypeProb "Probability of the classified object type";
CM_ SG_ 190 VFC_Obj07A_Dx "Object distance in longitudinal direction";
CM_ SG_ 190 VFC_Obj07A_Dy "Object distance in lateral direction";
CM_ SG_ 190 VFC_Obj07A_Vx "Object velocity in longitudinal direction";
CM_ SG_ 190 VFC_Obj07A_Vy "Object velocity in lateral direction";
CM_ SG_ 190 VFC_Obj07A_Ax "Object acceleration in longitudinal direction";
CM_ SG_ 190 VFC_Obj07A_Ay "Object acceleration in lateral direction";
CM_ SG_ 190 VFC_Obj07A_DxStdDev "Standard deviation of Object distance in longitudinal direction";
CM_ SG_ 190 VFC_Obj07A_DyStdDev "Standard deviation of Object distance in lateral direction";
CM_ SG_ 190 VFC_Obj07A_VxStdDev "Standard deviation of Object velocity in longitudinal direction";
CM_ SG_ 190 VFC_Obj07A_VyStdDev "Standard deviation of Object velocity in lateral direction";
CM_ SG_ 190 VFC_Obj07A_AxStdDev "Standard deviation of Object acceleration in longitudinal direction";
CM_ SG_ 190 VFC_Obj07A_AyStdDev "Standard deviation of Object acceleration in lateral direction";
CM_ SG_ 190 VFC_Obj07A_Length "Length of the object";
CM_ SG_ 190 VFC_Obj07A_Width "Width of the object";
CM_ SG_ 190 VFC_Obj07A_Height "Height of the object";
CM_ SG_ 190 VFC_Obj07A_LengthStdDev "Standard deviation of object length";
CM_ SG_ 190 VFC_Obj07A_WidthStdDev "Standard deviation of object width";
CM_ SG_ 190 VFC_Obj07A_HeightStdDev "Standard deviation of object height";
CM_ SG_ 190 VFC_Obj07A_EdgeLeft "In ACCS coordinates; corresponds to tan(viewing angle of left object edge)";
CM_ SG_ 190 VFC_Obj07A_EdgeMid "In ACCS coordinates; corresponds to tan(viewing angle of middle object edge)";
CM_ SG_ 190 VFC_Obj07A_EdgeRight "In ACCS coordinates; corresponds to tan(viewing angle of right object edge)";
CM_ SG_ 190 VFC_Obj07A_EdgeTop "In ACCS coordinates; corresponds to tan(viewing angle of top object edge)";
CM_ SG_ 190 VFC_Obj07A_EdgeBottom "In ACCS coordinates; corresponds to tan(viewing angle of bottom object edge)";
CM_ SG_ 190 VFC_Obj07A_EdgeLeftStdDev "Standard deviation of the ACCS left object edge";
CM_ SG_ 190 VFC_Obj07A_EdgeMidStdDev "Standard deviation of the ACCS middle object edge";
CM_ SG_ 190 VFC_Obj07A_EdgeRightStdDev "Standard deviation of the ACCS right object edge";
CM_ SG_ 190 VFC_Obj07A_EdgeTopStdDev "Standard deviation of the ACCS top object edge";
CM_ SG_ 190 VFC_Obj07A_EdgeBottomStdDev "Standard deviation of the ACCS bottom object edge";
CM_ SG_ 190 VFC_Obj07A_NormVx "Normalised Object velocity in longitudinal direction";
CM_ SG_ 190 VFC_Obj07A_NormAx "Normalised Object acceleration in longitudinal direction";
CM_ SG_ 190 VFC_Obj07A_NormVyEdgeLeft "Normalised velocity of the ACCS left object edge in lateral direction";
CM_ SG_ 190 VFC_Obj07A_NormVyEdgeRight "Normalised velocity of the ACCS right object edge in lateral direction";
CM_ SG_ 190 VFC_Obj07A_NormVxStdDev "Standard deviation of Normalised Object velocity in longitudinal direction";
CM_ SG_ 190 VFC_Obj07A_NormAxStdDev "Standard deviation of Normalised Object acceleration in longitudinal direction";
CM_ SG_ 190 VFC_Obj07A_NormVyEdgeLeftStdDev "Standard deviation of Normalised velocity of the ACCS left object edge in lateral direction";
CM_ SG_ 190 VFC_Obj07A_NormVyEdgeRightStdDev "Standard deviation of Normalised velocity of the ACCS right object edge in lateral direction";
CM_ SG_ 190 VFC_Obj07A_ScaleChange "A scale change of of the detected object";
CM_ SG_ 190 VFC_Obj07A_ScaleChngStdDev "Standard deviation of object scale change";
CM_ SG_ 190 VFC_Obj07A_HeadingAngle "Heading angle of the object";
CM_ SG_ 190 VFC_Obj07A_HeadingAngleStdDev "Standard deviation of object Heading angle";
CM_ SG_ 190 VFC_Obj07A_HeadOrientation "The orientation of the head of cyclists or pedestrians that are detected";
CM_ SG_ 190 VFC_Obj07A_CompletelyInImg "indicator if the object is completely measured in the image";
CM_ SG_ 190 VFC_Obj07A_ProbMovingLat "Probability of object moving laterally";
CM_ SG_ 190 VFC_Obj07A_ProbMovingLong "Probability of object moving longitudinally";
CM_ SG_ 190 VFC_Obj07A_ProbExist "Object existence probability";
CM_ SG_ 190 VFC_Obj07A_MeasSource "Bitfield for the measurement programs from which this object originates
Bit 0: MOD
Bit 1: PDET
Bit 2: OFT
Bit 3: OLS
Bit 4: RESERVED";
CM_ SG_ 190 VFC_Obj07A_Reliability "The bitfield shows if the signal quality is assumed to be sufficient for functions with safety target -no false positives-
Bit 0: DYNAMIC
Bit 1: SEMSEG_SURFACE
Bit 2: WDD_CRITICAL
Bit 3: GOD_CONFIRMED
Bit 4: RESTRICTED
Bit 5: ISO26262_SAFE";
CM_ SG_ 190 VFC_Obj07A_Measured "Indicator if the object detected is measured or predicted";
CM_ SG_ 190 VFC_Obj07A_VisibleView "The visible view of the detected object";
CM_ SG_ 190 VFC_Obj07A_ClassifiedView "The classified view of object to be used in connection with Heading angle";
CM_ SG_ 190 VFC_Obj07A_DirIndicator "The detected direction indicator lights";
CM_ SG_ 190 VFC_Obj07A_BrakeLight "The number of detected lights. More confident if more lights are detected.";
CM_ SG_ 192 VFC_Obj08A_CRC "CRC - Autosar E2E Profile 5";
CM_ SG_ 192 VFC_Obj08A_AliveCtr "Alive counter - Autosar E2E Profile 5";
CM_ SG_ 192 VFC_Obj08A_ProtBlockCtr "Protocol-Signal: Block-Counter";
CM_ SG_ 192 VFC_Obj08A_ID "Unique Object ID";
CM_ SG_ 192 VFC_Obj08A_Type "Classification of the object";
CM_ SG_ 192 VFC_Obj08A_TypeProb "Probability of the classified object type";
CM_ SG_ 192 VFC_Obj08A_Dx "Object distance in longitudinal direction";
CM_ SG_ 192 VFC_Obj08A_Dy "Object distance in lateral direction";
CM_ SG_ 192 VFC_Obj08A_Vx "Object velocity in longitudinal direction";
CM_ SG_ 192 VFC_Obj08A_Vy "Object velocity in lateral direction";
CM_ SG_ 192 VFC_Obj08A_Ax "Object acceleration in longitudinal direction";
CM_ SG_ 192 VFC_Obj08A_Ay "Object acceleration in lateral direction";
CM_ SG_ 192 VFC_Obj08A_DxStdDev "Standard deviation of Object distance in longitudinal direction";
CM_ SG_ 192 VFC_Obj08A_DyStdDev "Standard deviation of Object distance in lateral direction";
CM_ SG_ 192 VFC_Obj08A_VxStdDev "Standard deviation of Object velocity in longitudinal direction";
CM_ SG_ 192 VFC_Obj08A_VyStdDev "Standard deviation of Object velocity in lateral direction";
CM_ SG_ 192 VFC_Obj08A_AxStdDev "Standard deviation of Object acceleration in longitudinal direction";
CM_ SG_ 192 VFC_Obj08A_AyStdDev "Standard deviation of Object acceleration in lateral direction";
CM_ SG_ 192 VFC_Obj08A_Length "Length of the object";
CM_ SG_ 192 VFC_Obj08A_Width "Width of the object";
CM_ SG_ 192 VFC_Obj08A_Height "Height of the object";
CM_ SG_ 192 VFC_Obj08A_LengthStdDev "Standard deviation of object length";
CM_ SG_ 192 VFC_Obj08A_WidthStdDev "Standard deviation of object width";
CM_ SG_ 192 VFC_Obj08A_HeightStdDev "Standard deviation of object height";
CM_ SG_ 192 VFC_Obj08A_EdgeLeft "In ACCS coordinates; corresponds to tan(viewing angle of left object edge)";
CM_ SG_ 192 VFC_Obj08A_EdgeMid "In ACCS coordinates; corresponds to tan(viewing angle of middle object edge)";
CM_ SG_ 192 VFC_Obj08A_EdgeRight "In ACCS coordinates; corresponds to tan(viewing angle of right object edge)";
CM_ SG_ 192 VFC_Obj08A_EdgeTop "In ACCS coordinates; corresponds to tan(viewing angle of top object edge)";
CM_ SG_ 192 VFC_Obj08A_EdgeBottom "In ACCS coordinates; corresponds to tan(viewing angle of bottom object edge)";
CM_ SG_ 192 VFC_Obj08A_EdgeLeftStdDev "Standard deviation of the ACCS left object edge";
CM_ SG_ 192 VFC_Obj08A_EdgeMidStdDev "Standard deviation of the ACCS middle object edge";
CM_ SG_ 192 VFC_Obj08A_EdgeRightStdDev "Standard deviation of the ACCS right object edge";
CM_ SG_ 192 VFC_Obj08A_EdgeTopStdDev "Standard deviation of the ACCS top object edge";
CM_ SG_ 192 VFC_Obj08A_EdgeBottomStdDev "Standard deviation of the ACCS bottom object edge";
CM_ SG_ 192 VFC_Obj08A_NormVx "Normalised Object velocity in longitudinal direction";
CM_ SG_ 192 VFC_Obj08A_NormAx "Normalised Object acceleration in longitudinal direction";
CM_ SG_ 192 VFC_Obj08A_NormVyEdgeLeft "Normalised velocity of the ACCS left object edge in lateral direction";
CM_ SG_ 192 VFC_Obj08A_NormVyEdgeRight "Normalised velocity of the ACCS right object edge in lateral direction";
CM_ SG_ 192 VFC_Obj08A_NormVxStdDev "Standard deviation of Normalised Object velocity in longitudinal direction";
CM_ SG_ 192 VFC_Obj08A_NormAxStdDev "Standard deviation of Normalised Object acceleration in longitudinal direction";
CM_ SG_ 192 VFC_Obj08A_NormVyEdgeLeftStdDev "Standard deviation of Normalised velocity of the ACCS left object edge in lateral direction";
CM_ SG_ 192 VFC_Obj08A_NormVyEdgeRightStdDev "Standard deviation of Normalised velocity of the ACCS right object edge in lateral direction";
CM_ SG_ 192 VFC_Obj08A_ScaleChange "A scale change of of the detected object";
CM_ SG_ 192 VFC_Obj08A_ScaleChngStdDev "Standard deviation of object scale change";
CM_ SG_ 192 VFC_Obj08A_HeadingAngle "Heading angle of the object";
CM_ SG_ 192 VFC_Obj08A_HeadingAngleStdDev "Standard deviation of object Heading angle";
CM_ SG_ 192 VFC_Obj08A_HeadOrientation "The orientation of the head of cyclists or pedestrians that are detected";
CM_ SG_ 192 VFC_Obj08A_CompletelyInImg "indicator if the object is completely measured in the image";
CM_ SG_ 192 VFC_Obj08A_ProbMovingLat "Probability of object moving laterally";
CM_ SG_ 192 VFC_Obj08A_ProbMovingLong "Probability of object moving longitudinally";
CM_ SG_ 192 VFC_Obj08A_ProbExist "Object existence probability";
CM_ SG_ 192 VFC_Obj08A_MeasSource "Bitfield for the measurement programs from which this object originates
Bit 0: MOD
Bit 1: PDET
Bit 2: OFT
Bit 3: OLS
Bit 4: RESERVED";
CM_ SG_ 192 VFC_Obj08A_Reliability "The bitfield shows if the signal quality is assumed to be sufficient for functions with safety target -no false positives-
Bit 0: DYNAMIC
Bit 1: SEMSEG_SURFACE
Bit 2: WDD_CRITICAL
Bit 3: GOD_CONFIRMED
Bit 4: RESTRICTED
Bit 5: ISO26262_SAFE";
CM_ SG_ 192 VFC_Obj08A_Measured "Indicator if the object detected is measured or predicted";
CM_ SG_ 192 VFC_Obj08A_VisibleView "The visible view of the detected object";
CM_ SG_ 192 VFC_Obj08A_ClassifiedView "The classified view of object to be used in connection with Heading angle";
CM_ SG_ 192 VFC_Obj08A_DirIndicator "The detected direction indicator lights";
CM_ SG_ 192 VFC_Obj08A_BrakeLight "The number of detected lights. More confident if more lights are detected.";
CM_ SG_ 194 VFC_Obj09A_CRC "CRC - Autosar E2E Profile 5";
CM_ SG_ 194 VFC_Obj09A_AliveCtr "Alive counter - Autosar E2E Profile 5";
CM_ SG_ 194 VFC_Obj09A_ProtBlockCtr "Protocol-Signal: Block-Counter";
CM_ SG_ 194 VFC_Obj09A_ID "Unique Object ID";
CM_ SG_ 194 VFC_Obj09A_Type "Classification of the object";
CM_ SG_ 194 VFC_Obj09A_TypeProb "Probability of the classified object type";
CM_ SG_ 194 VFC_Obj09A_Dx "Object distance in longitudinal direction";
CM_ SG_ 194 VFC_Obj09A_Dy "Object distance in lateral direction";
CM_ SG_ 194 VFC_Obj09A_Vx "Object velocity in longitudinal direction";
CM_ SG_ 194 VFC_Obj09A_Vy "Object velocity in lateral direction";
CM_ SG_ 194 VFC_Obj09A_Ax "Object acceleration in longitudinal direction";
CM_ SG_ 194 VFC_Obj09A_Ay "Object acceleration in lateral direction";
CM_ SG_ 194 VFC_Obj09A_DxStdDev "Standard deviation of Object distance in longitudinal direction";
CM_ SG_ 194 VFC_Obj09A_DyStdDev "Standard deviation of Object distance in lateral direction";
CM_ SG_ 194 VFC_Obj09A_VxStdDev "Standard deviation of Object velocity in longitudinal direction";
CM_ SG_ 194 VFC_Obj09A_VyStdDev "Standard deviation of Object velocity in lateral direction";
CM_ SG_ 194 VFC_Obj09A_AxStdDev "Standard deviation of Object acceleration in longitudinal direction";
CM_ SG_ 194 VFC_Obj09A_AyStdDev "Standard deviation of Object acceleration in lateral direction";
CM_ SG_ 194 VFC_Obj09A_Length "Length of the object";
CM_ SG_ 194 VFC_Obj09A_Width "Width of the object";
CM_ SG_ 194 VFC_Obj09A_Height "Height of the object";
CM_ SG_ 194 VFC_Obj09A_LengthStdDev "Standard deviation of object length";
CM_ SG_ 194 VFC_Obj09A_WidthStdDev "Standard deviation of object width";
CM_ SG_ 194 VFC_Obj09A_HeightStdDev "Standard deviation of object height";
CM_ SG_ 194 VFC_Obj09A_EdgeLeft "In ACCS coordinates; corresponds to tan(viewing angle of left object edge)";
CM_ SG_ 194 VFC_Obj09A_EdgeMid "In ACCS coordinates; corresponds to tan(viewing angle of middle object edge)";
CM_ SG_ 194 VFC_Obj09A_EdgeRight "In ACCS coordinates; corresponds to tan(viewing angle of right object edge)";
CM_ SG_ 194 VFC_Obj09A_EdgeTop "In ACCS coordinates; corresponds to tan(viewing angle of top object edge)";
CM_ SG_ 194 VFC_Obj09A_EdgeBottom "In ACCS coordinates; corresponds to tan(viewing angle of bottom object edge)";
CM_ SG_ 194 VFC_Obj09A_EdgeLeftStdDev "Standard deviation of the ACCS left object edge";
CM_ SG_ 194 VFC_Obj09A_EdgeMidStdDev "Standard deviation of the ACCS middle object edge";
CM_ SG_ 194 VFC_Obj09A_EdgeRightStdDev "Standard deviation of the ACCS right object edge";
CM_ SG_ 194 VFC_Obj09A_EdgeTopStdDev "Standard deviation of the ACCS top object edge";
CM_ SG_ 194 VFC_Obj09A_EdgeBottomStdDev "Standard deviation of the ACCS bottom object edge";
CM_ SG_ 194 VFC_Obj09A_NormVx "Normalised Object velocity in longitudinal direction";
CM_ SG_ 194 VFC_Obj09A_NormAx "Normalised Object acceleration in longitudinal direction";
CM_ SG_ 194 VFC_Obj09A_NormVyEdgeLeft "Normalised velocity of the ACCS left object edge in lateral direction";
CM_ SG_ 194 VFC_Obj09A_NormVyEdgeRight "Normalised velocity of the ACCS right object edge in lateral direction";
CM_ SG_ 194 VFC_Obj09A_NormVxStdDev "Standard deviation of Normalised Object velocity in longitudinal direction";
CM_ SG_ 194 VFC_Obj09A_NormAxStdDev "Standard deviation of Normalised Object acceleration in longitudinal direction";
CM_ SG_ 194 VFC_Obj09A_NormVyEdgeLeftStdDev "Standard deviation of Normalised velocity of the ACCS left object edge in lateral direction";
CM_ SG_ 194 VFC_Obj09A_NormVyEdgeRightStdDev "Standard deviation of Normalised velocity of the ACCS right object edge in lateral direction";
CM_ SG_ 194 VFC_Obj09A_ScaleChange "A scale change of of the detected object";
CM_ SG_ 194 VFC_Obj09A_ScaleChngStdDev "Standard deviation of object scale change";
CM_ SG_ 194 VFC_Obj09A_HeadingAngle "Heading angle of the object";
CM_ SG_ 194 VFC_Obj09A_HeadingAngleStdDev "Standard deviation of object Heading angle";
CM_ SG_ 194 VFC_Obj09A_HeadOrientation "The orientation of the head of cyclists or pedestrians that are detected";
CM_ SG_ 194 VFC_Obj09A_CompletelyInImg "indicator if the object is completely measured in the image";
CM_ SG_ 194 VFC_Obj09A_ProbMovingLat "Probability of object moving laterally";
CM_ SG_ 194 VFC_Obj09A_ProbMovingLong "Probability of object moving longitudinally";
CM_ SG_ 194 VFC_Obj09A_ProbExist "Object existence probability";
CM_ SG_ 194 VFC_Obj09A_MeasSource "Bitfield for the measurement programs from which this object originates
Bit 0: MOD
Bit 1: PDET
Bit 2: OFT
Bit 3: OLS
Bit 4: RESERVED";
CM_ SG_ 194 VFC_Obj09A_Reliability "The bitfield shows if the signal quality is assumed to be sufficient for functions with safety target -no false positives-
Bit 0: DYNAMIC
Bit 1: SEMSEG_SURFACE
Bit 2: WDD_CRITICAL
Bit 3: GOD_CONFIRMED
Bit 4: RESTRICTED
Bit 5: ISO26262_SAFE";
CM_ SG_ 194 VFC_Obj09A_Measured "Indicator if the object detected is measured or predicted";
CM_ SG_ 194 VFC_Obj09A_VisibleView "The visible view of the detected object";
CM_ SG_ 194 VFC_Obj09A_ClassifiedView "The classified view of object to be used in connection with Heading angle";
CM_ SG_ 194 VFC_Obj09A_DirIndicator "The detected direction indicator lights";
CM_ SG_ 194 VFC_Obj09A_BrakeLight "The number of detected lights. More confident if more lights are detected.";
CM_ SG_ 196 VFC_Obj10A_CRC "CRC - Autosar E2E Profile 5";
CM_ SG_ 196 VFC_Obj10A_AliveCtr "Alive counter - Autosar E2E Profile 5";
CM_ SG_ 196 VFC_Obj10A_ProtBlockCtr "Protocol-Signal: Block-Counter";
CM_ SG_ 196 VFC_Obj10A_ID "Unique Object ID";
CM_ SG_ 196 VFC_Obj10A_Type "Classification of the object";
CM_ SG_ 196 VFC_Obj10A_TypeProb "Probability of the classified object type";
CM_ SG_ 196 VFC_Obj10A_Dx "Object distance in longitudinal direction";
CM_ SG_ 196 VFC_Obj10A_Dy "Object distance in lateral direction";
CM_ SG_ 196 VFC_Obj10A_Vx "Object velocity in longitudinal direction";
CM_ SG_ 196 VFC_Obj10A_Vy "Object velocity in lateral direction";
CM_ SG_ 196 VFC_Obj10A_Ax "Object acceleration in longitudinal direction";
CM_ SG_ 196 VFC_Obj10A_Ay "Object acceleration in lateral direction";
CM_ SG_ 196 VFC_Obj10A_DxStdDev "Standard deviation of Object distance in longitudinal direction";
CM_ SG_ 196 VFC_Obj10A_DyStdDev "Standard deviation of Object distance in lateral direction";
CM_ SG_ 196 VFC_Obj10A_VxStdDev "Standard deviation of Object velocity in longitudinal direction";
CM_ SG_ 196 VFC_Obj10A_VyStdDev "Standard deviation of Object velocity in lateral direction";
CM_ SG_ 196 VFC_Obj10A_AxStdDev "Standard deviation of Object acceleration in longitudinal direction";
CM_ SG_ 196 VFC_Obj10A_AyStdDev "Standard deviation of Object acceleration in lateral direction";
CM_ SG_ 196 VFC_Obj10A_Length "Length of the object";
CM_ SG_ 196 VFC_Obj10A_Width "Width of the object";
CM_ SG_ 196 VFC_Obj10A_Height "Height of the object";
CM_ SG_ 196 VFC_Obj10A_LengthStdDev "Standard deviation of object length";
CM_ SG_ 196 VFC_Obj10A_WidthStdDev "Standard deviation of object width";
CM_ SG_ 196 VFC_Obj10A_HeightStdDev "Standard deviation of object height";
CM_ SG_ 196 VFC_Obj10A_EdgeLeft "In ACCS coordinates; corresponds to tan(viewing angle of left object edge)";
CM_ SG_ 196 VFC_Obj10A_EdgeMid "In ACCS coordinates; corresponds to tan(viewing angle of middle object edge)";
CM_ SG_ 196 VFC_Obj10A_EdgeRight "In ACCS coordinates; corresponds to tan(viewing angle of right object edge)";
CM_ SG_ 196 VFC_Obj10A_EdgeTop "In ACCS coordinates; corresponds to tan(viewing angle of top object edge)";
CM_ SG_ 196 VFC_Obj10A_EdgeBottom "In ACCS coordinates; corresponds to tan(viewing angle of bottom object edge)";
CM_ SG_ 196 VFC_Obj10A_EdgeLeftStdDev "Standard deviation of the ACCS left object edge";
CM_ SG_ 196 VFC_Obj10A_EdgeMidStdDev "Standard deviation of the ACCS middle object edge";
CM_ SG_ 196 VFC_Obj10A_EdgeRightStdDev "Standard deviation of the ACCS right object edge";
CM_ SG_ 196 VFC_Obj10A_EdgeTopStdDev "Standard deviation of the ACCS top object edge";
CM_ SG_ 196 VFC_Obj10A_EdgeBottomStdDev "Standard deviation of the ACCS bottom object edge";
CM_ SG_ 196 VFC_Obj10A_NormVx "Normalised Object velocity in longitudinal direction";
CM_ SG_ 196 VFC_Obj10A_NormAx "Normalised Object acceleration in longitudinal direction";
CM_ SG_ 196 VFC_Obj10A_NormVyEdgeLeft "Normalised velocity of the ACCS left object edge in lateral direction";
CM_ SG_ 196 VFC_Obj10A_NormVyEdgeRight "Normalised velocity of the ACCS right object edge in lateral direction";
CM_ SG_ 196 VFC_Obj10A_NormVxStdDev "Standard deviation of Normalised Object velocity in longitudinal direction";
CM_ SG_ 196 VFC_Obj10A_NormAxStdDev "Standard deviation of Normalised Object acceleration in longitudinal direction";
CM_ SG_ 196 VFC_Obj10A_NormVyEdgeLeftStdDev "Standard deviation of Normalised velocity of the ACCS left object edge in lateral direction";
CM_ SG_ 196 VFC_Obj10A_NormVyEdgeRightStdDev "Standard deviation of Normalised velocity of the ACCS right object edge in lateral direction";
CM_ SG_ 196 VFC_Obj10A_ScaleChange "A scale change of of the detected object";
CM_ SG_ 196 VFC_Obj10A_ScaleChngStdDev "Standard deviation of object scale change";
CM_ SG_ 196 VFC_Obj10A_HeadingAngle "Heading angle of the object";
CM_ SG_ 196 VFC_Obj10A_HeadingAngleStdDev "Standard deviation of object Heading angle";
CM_ SG_ 196 VFC_Obj10A_HeadOrientation "The orientation of the head of cyclists or pedestrians that are detected";
CM_ SG_ 196 VFC_Obj10A_CompletelyInImg "indicator if the object is completely measured in the image";
CM_ SG_ 196 VFC_Obj10A_ProbMovingLat "Probability of object moving laterally";
CM_ SG_ 196 VFC_Obj10A_ProbMovingLong "Probability of object moving longitudinally";
CM_ SG_ 196 VFC_Obj10A_ProbExist "Object existence probability";
CM_ SG_ 196 VFC_Obj10A_MeasSource "Bitfield for the measurement programs from which this object originates
Bit 0: MOD
Bit 1: PDET
Bit 2: OFT
Bit 3: OLS
Bit 4: RESERVED";
CM_ SG_ 196 VFC_Obj10A_Reliability "The bitfield shows if the signal quality is assumed to be sufficient for functions with safety target -no false positives-
Bit 0: DYNAMIC
Bit 1: SEMSEG_SURFACE
Bit 2: WDD_CRITICAL
Bit 3: GOD_CONFIRMED
Bit 4: RESTRICTED
Bit 5: ISO26262_SAFE";
CM_ SG_ 196 VFC_Obj10A_Measured "Indicator if the object detected is measured or predicted";
CM_ SG_ 196 VFC_Obj10A_VisibleView "The visible view of the detected object";
CM_ SG_ 196 VFC_Obj10A_ClassifiedView "The classified view of object to be used in connection with Heading angle";
CM_ SG_ 196 VFC_Obj10A_DirIndicator "The detected direction indicator lights";
CM_ SG_ 196 VFC_Obj10A_BrakeLight "The number of detected lights. More confident if more lights are detected.";
CM_ SG_ 198 VFC_Obj11A_CRC "CRC - Autosar E2E Profile 5";
CM_ SG_ 198 VFC_Obj11A_AliveCtr "Alive counter - Autosar E2E Profile 5";
CM_ SG_ 198 VFC_Obj11A_ProtBlockCtr "Protocol-Signal: Block-Counter";
CM_ SG_ 198 VFC_Obj11A_ID "Unique Object ID";
CM_ SG_ 198 VFC_Obj11A_Type "Classification of the object";
CM_ SG_ 198 VFC_Obj11A_TypeProb "Probability of the classified object type";
CM_ SG_ 198 VFC_Obj11A_Dx "Object distance in longitudinal direction";
CM_ SG_ 198 VFC_Obj11A_Dy "Object distance in lateral direction";
CM_ SG_ 198 VFC_Obj11A_Vx "Object velocity in longitudinal direction";
CM_ SG_ 198 VFC_Obj11A_Vy "Object velocity in lateral direction";
CM_ SG_ 198 VFC_Obj11A_Ax "Object acceleration in longitudinal direction";
CM_ SG_ 198 VFC_Obj11A_Ay "Object acceleration in lateral direction";
CM_ SG_ 198 VFC_Obj11A_DxStdDev "Standard deviation of Object distance in longitudinal direction";
CM_ SG_ 198 VFC_Obj11A_DyStdDev "Standard deviation of Object distance in lateral direction";
CM_ SG_ 198 VFC_Obj11A_VxStdDev "Standard deviation of Object velocity in longitudinal direction";
CM_ SG_ 198 VFC_Obj11A_VyStdDev "Standard deviation of Object velocity in lateral direction";
CM_ SG_ 198 VFC_Obj11A_AxStdDev "Standard deviation of Object acceleration in longitudinal direction";
CM_ SG_ 198 VFC_Obj11A_AyStdDev "Standard deviation of Object acceleration in lateral direction";
CM_ SG_ 198 VFC_Obj11A_Length "Length of the object";
CM_ SG_ 198 VFC_Obj11A_Width "Width of the object";
CM_ SG_ 198 VFC_Obj11A_Height "Height of the object";
CM_ SG_ 198 VFC_Obj11A_LengthStdDev "Standard deviation of object length";
CM_ SG_ 198 VFC_Obj11A_WidthStdDev "Standard deviation of object width";
CM_ SG_ 198 VFC_Obj11A_HeightStdDev "Standard deviation of object height";
CM_ SG_ 198 VFC_Obj11A_EdgeLeft "In ACCS coordinates; corresponds to tan(viewing angle of left object edge)";
CM_ SG_ 198 VFC_Obj11A_EdgeMid "In ACCS coordinates; corresponds to tan(viewing angle of middle object edge)";
CM_ SG_ 198 VFC_Obj11A_EdgeRight "In ACCS coordinates; corresponds to tan(viewing angle of right object edge)";
CM_ SG_ 198 VFC_Obj11A_EdgeTop "In ACCS coordinates; corresponds to tan(viewing angle of top object edge)";
CM_ SG_ 198 VFC_Obj11A_EdgeBottom "In ACCS coordinates; corresponds to tan(viewing angle of bottom object edge)";
CM_ SG_ 198 VFC_Obj11A_EdgeLeftStdDev "Standard deviation of the ACCS left object edge";
CM_ SG_ 198 VFC_Obj11A_EdgeMidStdDev "Standard deviation of the ACCS middle object edge";
CM_ SG_ 198 VFC_Obj11A_EdgeRightStdDev "Standard deviation of the ACCS right object edge";
CM_ SG_ 198 VFC_Obj11A_EdgeTopStdDev "Standard deviation of the ACCS top object edge";
CM_ SG_ 198 VFC_Obj11A_EdgeBottomStdDev "Standard deviation of the ACCS bottom object edge";
CM_ SG_ 198 VFC_Obj11A_NormVx "Normalised Object velocity in longitudinal direction";
CM_ SG_ 198 VFC_Obj11A_NormAx "Normalised Object acceleration in longitudinal direction";
CM_ SG_ 198 VFC_Obj11A_NormVyEdgeLeft "Normalised velocity of the ACCS left object edge in lateral direction";
CM_ SG_ 198 VFC_Obj11A_NormVyEdgeRight "Normalised velocity of the ACCS right object edge in lateral direction";
CM_ SG_ 198 VFC_Obj11A_NormVxStdDev "Standard deviation of Normalised Object velocity in longitudinal direction";
CM_ SG_ 198 VFC_Obj11A_NormAxStdDev "Standard deviation of Normalised Object acceleration in longitudinal direction";
CM_ SG_ 198 VFC_Obj11A_NormVyEdgeLeftStdDev "Standard deviation of Normalised velocity of the ACCS left object edge in lateral direction";
CM_ SG_ 198 VFC_Obj11A_NormVyEdgeRightStdDev "Standard deviation of Normalised velocity of the ACCS right object edge in lateral direction";
CM_ SG_ 198 VFC_Obj11A_ScaleChange "A scale change of of the detected object";
CM_ SG_ 198 VFC_Obj11A_ScaleChngStdDev "Standard deviation of object scale change";
CM_ SG_ 198 VFC_Obj11A_HeadingAngle "Heading angle of the object";
CM_ SG_ 198 VFC_Obj11A_HeadingAngleStdDev "Standard deviation of object Heading angle";
CM_ SG_ 198 VFC_Obj11A_HeadOrientation "The orientation of the head of cyclists or pedestrians that are detected";
CM_ SG_ 198 VFC_Obj11A_CompletelyInImg "indicator if the object is completely measured in the image";
CM_ SG_ 198 VFC_Obj11A_ProbMovingLat "Probability of object moving laterally";
CM_ SG_ 198 VFC_Obj11A_ProbMovingLong "Probability of object moving longitudinally";
CM_ SG_ 198 VFC_Obj11A_ProbExist "Object existence probability";
CM_ SG_ 198 VFC_Obj11A_MeasSource "Bitfield for the measurement programs from which this object originates
Bit 0: MOD
Bit 1: PDET
Bit 2: OFT
Bit 3: OLS
Bit 4: RESERVED";
CM_ SG_ 198 VFC_Obj11A_Reliability "The bitfield shows if the signal quality is assumed to be sufficient for functions with safety target -no false positives-
Bit 0: DYNAMIC
Bit 1: SEMSEG_SURFACE
Bit 2: WDD_CRITICAL
Bit 3: GOD_CONFIRMED
Bit 4: RESTRICTED
Bit 5: ISO26262_SAFE";
CM_ SG_ 198 VFC_Obj11A_Measured "Indicator if the object detected is measured or predicted";
CM_ SG_ 198 VFC_Obj11A_VisibleView "The visible view of the detected object";
CM_ SG_ 198 VFC_Obj11A_ClassifiedView "The classified view of object to be used in connection with Heading angle";
CM_ SG_ 198 VFC_Obj11A_DirIndicator "The detected direction indicator lights";
CM_ SG_ 198 VFC_Obj11A_BrakeLight "The number of detected lights. More confident if more lights are detected.";
BA_DEF_ BO_  "GenMsgSendType" ENUM  "cyclic","NoMsgSendType","IfActive","Event","CA","CE";
BA_DEF_ BO_  "GenMsgCycleTime" INT 0 0;
BA_DEF_ SG_  "GenSigSendType" ENUM  "cyclic","OnChange","OnWrite","IfActive","OnChangeWithRepetition","OnWriteWithRepetition","IfActiveWithRepetition","CA","CE","Event";
BA_DEF_ SG_  "GenSigStartValue" INT 0 0;
BA_DEF_ BO_  "CANFD_BRS" ENUM  "0","1";
BA_DEF_ BO_  "VFrameFormat" ENUM  "StandardCAN","ExtendedCAN","reserved","reserved","reserved","reserved","reserved","reserved","reserved","reserved","reserved","reserved","reserved","reserved","StandardCAN_FD","ExtendedCAN_FD";
BA_DEF_ BO_  "GenMsgILSupport" ENUM  "No","Yes";
BA_DEF_DEF_  "GenMsgSendType" "cyclic";
BA_DEF_DEF_  "GenMsgCycleTime" 0;
BA_DEF_DEF_  "GenSigSendType" "cyclic";
BA_DEF_DEF_  "GenSigStartValue" 0;
BA_DEF_DEF_  "CANFD_BRS" "1";
BA_DEF_DEF_  "VFrameFormat" "";
BA_DEF_DEF_  "GenMsgILSupport" "Yes";
BA_ "GenMsgSendType" BO_ 160 3;
BA_ "VFrameFormat" BO_ 160 14;
BA_ "GenMsgSendType" BO_ 176 3;
BA_ "VFrameFormat" BO_ 176 14;
BA_ "GenMsgSendType" BO_ 178 3;
BA_ "VFrameFormat" BO_ 178 14;
BA_ "GenMsgSendType" BO_ 180 3;
BA_ "VFrameFormat" BO_ 180 14;
BA_ "GenMsgSendType" BO_ 182 3;
BA_ "VFrameFormat" BO_ 182 14;
BA_ "GenMsgSendType" BO_ 184 3;
BA_ "VFrameFormat" BO_ 184 14;
BA_ "GenMsgSendType" BO_ 186 3;
BA_ "VFrameFormat" BO_ 186 14;
BA_ "GenMsgSendType" BO_ 188 3;
BA_ "VFrameFormat" BO_ 188 14;
BA_ "GenMsgSendType" BO_ 190 3;
BA_ "VFrameFormat" BO_ 190 14;
BA_ "GenMsgSendType" BO_ 192 3;
BA_ "VFrameFormat" BO_ 192 14;
BA_ "GenMsgSendType" BO_ 194 3;
BA_ "VFrameFormat" BO_ 194 14;
BA_ "GenMsgSendType" BO_ 196 3;
BA_ "VFrameFormat" BO_ 196 14;
BA_ "GenMsgSendType" BO_ 198 3;
BA_ "VFrameFormat" BO_ 198 14;
BA_ "GenSigSendType" SG_ 160 VFC_ObjHdr_CRC 9;
BA_ "GenSigSendType" SG_ 160 VFC_ObjHdr_AliveCtr 9;
BA_ "GenSigSendType" SG_ 160 VFC_ObjHdr_ProtBlockCtr 9;
BA_ "GenSigSendType" SG_ 160 VFC_ObjHdr_ProtObjCount 9;
BA_ "GenSigSendType" SG_ 160 VFC_ObjHdr_State 9;
BA_ "GenSigSendType" SG_ 160 VFC_ObjHdr_TimeStampStatus 9;
BA_ "GenSigSendType" SG_ 160 VFC_ObjHdr_TimeStamp 9;
BA_ "GenSigSendType" SG_ 160 VFC_ObjHdr_TimeLatency 9;
BA_ "GenSigSendType" SG_ 176 VFC_Obj00A_CRC 9;
BA_ "GenSigSendType" SG_ 176 VFC_Obj00A_AliveCtr 9;
BA_ "GenSigSendType" SG_ 176 VFC_Obj00A_ProtBlockCtr 9;
BA_ "GenSigSendType" SG_ 176 VFC_Obj00A_ID 9;
BA_ "GenSigSendType" SG_ 176 VFC_Obj00A_Type 9;
BA_ "GenSigSendType" SG_ 176 VFC_Obj00A_TypeProb 9;
BA_ "GenSigSendType" SG_ 176 VFC_Obj00A_Dx 9;
BA_ "GenSigSendType" SG_ 176 VFC_Obj00A_Dy 9;
BA_ "GenSigStartValue" SG_ 176 VFC_Obj00A_Dy 8000;
BA_ "GenSigSendType" SG_ 176 VFC_Obj00A_Vx 9;
BA_ "GenSigStartValue" SG_ 176 VFC_Obj00A_Vx 1540;
BA_ "GenSigSendType" SG_ 176 VFC_Obj00A_Vy 9;
BA_ "GenSigStartValue" SG_ 176 VFC_Obj00A_Vy 500;
BA_ "GenSigSendType" SG_ 176 VFC_Obj00A_Ax 9;
BA_ "GenSigStartValue" SG_ 176 VFC_Obj00A_Ax 160;
BA_ "GenSigSendType" SG_ 176 VFC_Obj00A_Ay 9;
BA_ "GenSigStartValue" SG_ 176 VFC_Obj00A_Ay 120;
BA_ "GenSigSendType" SG_ 176 VFC_Obj00A_DxStdDev 9;
BA_ "GenSigSendType" SG_ 176 VFC_Obj00A_DyStdDev 9;
BA_ "GenSigSendType" SG_ 176 VFC_Obj00A_VxStdDev 9;
BA_ "GenSigSendType" SG_ 176 VFC_Obj00A_VyStdDev 9;
BA_ "GenSigSendType" SG_ 176 VFC_Obj00A_AxStdDev 9;
BA_ "GenSigSendType" SG_ 176 VFC_Obj00A_AyStdDev 9;
BA_ "GenSigSendType" SG_ 176 VFC_Obj00A_Length 9;
BA_ "GenSigSendType" SG_ 176 VFC_Obj00A_Width 9;
BA_ "GenSigSendType" SG_ 176 VFC_Obj00A_Height 9;
BA_ "GenSigSendType" SG_ 176 VFC_Obj00A_LengthStdDev 9;
BA_ "GenSigSendType" SG_ 176 VFC_Obj00A_WidthStdDev 9;
BA_ "GenSigSendType" SG_ 176 VFC_Obj00A_HeightStdDev 9;
BA_ "GenSigSendType" SG_ 176 VFC_Obj00A_EdgeLeft 9;
BA_ "GenSigStartValue" SG_ 176 VFC_Obj00A_EdgeLeft 4000;
BA_ "GenSigSendType" SG_ 176 VFC_Obj00A_EdgeMid 9;
BA_ "GenSigStartValue" SG_ 176 VFC_Obj00A_EdgeMid 4000;
BA_ "GenSigSendType" SG_ 176 VFC_Obj00A_EdgeRight 9;
BA_ "GenSigStartValue" SG_ 176 VFC_Obj00A_EdgeRight 4000;
BA_ "GenSigSendType" SG_ 176 VFC_Obj00A_EdgeTop 9;
BA_ "GenSigStartValue" SG_ 176 VFC_Obj00A_EdgeTop 2000;
BA_ "GenSigSendType" SG_ 176 VFC_Obj00A_EdgeBottom 9;
BA_ "GenSigStartValue" SG_ 176 VFC_Obj00A_EdgeBottom 2000;
BA_ "GenSigSendType" SG_ 176 VFC_Obj00A_EdgeLeftStdDev 9;
BA_ "GenSigSendType" SG_ 176 VFC_Obj00A_EdgeMidStdDev 9;
BA_ "GenSigSendType" SG_ 176 VFC_Obj00A_EdgeRightStdDev 9;
BA_ "GenSigSendType" SG_ 176 VFC_Obj00A_EdgeTopStdDev 9;
BA_ "GenSigSendType" SG_ 176 VFC_Obj00A_EdgeBottomStdDev 9;
BA_ "GenSigSendType" SG_ 176 VFC_Obj00A_NormVx 9;
BA_ "GenSigStartValue" SG_ 176 VFC_Obj00A_NormVx 40000;
BA_ "GenSigSendType" SG_ 176 VFC_Obj00A_NormAx 9;
BA_ "GenSigStartValue" SG_ 176 VFC_Obj00A_NormAx 5000;
BA_ "GenSigSendType" SG_ 176 VFC_Obj00A_NormVyEdgeLeft 9;
BA_ "GenSigStartValue" SG_ 176 VFC_Obj00A_NormVyEdgeLeft 4000;
BA_ "GenSigSendType" SG_ 176 VFC_Obj00A_NormVyEdgeRight 9;
BA_ "GenSigStartValue" SG_ 176 VFC_Obj00A_NormVyEdgeRight 4000;
BA_ "GenSigSendType" SG_ 176 VFC_Obj00A_NormVxStdDev 9;
BA_ "GenSigSendType" SG_ 176 VFC_Obj00A_NormAxStdDev 9;
BA_ "GenSigSendType" SG_ 176 VFC_Obj00A_NormVyEdgeLeftStdDev 9;
BA_ "GenSigSendType" SG_ 176 VFC_Obj00A_NormVyEdgeRightStdDev 9;
BA_ "GenSigSendType" SG_ 176 VFC_Obj00A_ScaleChange 9;
BA_ "GenSigSendType" SG_ 176 VFC_Obj00A_ScaleChngStdDev 9;
BA_ "GenSigSendType" SG_ 176 VFC_Obj00A_HeadingAngle 9;
BA_ "GenSigStartValue" SG_ 176 VFC_Obj00A_HeadingAngle 157;
BA_ "GenSigSendType" SG_ 176 VFC_Obj00A_HeadingAngleStdDev 9;
BA_ "GenSigSendType" SG_ 176 VFC_Obj00A_HeadOrientation 9;
BA_ "GenSigSendType" SG_ 176 VFC_Obj00A_CompletelyInImg 9;
BA_ "GenSigSendType" SG_ 176 VFC_Obj00A_ProbMovingLat 9;
BA_ "GenSigSendType" SG_ 176 VFC_Obj00A_ProbMovingLong 9;
BA_ "GenSigSendType" SG_ 176 VFC_Obj00A_ProbExist 9;
BA_ "GenSigSendType" SG_ 176 VFC_Obj00A_MeasSource 9;
BA_ "GenSigSendType" SG_ 176 VFC_Obj00A_Reliability 9;
BA_ "GenSigSendType" SG_ 176 VFC_Obj00A_Measured 9;
BA_ "GenSigSendType" SG_ 176 VFC_Obj00A_VisibleView 9;
BA_ "GenSigSendType" SG_ 176 VFC_Obj00A_ClassifiedView 9;
BA_ "GenSigSendType" SG_ 176 VFC_Obj00A_DirIndicator 9;
BA_ "GenSigSendType" SG_ 176 VFC_Obj00A_BrakeLight 9;
BA_ "GenSigSendType" SG_ 178 VFC_Obj01A_CRC 9;
BA_ "GenSigSendType" SG_ 178 VFC_Obj01A_AliveCtr 9;
BA_ "GenSigSendType" SG_ 178 VFC_Obj01A_ProtBlockCtr 9;
BA_ "GenSigSendType" SG_ 178 VFC_Obj01A_ID 9;
BA_ "GenSigSendType" SG_ 178 VFC_Obj01A_Type 9;
BA_ "GenSigSendType" SG_ 178 VFC_Obj01A_TypeProb 9;
BA_ "GenSigSendType" SG_ 178 VFC_Obj01A_Dx 9;
BA_ "GenSigSendType" SG_ 178 VFC_Obj01A_Dy 9;
BA_ "GenSigStartValue" SG_ 178 VFC_Obj01A_Dy 8000;
BA_ "GenSigSendType" SG_ 178 VFC_Obj01A_Vx 9;
BA_ "GenSigStartValue" SG_ 178 VFC_Obj01A_Vx 1540;
BA_ "GenSigSendType" SG_ 178 VFC_Obj01A_Vy 9;
BA_ "GenSigStartValue" SG_ 178 VFC_Obj01A_Vy 500;
BA_ "GenSigSendType" SG_ 178 VFC_Obj01A_Ax 9;
BA_ "GenSigStartValue" SG_ 178 VFC_Obj01A_Ax 160;
BA_ "GenSigSendType" SG_ 178 VFC_Obj01A_Ay 9;
BA_ "GenSigStartValue" SG_ 178 VFC_Obj01A_Ay 120;
BA_ "GenSigSendType" SG_ 178 VFC_Obj01A_DxStdDev 9;
BA_ "GenSigSendType" SG_ 178 VFC_Obj01A_DyStdDev 9;
BA_ "GenSigSendType" SG_ 178 VFC_Obj01A_VxStdDev 9;
BA_ "GenSigSendType" SG_ 178 VFC_Obj01A_VyStdDev 9;
BA_ "GenSigSendType" SG_ 178 VFC_Obj01A_AxStdDev 9;
BA_ "GenSigSendType" SG_ 178 VFC_Obj01A_AyStdDev 9;
BA_ "GenSigSendType" SG_ 178 VFC_Obj01A_Length 9;
BA_ "GenSigSendType" SG_ 178 VFC_Obj01A_Width 9;
BA_ "GenSigSendType" SG_ 178 VFC_Obj01A_Height 9;
BA_ "GenSigSendType" SG_ 178 VFC_Obj01A_LengthStdDev 9;
BA_ "GenSigSendType" SG_ 178 VFC_Obj01A_WidthStdDev 9;
BA_ "GenSigSendType" SG_ 178 VFC_Obj01A_HeightStdDev 9;
BA_ "GenSigSendType" SG_ 178 VFC_Obj01A_EdgeLeft 9;
BA_ "GenSigStartValue" SG_ 178 VFC_Obj01A_EdgeLeft 4000;
BA_ "GenSigSendType" SG_ 178 VFC_Obj01A_EdgeMid 9;
BA_ "GenSigStartValue" SG_ 178 VFC_Obj01A_EdgeMid 4000;
BA_ "GenSigSendType" SG_ 178 VFC_Obj01A_EdgeRight 9;
BA_ "GenSigStartValue" SG_ 178 VFC_Obj01A_EdgeRight 4000;
BA_ "GenSigSendType" SG_ 178 VFC_Obj01A_EdgeTop 9;
BA_ "GenSigStartValue" SG_ 178 VFC_Obj01A_EdgeTop 2000;
BA_ "GenSigSendType" SG_ 178 VFC_Obj01A_EdgeBottom 9;
BA_ "GenSigStartValue" SG_ 178 VFC_Obj01A_EdgeBottom 2000;
BA_ "GenSigSendType" SG_ 178 VFC_Obj01A_EdgeLeftStdDev 9;
BA_ "GenSigSendType" SG_ 178 VFC_Obj01A_EdgeMidStdDev 9;
BA_ "GenSigSendType" SG_ 178 VFC_Obj01A_EdgeRightStdDev 9;
BA_ "GenSigSendType" SG_ 178 VFC_Obj01A_EdgeTopStdDev 9;
BA_ "GenSigSendType" SG_ 178 VFC_Obj01A_EdgeBottomStdDev 9;
BA_ "GenSigSendType" SG_ 178 VFC_Obj01A_NormVx 9;
BA_ "GenSigStartValue" SG_ 178 VFC_Obj01A_NormVx 40000;
BA_ "GenSigSendType" SG_ 178 VFC_Obj01A_NormAx 9;
BA_ "GenSigStartValue" SG_ 178 VFC_Obj01A_NormAx 5000;
BA_ "GenSigSendType" SG_ 178 VFC_Obj01A_NormVyEdgeLeft 9;
BA_ "GenSigStartValue" SG_ 178 VFC_Obj01A_NormVyEdgeLeft 4000;
BA_ "GenSigSendType" SG_ 178 VFC_Obj01A_NormVyEdgeRight 9;
BA_ "GenSigStartValue" SG_ 178 VFC_Obj01A_NormVyEdgeRight 4000;
BA_ "GenSigSendType" SG_ 178 VFC_Obj01A_NormVxStdDev 9;
BA_ "GenSigSendType" SG_ 178 VFC_Obj01A_NormAxStdDev 9;
BA_ "GenSigSendType" SG_ 178 VFC_Obj01A_NormVyEdgeLeftStdDev 9;
BA_ "GenSigSendType" SG_ 178 VFC_Obj01A_NormVyEdgeRightStdDev 9;
BA_ "GenSigSendType" SG_ 178 VFC_Obj01A_ScaleChange 9;
BA_ "GenSigSendType" SG_ 178 VFC_Obj01A_ScaleChngStdDev 9;
BA_ "GenSigSendType" SG_ 178 VFC_Obj01A_HeadingAngle 9;
BA_ "GenSigStartValue" SG_ 178 VFC_Obj01A_HeadingAngle 157;
BA_ "GenSigSendType" SG_ 178 VFC_Obj01A_HeadingAngleStdDev 9;
BA_ "GenSigSendType" SG_ 178 VFC_Obj01A_HeadOrientation 9;
BA_ "GenSigSendType" SG_ 178 VFC_Obj01A_CompletelyInImg 9;
BA_ "GenSigSendType" SG_ 178 VFC_Obj01A_ProbMovingLat 9;
BA_ "GenSigSendType" SG_ 178 VFC_Obj01A_ProbMovingLong 9;
BA_ "GenSigSendType" SG_ 178 VFC_Obj01A_ProbExist 9;
BA_ "GenSigSendType" SG_ 178 VFC_Obj01A_MeasSource 9;
BA_ "GenSigSendType" SG_ 178 VFC_Obj01A_Reliability 9;
BA_ "GenSigSendType" SG_ 178 VFC_Obj01A_Measured 9;
BA_ "GenSigSendType" SG_ 178 VFC_Obj01A_VisibleView 9;
BA_ "GenSigSendType" SG_ 178 VFC_Obj01A_ClassifiedView 9;
BA_ "GenSigSendType" SG_ 178 VFC_Obj01A_DirIndicator 9;
BA_ "GenSigSendType" SG_ 178 VFC_Obj01A_BrakeLight 9;
BA_ "GenSigSendType" SG_ 180 VFC_Obj02A_CRC 9;
BA_ "GenSigSendType" SG_ 180 VFC_Obj02A_AliveCtr 9;
BA_ "GenSigSendType" SG_ 180 VFC_Obj02A_ProtBlockCtr 9;
BA_ "GenSigSendType" SG_ 180 VFC_Obj02A_ID 9;
BA_ "GenSigSendType" SG_ 180 VFC_Obj02A_Type 9;
BA_ "GenSigSendType" SG_ 180 VFC_Obj02A_TypeProb 9;
BA_ "GenSigSendType" SG_ 180 VFC_Obj02A_Dx 9;
BA_ "GenSigSendType" SG_ 180 VFC_Obj02A_Dy 9;
BA_ "GenSigStartValue" SG_ 180 VFC_Obj02A_Dy 8000;
BA_ "GenSigSendType" SG_ 180 VFC_Obj02A_Vx 9;
BA_ "GenSigStartValue" SG_ 180 VFC_Obj02A_Vx 1540;
BA_ "GenSigSendType" SG_ 180 VFC_Obj02A_Vy 9;
BA_ "GenSigStartValue" SG_ 180 VFC_Obj02A_Vy 500;
BA_ "GenSigSendType" SG_ 180 VFC_Obj02A_Ax 9;
BA_ "GenSigStartValue" SG_ 180 VFC_Obj02A_Ax 160;
BA_ "GenSigSendType" SG_ 180 VFC_Obj02A_Ay 9;
BA_ "GenSigStartValue" SG_ 180 VFC_Obj02A_Ay 120;
BA_ "GenSigSendType" SG_ 180 VFC_Obj02A_DxStdDev 9;
BA_ "GenSigSendType" SG_ 180 VFC_Obj02A_DyStdDev 9;
BA_ "GenSigSendType" SG_ 180 VFC_Obj02A_VxStdDev 9;
BA_ "GenSigSendType" SG_ 180 VFC_Obj02A_VyStdDev 9;
BA_ "GenSigSendType" SG_ 180 VFC_Obj02A_AxStdDev 9;
BA_ "GenSigSendType" SG_ 180 VFC_Obj02A_AyStdDev 9;
BA_ "GenSigSendType" SG_ 180 VFC_Obj02A_Length 9;
BA_ "GenSigSendType" SG_ 180 VFC_Obj02A_Width 9;
BA_ "GenSigSendType" SG_ 180 VFC_Obj02A_Height 9;
BA_ "GenSigSendType" SG_ 180 VFC_Obj02A_LengthStdDev 9;
BA_ "GenSigSendType" SG_ 180 VFC_Obj02A_WidthStdDev 9;
BA_ "GenSigSendType" SG_ 180 VFC_Obj02A_HeightStdDev 9;
BA_ "GenSigSendType" SG_ 180 VFC_Obj02A_EdgeLeft 9;
BA_ "GenSigStartValue" SG_ 180 VFC_Obj02A_EdgeLeft 4000;
BA_ "GenSigSendType" SG_ 180 VFC_Obj02A_EdgeMid 9;
BA_ "GenSigStartValue" SG_ 180 VFC_Obj02A_EdgeMid 4000;
BA_ "GenSigSendType" SG_ 180 VFC_Obj02A_EdgeRight 9;
BA_ "GenSigStartValue" SG_ 180 VFC_Obj02A_EdgeRight 4000;
BA_ "GenSigSendType" SG_ 180 VFC_Obj02A_EdgeTop 9;
BA_ "GenSigStartValue" SG_ 180 VFC_Obj02A_EdgeTop 2000;
BA_ "GenSigSendType" SG_ 180 VFC_Obj02A_EdgeBottom 9;
BA_ "GenSigStartValue" SG_ 180 VFC_Obj02A_EdgeBottom 2000;
BA_ "GenSigSendType" SG_ 180 VFC_Obj02A_EdgeLeftStdDev 9;
BA_ "GenSigSendType" SG_ 180 VFC_Obj02A_EdgeMidStdDev 9;
BA_ "GenSigSendType" SG_ 180 VFC_Obj02A_EdgeRightStdDev 9;
BA_ "GenSigSendType" SG_ 180 VFC_Obj02A_EdgeTopStdDev 9;
BA_ "GenSigSendType" SG_ 180 VFC_Obj02A_EdgeBottomStdDev 9;
BA_ "GenSigSendType" SG_ 180 VFC_Obj02A_NormVx 9;
BA_ "GenSigStartValue" SG_ 180 VFC_Obj02A_NormVx 40000;
BA_ "GenSigSendType" SG_ 180 VFC_Obj02A_NormAx 9;
BA_ "GenSigStartValue" SG_ 180 VFC_Obj02A_NormAx 5000;
BA_ "GenSigSendType" SG_ 180 VFC_Obj02A_NormVyEdgeLeft 9;
BA_ "GenSigStartValue" SG_ 180 VFC_Obj02A_NormVyEdgeLeft 4000;
BA_ "GenSigSendType" SG_ 180 VFC_Obj02A_NormVyEdgeRight 9;
BA_ "GenSigStartValue" SG_ 180 VFC_Obj02A_NormVyEdgeRight 4000;
BA_ "GenSigSendType" SG_ 180 VFC_Obj02A_NormVxStdDev 9;
BA_ "GenSigSendType" SG_ 180 VFC_Obj02A_NormAxStdDev 9;
BA_ "GenSigSendType" SG_ 180 VFC_Obj02A_NormVyEdgeLeftStdDev 9;
BA_ "GenSigSendType" SG_ 180 VFC_Obj02A_NormVyEdgeRightStdDev 9;
BA_ "GenSigSendType" SG_ 180 VFC_Obj02A_ScaleChange 9;
BA_ "GenSigSendType" SG_ 180 VFC_Obj02A_ScaleChngStdDev 9;
BA_ "GenSigSendType" SG_ 180 VFC_Obj02A_HeadingAngle 9;
BA_ "GenSigStartValue" SG_ 180 VFC_Obj02A_HeadingAngle 157;
BA_ "GenSigSendType" SG_ 180 VFC_Obj02A_HeadingAngleStdDev 9;
BA_ "GenSigSendType" SG_ 180 VFC_Obj02A_HeadOrientation 9;
BA_ "GenSigSendType" SG_ 180 VFC_Obj02A_CompletelyInImg 9;
BA_ "GenSigSendType" SG_ 180 VFC_Obj02A_ProbMovingLat 9;
BA_ "GenSigSendType" SG_ 180 VFC_Obj02A_ProbMovingLong 9;
BA_ "GenSigSendType" SG_ 180 VFC_Obj02A_ProbExist 9;
BA_ "GenSigSendType" SG_ 180 VFC_Obj02A_MeasSource 9;
BA_ "GenSigSendType" SG_ 180 VFC_Obj02A_Reliability 9;
BA_ "GenSigSendType" SG_ 180 VFC_Obj02A_Measured 9;
BA_ "GenSigSendType" SG_ 180 VFC_Obj02A_VisibleView 9;
BA_ "GenSigSendType" SG_ 180 VFC_Obj02A_ClassifiedView 9;
BA_ "GenSigSendType" SG_ 180 VFC_Obj02A_DirIndicator 9;
BA_ "GenSigSendType" SG_ 180 VFC_Obj02A_BrakeLight 9;
BA_ "GenSigSendType" SG_ 182 VFC_Obj03A_CRC 9;
BA_ "GenSigSendType" SG_ 182 VFC_Obj03A_AliveCtr 9;
BA_ "GenSigSendType" SG_ 182 VFC_Obj03A_ProtBlockCtr 9;
BA_ "GenSigSendType" SG_ 182 VFC_Obj03A_ID 9;
BA_ "GenSigSendType" SG_ 182 VFC_Obj03A_Type 9;
BA_ "GenSigSendType" SG_ 182 VFC_Obj03A_TypeProb 9;
BA_ "GenSigSendType" SG_ 182 VFC_Obj03A_Dx 9;
BA_ "GenSigSendType" SG_ 182 VFC_Obj03A_Dy 9;
BA_ "GenSigStartValue" SG_ 182 VFC_Obj03A_Dy 8000;
BA_ "GenSigSendType" SG_ 182 VFC_Obj03A_Vx 9;
BA_ "GenSigStartValue" SG_ 182 VFC_Obj03A_Vx 1540;
BA_ "GenSigSendType" SG_ 182 VFC_Obj03A_Vy 9;
BA_ "GenSigStartValue" SG_ 182 VFC_Obj03A_Vy 500;
BA_ "GenSigSendType" SG_ 182 VFC_Obj03A_Ax 9;
BA_ "GenSigStartValue" SG_ 182 VFC_Obj03A_Ax 160;
BA_ "GenSigSendType" SG_ 182 VFC_Obj03A_Ay 9;
BA_ "GenSigStartValue" SG_ 182 VFC_Obj03A_Ay 120;
BA_ "GenSigSendType" SG_ 182 VFC_Obj03A_DxStdDev 9;
BA_ "GenSigSendType" SG_ 182 VFC_Obj03A_DyStdDev 9;
BA_ "GenSigSendType" SG_ 182 VFC_Obj03A_VxStdDev 9;
BA_ "GenSigSendType" SG_ 182 VFC_Obj03A_VyStdDev 9;
BA_ "GenSigSendType" SG_ 182 VFC_Obj03A_AxStdDev 9;
BA_ "GenSigSendType" SG_ 182 VFC_Obj03A_AyStdDev 9;
BA_ "GenSigSendType" SG_ 182 VFC_Obj03A_Length 9;
BA_ "GenSigSendType" SG_ 182 VFC_Obj03A_Width 9;
BA_ "GenSigSendType" SG_ 182 VFC_Obj03A_Height 9;
BA_ "GenSigSendType" SG_ 182 VFC_Obj03A_LengthStdDev 9;
BA_ "GenSigSendType" SG_ 182 VFC_Obj03A_WidthStdDev 9;
BA_ "GenSigSendType" SG_ 182 VFC_Obj03A_HeightStdDev 9;
BA_ "GenSigSendType" SG_ 182 VFC_Obj03A_EdgeLeft 9;
BA_ "GenSigStartValue" SG_ 182 VFC_Obj03A_EdgeLeft 4000;
BA_ "GenSigSendType" SG_ 182 VFC_Obj03A_EdgeMid 9;
BA_ "GenSigStartValue" SG_ 182 VFC_Obj03A_EdgeMid 4000;
BA_ "GenSigSendType" SG_ 182 VFC_Obj03A_EdgeRight 9;
BA_ "GenSigStartValue" SG_ 182 VFC_Obj03A_EdgeRight 4000;
BA_ "GenSigSendType" SG_ 182 VFC_Obj03A_EdgeTop 9;
BA_ "GenSigStartValue" SG_ 182 VFC_Obj03A_EdgeTop 2000;
BA_ "GenSigSendType" SG_ 182 VFC_Obj03A_EdgeBottom 9;
BA_ "GenSigStartValue" SG_ 182 VFC_Obj03A_EdgeBottom 2000;
BA_ "GenSigSendType" SG_ 182 VFC_Obj03A_EdgeLeftStdDev 9;
BA_ "GenSigSendType" SG_ 182 VFC_Obj03A_EdgeMidStdDev 9;
BA_ "GenSigSendType" SG_ 182 VFC_Obj03A_EdgeRightStdDev 9;
BA_ "GenSigSendType" SG_ 182 VFC_Obj03A_EdgeTopStdDev 9;
BA_ "GenSigSendType" SG_ 182 VFC_Obj03A_EdgeBottomStdDev 9;
BA_ "GenSigSendType" SG_ 182 VFC_Obj03A_NormVx 9;
BA_ "GenSigStartValue" SG_ 182 VFC_Obj03A_NormVx 40000;
BA_ "GenSigSendType" SG_ 182 VFC_Obj03A_NormAx 9;
BA_ "GenSigStartValue" SG_ 182 VFC_Obj03A_NormAx 5000;
BA_ "GenSigSendType" SG_ 182 VFC_Obj03A_NormVyEdgeLeft 9;
BA_ "GenSigStartValue" SG_ 182 VFC_Obj03A_NormVyEdgeLeft 4000;
BA_ "GenSigSendType" SG_ 182 VFC_Obj03A_NormVyEdgeRight 9;
BA_ "GenSigStartValue" SG_ 182 VFC_Obj03A_NormVyEdgeRight 4000;
BA_ "GenSigSendType" SG_ 182 VFC_Obj03A_NormVxStdDev 9;
BA_ "GenSigSendType" SG_ 182 VFC_Obj03A_NormAxStdDev 9;
BA_ "GenSigSendType" SG_ 182 VFC_Obj03A_NormVyEdgeLeftStdDev 9;
BA_ "GenSigSendType" SG_ 182 VFC_Obj03A_NormVyEdgeRightStdDev 9;
BA_ "GenSigSendType" SG_ 182 VFC_Obj03A_ScaleChange 9;
BA_ "GenSigSendType" SG_ 182 VFC_Obj03A_ScaleChngStdDev 9;
BA_ "GenSigSendType" SG_ 182 VFC_Obj03A_HeadingAngle 9;
BA_ "GenSigStartValue" SG_ 182 VFC_Obj03A_HeadingAngle 157;
BA_ "GenSigSendType" SG_ 182 VFC_Obj03A_HeadingAngleStdDev 9;
BA_ "GenSigSendType" SG_ 182 VFC_Obj03A_HeadOrientation 9;
BA_ "GenSigSendType" SG_ 182 VFC_Obj03A_CompletelyInImg 9;
BA_ "GenSigSendType" SG_ 182 VFC_Obj03A_ProbMovingLat 9;
BA_ "GenSigSendType" SG_ 182 VFC_Obj03A_ProbMovingLong 9;
BA_ "GenSigSendType" SG_ 182 VFC_Obj03A_ProbExist 9;
BA_ "GenSigSendType" SG_ 182 VFC_Obj03A_MeasSource 9;
BA_ "GenSigSendType" SG_ 182 VFC_Obj03A_Reliability 9;
BA_ "GenSigSendType" SG_ 182 VFC_Obj03A_Measured 9;
BA_ "GenSigSendType" SG_ 182 VFC_Obj03A_VisibleView 9;
BA_ "GenSigSendType" SG_ 182 VFC_Obj03A_ClassifiedView 9;
BA_ "GenSigSendType" SG_ 182 VFC_Obj03A_DirIndicator 9;
BA_ "GenSigSendType" SG_ 182 VFC_Obj03A_BrakeLight 9;
BA_ "GenSigSendType" SG_ 184 VFC_Obj04A_CRC 9;
BA_ "GenSigSendType" SG_ 184 VFC_Obj04A_AliveCtr 9;
BA_ "GenSigSendType" SG_ 184 VFC_Obj04A_ProtBlockCtr 9;
BA_ "GenSigSendType" SG_ 184 VFC_Obj04A_ID 9;
BA_ "GenSigSendType" SG_ 184 VFC_Obj04A_Type 9;
BA_ "GenSigSendType" SG_ 184 VFC_Obj04A_TypeProb 9;
BA_ "GenSigSendType" SG_ 184 VFC_Obj04A_Dx 9;
BA_ "GenSigSendType" SG_ 184 VFC_Obj04A_Dy 9;
BA_ "GenSigStartValue" SG_ 184 VFC_Obj04A_Dy 8000;
BA_ "GenSigSendType" SG_ 184 VFC_Obj04A_Vx 9;
BA_ "GenSigStartValue" SG_ 184 VFC_Obj04A_Vx 1540;
BA_ "GenSigSendType" SG_ 184 VFC_Obj04A_Vy 9;
BA_ "GenSigStartValue" SG_ 184 VFC_Obj04A_Vy 500;
BA_ "GenSigSendType" SG_ 184 VFC_Obj04A_Ax 9;
BA_ "GenSigStartValue" SG_ 184 VFC_Obj04A_Ax 160;
BA_ "GenSigSendType" SG_ 184 VFC_Obj04A_Ay 9;
BA_ "GenSigStartValue" SG_ 184 VFC_Obj04A_Ay 120;
BA_ "GenSigSendType" SG_ 184 VFC_Obj04A_DxStdDev 9;
BA_ "GenSigSendType" SG_ 184 VFC_Obj04A_DyStdDev 9;
BA_ "GenSigSendType" SG_ 184 VFC_Obj04A_VxStdDev 9;
BA_ "GenSigSendType" SG_ 184 VFC_Obj04A_VyStdDev 9;
BA_ "GenSigSendType" SG_ 184 VFC_Obj04A_AxStdDev 9;
BA_ "GenSigSendType" SG_ 184 VFC_Obj04A_AyStdDev 9;
BA_ "GenSigSendType" SG_ 184 VFC_Obj04A_Length 9;
BA_ "GenSigSendType" SG_ 184 VFC_Obj04A_Width 9;
BA_ "GenSigSendType" SG_ 184 VFC_Obj04A_Height 9;
BA_ "GenSigSendType" SG_ 184 VFC_Obj04A_LengthStdDev 9;
BA_ "GenSigSendType" SG_ 184 VFC_Obj04A_WidthStdDev 9;
BA_ "GenSigSendType" SG_ 184 VFC_Obj04A_HeightStdDev 9;
BA_ "GenSigSendType" SG_ 184 VFC_Obj04A_EdgeLeft 9;
BA_ "GenSigStartValue" SG_ 184 VFC_Obj04A_EdgeLeft 4000;
BA_ "GenSigSendType" SG_ 184 VFC_Obj04A_EdgeMid 9;
BA_ "GenSigStartValue" SG_ 184 VFC_Obj04A_EdgeMid 4000;
BA_ "GenSigSendType" SG_ 184 VFC_Obj04A_EdgeRight 9;
BA_ "GenSigStartValue" SG_ 184 VFC_Obj04A_EdgeRight 4000;
BA_ "GenSigSendType" SG_ 184 VFC_Obj04A_EdgeTop 9;
BA_ "GenSigStartValue" SG_ 184 VFC_Obj04A_EdgeTop 2000;
BA_ "GenSigSendType" SG_ 184 VFC_Obj04A_EdgeBottom 9;
BA_ "GenSigStartValue" SG_ 184 VFC_Obj04A_EdgeBottom 2000;
BA_ "GenSigSendType" SG_ 184 VFC_Obj04A_EdgeLeftStdDev 9;
BA_ "GenSigSendType" SG_ 184 VFC_Obj04A_EdgeMidStdDev 9;
BA_ "GenSigSendType" SG_ 184 VFC_Obj04A_EdgeRightStdDev 9;
BA_ "GenSigSendType" SG_ 184 VFC_Obj04A_EdgeTopStdDev 9;
BA_ "GenSigSendType" SG_ 184 VFC_Obj04A_EdgeBottomStdDev 9;
BA_ "GenSigSendType" SG_ 184 VFC_Obj04A_NormVx 9;
BA_ "GenSigStartValue" SG_ 184 VFC_Obj04A_NormVx 40000;
BA_ "GenSigSendType" SG_ 184 VFC_Obj04A_NormAx 9;
BA_ "GenSigStartValue" SG_ 184 VFC_Obj04A_NormAx 5000;
BA_ "GenSigSendType" SG_ 184 VFC_Obj04A_NormVyEdgeLeft 9;
BA_ "GenSigStartValue" SG_ 184 VFC_Obj04A_NormVyEdgeLeft 4000;
BA_ "GenSigSendType" SG_ 184 VFC_Obj04A_NormVyEdgeRight 9;
BA_ "GenSigStartValue" SG_ 184 VFC_Obj04A_NormVyEdgeRight 4000;
BA_ "GenSigSendType" SG_ 184 VFC_Obj04A_NormVxStdDev 9;
BA_ "GenSigSendType" SG_ 184 VFC_Obj04A_NormAxStdDev 9;
BA_ "GenSigSendType" SG_ 184 VFC_Obj04A_NormVyEdgeLeftStdDev 9;
BA_ "GenSigSendType" SG_ 184 VFC_Obj04A_NormVyEdgeRightStdDev 9;
BA_ "GenSigSendType" SG_ 184 VFC_Obj04A_ScaleChange 9;
BA_ "GenSigSendType" SG_ 184 VFC_Obj04A_ScaleChngStdDev 9;
BA_ "GenSigSendType" SG_ 184 VFC_Obj04A_HeadingAngle 9;
BA_ "GenSigStartValue" SG_ 184 VFC_Obj04A_HeadingAngle 157;
BA_ "GenSigSendType" SG_ 184 VFC_Obj04A_HeadingAngleStdDev 9;
BA_ "GenSigSendType" SG_ 184 VFC_Obj04A_HeadOrientation 9;
BA_ "GenSigSendType" SG_ 184 VFC_Obj04A_CompletelyInImg 9;
BA_ "GenSigSendType" SG_ 184 VFC_Obj04A_ProbMovingLat 9;
BA_ "GenSigSendType" SG_ 184 VFC_Obj04A_ProbMovingLong 9;
BA_ "GenSigSendType" SG_ 184 VFC_Obj04A_ProbExist 9;
BA_ "GenSigSendType" SG_ 184 VFC_Obj04A_MeasSource 9;
BA_ "GenSigSendType" SG_ 184 VFC_Obj04A_Reliability 9;
BA_ "GenSigSendType" SG_ 184 VFC_Obj04A_Measured 9;
BA_ "GenSigSendType" SG_ 184 VFC_Obj04A_VisibleView 9;
BA_ "GenSigSendType" SG_ 184 VFC_Obj04A_ClassifiedView 9;
BA_ "GenSigSendType" SG_ 184 VFC_Obj04A_DirIndicator 9;
BA_ "GenSigSendType" SG_ 184 VFC_Obj04A_BrakeLight 9;
BA_ "GenSigSendType" SG_ 186 VFC_Obj05A_CRC 9;
BA_ "GenSigSendType" SG_ 186 VFC_Obj05A_AliveCtr 9;
BA_ "GenSigSendType" SG_ 186 VFC_Obj05A_ProtBlockCtr 9;
BA_ "GenSigSendType" SG_ 186 VFC_Obj05A_ID 9;
BA_ "GenSigSendType" SG_ 186 VFC_Obj05A_Type 9;
BA_ "GenSigSendType" SG_ 186 VFC_Obj05A_TypeProb 9;
BA_ "GenSigSendType" SG_ 186 VFC_Obj05A_Dx 9;
BA_ "GenSigSendType" SG_ 186 VFC_Obj05A_Dy 9;
BA_ "GenSigStartValue" SG_ 186 VFC_Obj05A_Dy 8000;
BA_ "GenSigSendType" SG_ 186 VFC_Obj05A_Vx 9;
BA_ "GenSigStartValue" SG_ 186 VFC_Obj05A_Vx 1540;
BA_ "GenSigSendType" SG_ 186 VFC_Obj05A_Vy 9;
BA_ "GenSigStartValue" SG_ 186 VFC_Obj05A_Vy 500;
BA_ "GenSigSendType" SG_ 186 VFC_Obj05A_Ax 9;
BA_ "GenSigStartValue" SG_ 186 VFC_Obj05A_Ax 160;
BA_ "GenSigSendType" SG_ 186 VFC_Obj05A_Ay 9;
BA_ "GenSigStartValue" SG_ 186 VFC_Obj05A_Ay 120;
BA_ "GenSigSendType" SG_ 186 VFC_Obj05A_DxStdDev 9;
BA_ "GenSigSendType" SG_ 186 VFC_Obj05A_DyStdDev 9;
BA_ "GenSigSendType" SG_ 186 VFC_Obj05A_VxStdDev 9;
BA_ "GenSigSendType" SG_ 186 VFC_Obj05A_VyStdDev 9;
BA_ "GenSigSendType" SG_ 186 VFC_Obj05A_AxStdDev 9;
BA_ "GenSigSendType" SG_ 186 VFC_Obj05A_AyStdDev 9;
BA_ "GenSigSendType" SG_ 186 VFC_Obj05A_Length 9;
BA_ "GenSigSendType" SG_ 186 VFC_Obj05A_Width 9;
BA_ "GenSigSendType" SG_ 186 VFC_Obj05A_Height 9;
BA_ "GenSigSendType" SG_ 186 VFC_Obj05A_LengthStdDev 9;
BA_ "GenSigSendType" SG_ 186 VFC_Obj05A_WidthStdDev 9;
BA_ "GenSigSendType" SG_ 186 VFC_Obj05A_HeightStdDev 9;
BA_ "GenSigSendType" SG_ 186 VFC_Obj05A_EdgeLeft 9;
BA_ "GenSigStartValue" SG_ 186 VFC_Obj05A_EdgeLeft 4000;
BA_ "GenSigSendType" SG_ 186 VFC_Obj05A_EdgeMid 9;
BA_ "GenSigStartValue" SG_ 186 VFC_Obj05A_EdgeMid 4000;
BA_ "GenSigSendType" SG_ 186 VFC_Obj05A_EdgeRight 9;
BA_ "GenSigStartValue" SG_ 186 VFC_Obj05A_EdgeRight 4000;
BA_ "GenSigSendType" SG_ 186 VFC_Obj05A_EdgeTop 9;
BA_ "GenSigStartValue" SG_ 186 VFC_Obj05A_EdgeTop 2000;
BA_ "GenSigSendType" SG_ 186 VFC_Obj05A_EdgeBottom 9;
BA_ "GenSigStartValue" SG_ 186 VFC_Obj05A_EdgeBottom 2000;
BA_ "GenSigSendType" SG_ 186 VFC_Obj05A_EdgeLeftStdDev 9;
BA_ "GenSigSendType" SG_ 186 VFC_Obj05A_EdgeMidStdDev 9;
BA_ "GenSigSendType" SG_ 186 VFC_Obj05A_EdgeRightStdDev 9;
BA_ "GenSigSendType" SG_ 186 VFC_Obj05A_EdgeTopStdDev 9;
BA_ "GenSigSendType" SG_ 186 VFC_Obj05A_EdgeBottomStdDev 9;
BA_ "GenSigSendType" SG_ 186 VFC_Obj05A_NormVx 9;
BA_ "GenSigStartValue" SG_ 186 VFC_Obj05A_NormVx 40000;
BA_ "GenSigSendType" SG_ 186 VFC_Obj05A_NormAx 9;
BA_ "GenSigStartValue" SG_ 186 VFC_Obj05A_NormAx 5000;
BA_ "GenSigSendType" SG_ 186 VFC_Obj05A_NormVyEdgeLeft 9;
BA_ "GenSigStartValue" SG_ 186 VFC_Obj05A_NormVyEdgeLeft 4000;
BA_ "GenSigSendType" SG_ 186 VFC_Obj05A_NormVyEdgeRight 9;
BA_ "GenSigStartValue" SG_ 186 VFC_Obj05A_NormVyEdgeRight 4000;
BA_ "GenSigSendType" SG_ 186 VFC_Obj05A_NormVxStdDev 9;
BA_ "GenSigSendType" SG_ 186 VFC_Obj05A_NormAxStdDev 9;
BA_ "GenSigSendType" SG_ 186 VFC_Obj05A_NormVyEdgeLeftStdDev 9;
BA_ "GenSigSendType" SG_ 186 VFC_Obj05A_NormVyEdgeRightStdDev 9;
BA_ "GenSigSendType" SG_ 186 VFC_Obj05A_ScaleChange 9;
BA_ "GenSigSendType" SG_ 186 VFC_Obj05A_ScaleChngStdDev 9;
BA_ "GenSigSendType" SG_ 186 VFC_Obj05A_HeadingAngle 9;
BA_ "GenSigStartValue" SG_ 186 VFC_Obj05A_HeadingAngle 157;
BA_ "GenSigSendType" SG_ 186 VFC_Obj05A_HeadingAngleStdDev 9;
BA_ "GenSigSendType" SG_ 186 VFC_Obj05A_HeadOrientation 9;
BA_ "GenSigSendType" SG_ 186 VFC_Obj05A_CompletelyInImg 9;
BA_ "GenSigSendType" SG_ 186 VFC_Obj05A_ProbMovingLat 9;
BA_ "GenSigSendType" SG_ 186 VFC_Obj05A_ProbMovingLong 9;
BA_ "GenSigSendType" SG_ 186 VFC_Obj05A_ProbExist 9;
BA_ "GenSigSendType" SG_ 186 VFC_Obj05A_MeasSource 9;
BA_ "GenSigSendType" SG_ 186 VFC_Obj05A_Reliability 9;
BA_ "GenSigSendType" SG_ 186 VFC_Obj05A_Measured 9;
BA_ "GenSigSendType" SG_ 186 VFC_Obj05A_VisibleView 9;
BA_ "GenSigSendType" SG_ 186 VFC_Obj05A_ClassifiedView 9;
BA_ "GenSigSendType" SG_ 186 VFC_Obj05A_DirIndicator 9;
BA_ "GenSigSendType" SG_ 186 VFC_Obj05A_BrakeLight 9;
BA_ "GenSigSendType" SG_ 188 VFC_Obj06A_CRC 9;
BA_ "GenSigSendType" SG_ 188 VFC_Obj06A_AliveCtr 9;
BA_ "GenSigSendType" SG_ 188 VFC_Obj06A_ProtBlockCtr 9;
BA_ "GenSigSendType" SG_ 188 VFC_Obj06A_ID 9;
BA_ "GenSigSendType" SG_ 188 VFC_Obj06A_Type 9;
BA_ "GenSigSendType" SG_ 188 VFC_Obj06A_TypeProb 9;
BA_ "GenSigSendType" SG_ 188 VFC_Obj06A_Dx 9;
BA_ "GenSigSendType" SG_ 188 VFC_Obj06A_Dy 9;
BA_ "GenSigStartValue" SG_ 188 VFC_Obj06A_Dy 8000;
BA_ "GenSigSendType" SG_ 188 VFC_Obj06A_Vx 9;
BA_ "GenSigStartValue" SG_ 188 VFC_Obj06A_Vx 1540;
BA_ "GenSigSendType" SG_ 188 VFC_Obj06A_Vy 9;
BA_ "GenSigStartValue" SG_ 188 VFC_Obj06A_Vy 500;
BA_ "GenSigSendType" SG_ 188 VFC_Obj06A_Ax 9;
BA_ "GenSigStartValue" SG_ 188 VFC_Obj06A_Ax 160;
BA_ "GenSigSendType" SG_ 188 VFC_Obj06A_Ay 9;
BA_ "GenSigStartValue" SG_ 188 VFC_Obj06A_Ay 120;
BA_ "GenSigSendType" SG_ 188 VFC_Obj06A_DxStdDev 9;
BA_ "GenSigSendType" SG_ 188 VFC_Obj06A_DyStdDev 9;
BA_ "GenSigSendType" SG_ 188 VFC_Obj06A_VxStdDev 9;
BA_ "GenSigSendType" SG_ 188 VFC_Obj06A_VyStdDev 9;
BA_ "GenSigSendType" SG_ 188 VFC_Obj06A_AxStdDev 9;
BA_ "GenSigSendType" SG_ 188 VFC_Obj06A_AyStdDev 9;
BA_ "GenSigSendType" SG_ 188 VFC_Obj06A_Length 9;
BA_ "GenSigSendType" SG_ 188 VFC_Obj06A_Width 9;
BA_ "GenSigSendType" SG_ 188 VFC_Obj06A_Height 9;
BA_ "GenSigSendType" SG_ 188 VFC_Obj06A_LengthStdDev 9;
BA_ "GenSigSendType" SG_ 188 VFC_Obj06A_WidthStdDev 9;
BA_ "GenSigSendType" SG_ 188 VFC_Obj06A_HeightStdDev 9;
BA_ "GenSigSendType" SG_ 188 VFC_Obj06A_EdgeLeft 9;
BA_ "GenSigStartValue" SG_ 188 VFC_Obj06A_EdgeLeft 4000;
BA_ "GenSigSendType" SG_ 188 VFC_Obj06A_EdgeMid 9;
BA_ "GenSigStartValue" SG_ 188 VFC_Obj06A_EdgeMid 4000;
BA_ "GenSigSendType" SG_ 188 VFC_Obj06A_EdgeRight 9;
BA_ "GenSigStartValue" SG_ 188 VFC_Obj06A_EdgeRight 4000;
BA_ "GenSigSendType" SG_ 188 VFC_Obj06A_EdgeTop 9;
BA_ "GenSigStartValue" SG_ 188 VFC_Obj06A_EdgeTop 2000;
BA_ "GenSigSendType" SG_ 188 VFC_Obj06A_EdgeBottom 9;
BA_ "GenSigStartValue" SG_ 188 VFC_Obj06A_EdgeBottom 2000;
BA_ "GenSigSendType" SG_ 188 VFC_Obj06A_EdgeLeftStdDev 9;
BA_ "GenSigSendType" SG_ 188 VFC_Obj06A_EdgeMidStdDev 9;
BA_ "GenSigSendType" SG_ 188 VFC_Obj06A_EdgeRightStdDev 9;
BA_ "GenSigSendType" SG_ 188 VFC_Obj06A_EdgeTopStdDev 9;
BA_ "GenSigSendType" SG_ 188 VFC_Obj06A_EdgeBottomStdDev 9;
BA_ "GenSigSendType" SG_ 188 VFC_Obj06A_NormVx 9;
BA_ "GenSigStartValue" SG_ 188 VFC_Obj06A_NormVx 40000;
BA_ "GenSigSendType" SG_ 188 VFC_Obj06A_NormAx 9;
BA_ "GenSigStartValue" SG_ 188 VFC_Obj06A_NormAx 5000;
BA_ "GenSigSendType" SG_ 188 VFC_Obj06A_NormVyEdgeLeft 9;
BA_ "GenSigStartValue" SG_ 188 VFC_Obj06A_NormVyEdgeLeft 4000;
BA_ "GenSigSendType" SG_ 188 VFC_Obj06A_NormVyEdgeRight 9;
BA_ "GenSigStartValue" SG_ 188 VFC_Obj06A_NormVyEdgeRight 4000;
BA_ "GenSigSendType" SG_ 188 VFC_Obj06A_NormVxStdDev 9;
BA_ "GenSigSendType" SG_ 188 VFC_Obj06A_NormAxStdDev 9;
BA_ "GenSigSendType" SG_ 188 VFC_Obj06A_NormVyEdgeLeftStdDev 9;
BA_ "GenSigSendType" SG_ 188 VFC_Obj06A_NormVyEdgeRightStdDev 9;
BA_ "GenSigSendType" SG_ 188 VFC_Obj06A_ScaleChange 9;
BA_ "GenSigSendType" SG_ 188 VFC_Obj06A_ScaleChngStdDev 9;
BA_ "GenSigSendType" SG_ 188 VFC_Obj06A_HeadingAngle 9;
BA_ "GenSigStartValue" SG_ 188 VFC_Obj06A_HeadingAngle 157;
BA_ "GenSigSendType" SG_ 188 VFC_Obj06A_HeadingAngleStdDev 9;
BA_ "GenSigSendType" SG_ 188 VFC_Obj06A_HeadOrientation 9;
BA_ "GenSigSendType" SG_ 188 VFC_Obj06A_CompletelyInImg 9;
BA_ "GenSigSendType" SG_ 188 VFC_Obj06A_ProbMovingLat 9;
BA_ "GenSigSendType" SG_ 188 VFC_Obj06A_ProbMovingLong 9;
BA_ "GenSigSendType" SG_ 188 VFC_Obj06A_ProbExist 9;
BA_ "GenSigSendType" SG_ 188 VFC_Obj06A_MeasSource 9;
BA_ "GenSigSendType" SG_ 188 VFC_Obj06A_Reliability 9;
BA_ "GenSigSendType" SG_ 188 VFC_Obj06A_Measured 9;
BA_ "GenSigSendType" SG_ 188 VFC_Obj06A_VisibleView 9;
BA_ "GenSigSendType" SG_ 188 VFC_Obj06A_ClassifiedView 9;
BA_ "GenSigSendType" SG_ 188 VFC_Obj06A_DirIndicator 9;
BA_ "GenSigSendType" SG_ 188 VFC_Obj06A_BrakeLight 9;
BA_ "GenSigSendType" SG_ 190 VFC_Obj07A_CRC 9;
BA_ "GenSigSendType" SG_ 190 VFC_Obj07A_AliveCtr 9;
BA_ "GenSigSendType" SG_ 190 VFC_Obj07A_ProtBlockCtr 9;
BA_ "GenSigSendType" SG_ 190 VFC_Obj07A_ID 9;
BA_ "GenSigSendType" SG_ 190 VFC_Obj07A_Type 9;
BA_ "GenSigSendType" SG_ 190 VFC_Obj07A_TypeProb 9;
BA_ "GenSigSendType" SG_ 190 VFC_Obj07A_Dx 9;
BA_ "GenSigSendType" SG_ 190 VFC_Obj07A_Dy 9;
BA_ "GenSigStartValue" SG_ 190 VFC_Obj07A_Dy 8000;
BA_ "GenSigSendType" SG_ 190 VFC_Obj07A_Vx 9;
BA_ "GenSigStartValue" SG_ 190 VFC_Obj07A_Vx 1540;
BA_ "GenSigSendType" SG_ 190 VFC_Obj07A_Vy 9;
BA_ "GenSigStartValue" SG_ 190 VFC_Obj07A_Vy 500;
BA_ "GenSigSendType" SG_ 190 VFC_Obj07A_Ax 9;
BA_ "GenSigStartValue" SG_ 190 VFC_Obj07A_Ax 160;
BA_ "GenSigSendType" SG_ 190 VFC_Obj07A_Ay 9;
BA_ "GenSigStartValue" SG_ 190 VFC_Obj07A_Ay 120;
BA_ "GenSigSendType" SG_ 190 VFC_Obj07A_DxStdDev 9;
BA_ "GenSigSendType" SG_ 190 VFC_Obj07A_DyStdDev 9;
BA_ "GenSigSendType" SG_ 190 VFC_Obj07A_VxStdDev 9;
BA_ "GenSigSendType" SG_ 190 VFC_Obj07A_VyStdDev 9;
BA_ "GenSigSendType" SG_ 190 VFC_Obj07A_AxStdDev 9;
BA_ "GenSigSendType" SG_ 190 VFC_Obj07A_AyStdDev 9;
BA_ "GenSigSendType" SG_ 190 VFC_Obj07A_Length 9;
BA_ "GenSigSendType" SG_ 190 VFC_Obj07A_Width 9;
BA_ "GenSigSendType" SG_ 190 VFC_Obj07A_Height 9;
BA_ "GenSigSendType" SG_ 190 VFC_Obj07A_LengthStdDev 9;
BA_ "GenSigSendType" SG_ 190 VFC_Obj07A_WidthStdDev 9;
BA_ "GenSigSendType" SG_ 190 VFC_Obj07A_HeightStdDev 9;
BA_ "GenSigSendType" SG_ 190 VFC_Obj07A_EdgeLeft 9;
BA_ "GenSigStartValue" SG_ 190 VFC_Obj07A_EdgeLeft 4000;
BA_ "GenSigSendType" SG_ 190 VFC_Obj07A_EdgeMid 9;
BA_ "GenSigStartValue" SG_ 190 VFC_Obj07A_EdgeMid 4000;
BA_ "GenSigSendType" SG_ 190 VFC_Obj07A_EdgeRight 9;
BA_ "GenSigStartValue" SG_ 190 VFC_Obj07A_EdgeRight 4000;
BA_ "GenSigSendType" SG_ 190 VFC_Obj07A_EdgeTop 9;
BA_ "GenSigStartValue" SG_ 190 VFC_Obj07A_EdgeTop 2000;
BA_ "GenSigSendType" SG_ 190 VFC_Obj07A_EdgeBottom 9;
BA_ "GenSigStartValue" SG_ 190 VFC_Obj07A_EdgeBottom 2000;
BA_ "GenSigSendType" SG_ 190 VFC_Obj07A_EdgeLeftStdDev 9;
BA_ "GenSigSendType" SG_ 190 VFC_Obj07A_EdgeMidStdDev 9;
BA_ "GenSigSendType" SG_ 190 VFC_Obj07A_EdgeRightStdDev 9;
BA_ "GenSigSendType" SG_ 190 VFC_Obj07A_EdgeTopStdDev 9;
BA_ "GenSigSendType" SG_ 190 VFC_Obj07A_EdgeBottomStdDev 9;
BA_ "GenSigSendType" SG_ 190 VFC_Obj07A_NormVx 9;
BA_ "GenSigStartValue" SG_ 190 VFC_Obj07A_NormVx 40000;
BA_ "GenSigSendType" SG_ 190 VFC_Obj07A_NormAx 9;
BA_ "GenSigStartValue" SG_ 190 VFC_Obj07A_NormAx 5000;
BA_ "GenSigSendType" SG_ 190 VFC_Obj07A_NormVyEdgeLeft 9;
BA_ "GenSigStartValue" SG_ 190 VFC_Obj07A_NormVyEdgeLeft 4000;
BA_ "GenSigSendType" SG_ 190 VFC_Obj07A_NormVyEdgeRight 9;
BA_ "GenSigStartValue" SG_ 190 VFC_Obj07A_NormVyEdgeRight 4000;
BA_ "GenSigSendType" SG_ 190 VFC_Obj07A_NormVxStdDev 9;
BA_ "GenSigSendType" SG_ 190 VFC_Obj07A_NormAxStdDev 9;
BA_ "GenSigSendType" SG_ 190 VFC_Obj07A_NormVyEdgeLeftStdDev 9;
BA_ "GenSigSendType" SG_ 190 VFC_Obj07A_NormVyEdgeRightStdDev 9;
BA_ "GenSigSendType" SG_ 190 VFC_Obj07A_ScaleChange 9;
BA_ "GenSigSendType" SG_ 190 VFC_Obj07A_ScaleChngStdDev 9;
BA_ "GenSigSendType" SG_ 190 VFC_Obj07A_HeadingAngle 9;
BA_ "GenSigStartValue" SG_ 190 VFC_Obj07A_HeadingAngle 157;
BA_ "GenSigSendType" SG_ 190 VFC_Obj07A_HeadingAngleStdDev 9;
BA_ "GenSigSendType" SG_ 190 VFC_Obj07A_HeadOrientation 9;
BA_ "GenSigSendType" SG_ 190 VFC_Obj07A_CompletelyInImg 9;
BA_ "GenSigSendType" SG_ 190 VFC_Obj07A_ProbMovingLat 9;
BA_ "GenSigSendType" SG_ 190 VFC_Obj07A_ProbMovingLong 9;
BA_ "GenSigSendType" SG_ 190 VFC_Obj07A_ProbExist 9;
BA_ "GenSigSendType" SG_ 190 VFC_Obj07A_MeasSource 9;
BA_ "GenSigSendType" SG_ 190 VFC_Obj07A_Reliability 9;
BA_ "GenSigSendType" SG_ 190 VFC_Obj07A_Measured 9;
BA_ "GenSigSendType" SG_ 190 VFC_Obj07A_VisibleView 9;
BA_ "GenSigSendType" SG_ 190 VFC_Obj07A_ClassifiedView 9;
BA_ "GenSigSendType" SG_ 190 VFC_Obj07A_DirIndicator 9;
BA_ "GenSigSendType" SG_ 190 VFC_Obj07A_BrakeLight 9;
BA_ "GenSigSendType" SG_ 192 VFC_Obj08A_CRC 9;
BA_ "GenSigSendType" SG_ 192 VFC_Obj08A_AliveCtr 9;
BA_ "GenSigSendType" SG_ 192 VFC_Obj08A_ProtBlockCtr 9;
BA_ "GenSigSendType" SG_ 192 VFC_Obj08A_ID 9;
BA_ "GenSigSendType" SG_ 192 VFC_Obj08A_Type 9;
BA_ "GenSigSendType" SG_ 192 VFC_Obj08A_TypeProb 9;
BA_ "GenSigSendType" SG_ 192 VFC_Obj08A_Dx 9;
BA_ "GenSigSendType" SG_ 192 VFC_Obj08A_Dy 9;
BA_ "GenSigStartValue" SG_ 192 VFC_Obj08A_Dy 8000;
BA_ "GenSigSendType" SG_ 192 VFC_Obj08A_Vx 9;
BA_ "GenSigStartValue" SG_ 192 VFC_Obj08A_Vx 1540;
BA_ "GenSigSendType" SG_ 192 VFC_Obj08A_Vy 9;
BA_ "GenSigStartValue" SG_ 192 VFC_Obj08A_Vy 500;
BA_ "GenSigSendType" SG_ 192 VFC_Obj08A_Ax 9;
BA_ "GenSigStartValue" SG_ 192 VFC_Obj08A_Ax 160;
BA_ "GenSigSendType" SG_ 192 VFC_Obj08A_Ay 9;
BA_ "GenSigStartValue" SG_ 192 VFC_Obj08A_Ay 120;
BA_ "GenSigSendType" SG_ 192 VFC_Obj08A_DxStdDev 9;
BA_ "GenSigSendType" SG_ 192 VFC_Obj08A_DyStdDev 9;
BA_ "GenSigSendType" SG_ 192 VFC_Obj08A_VxStdDev 9;
BA_ "GenSigSendType" SG_ 192 VFC_Obj08A_VyStdDev 9;
BA_ "GenSigSendType" SG_ 192 VFC_Obj08A_AxStdDev 9;
BA_ "GenSigSendType" SG_ 192 VFC_Obj08A_AyStdDev 9;
BA_ "GenSigSendType" SG_ 192 VFC_Obj08A_Length 9;
BA_ "GenSigSendType" SG_ 192 VFC_Obj08A_Width 9;
BA_ "GenSigSendType" SG_ 192 VFC_Obj08A_Height 9;
BA_ "GenSigSendType" SG_ 192 VFC_Obj08A_LengthStdDev 9;
BA_ "GenSigSendType" SG_ 192 VFC_Obj08A_WidthStdDev 9;
BA_ "GenSigSendType" SG_ 192 VFC_Obj08A_HeightStdDev 9;
BA_ "GenSigSendType" SG_ 192 VFC_Obj08A_EdgeLeft 9;
BA_ "GenSigStartValue" SG_ 192 VFC_Obj08A_EdgeLeft 4000;
BA_ "GenSigSendType" SG_ 192 VFC_Obj08A_EdgeMid 9;
BA_ "GenSigStartValue" SG_ 192 VFC_Obj08A_EdgeMid 4000;
BA_ "GenSigSendType" SG_ 192 VFC_Obj08A_EdgeRight 9;
BA_ "GenSigStartValue" SG_ 192 VFC_Obj08A_EdgeRight 4000;
BA_ "GenSigSendType" SG_ 192 VFC_Obj08A_EdgeTop 9;
BA_ "GenSigStartValue" SG_ 192 VFC_Obj08A_EdgeTop 2000;
BA_ "GenSigSendType" SG_ 192 VFC_Obj08A_EdgeBottom 9;
BA_ "GenSigStartValue" SG_ 192 VFC_Obj08A_EdgeBottom 2000;
BA_ "GenSigSendType" SG_ 192 VFC_Obj08A_EdgeLeftStdDev 9;
BA_ "GenSigSendType" SG_ 192 VFC_Obj08A_EdgeMidStdDev 9;
BA_ "GenSigSendType" SG_ 192 VFC_Obj08A_EdgeRightStdDev 9;
BA_ "GenSigSendType" SG_ 192 VFC_Obj08A_EdgeTopStdDev 9;
BA_ "GenSigSendType" SG_ 192 VFC_Obj08A_EdgeBottomStdDev 9;
BA_ "GenSigSendType" SG_ 192 VFC_Obj08A_NormVx 9;
BA_ "GenSigStartValue" SG_ 192 VFC_Obj08A_NormVx 40000;
BA_ "GenSigSendType" SG_ 192 VFC_Obj08A_NormAx 9;
BA_ "GenSigStartValue" SG_ 192 VFC_Obj08A_NormAx 5000;
BA_ "GenSigSendType" SG_ 192 VFC_Obj08A_NormVyEdgeLeft 9;
BA_ "GenSigStartValue" SG_ 192 VFC_Obj08A_NormVyEdgeLeft 4000;
BA_ "GenSigSendType" SG_ 192 VFC_Obj08A_NormVyEdgeRight 9;
BA_ "GenSigStartValue" SG_ 192 VFC_Obj08A_NormVyEdgeRight 4000;
BA_ "GenSigSendType" SG_ 192 VFC_Obj08A_NormVxStdDev 9;
BA_ "GenSigSendType" SG_ 192 VFC_Obj08A_NormAxStdDev 9;
BA_ "GenSigSendType" SG_ 192 VFC_Obj08A_NormVyEdgeLeftStdDev 9;
BA_ "GenSigSendType" SG_ 192 VFC_Obj08A_NormVyEdgeRightStdDev 9;
BA_ "GenSigSendType" SG_ 192 VFC_Obj08A_ScaleChange 9;
BA_ "GenSigSendType" SG_ 192 VFC_Obj08A_ScaleChngStdDev 9;
BA_ "GenSigSendType" SG_ 192 VFC_Obj08A_HeadingAngle 9;
BA_ "GenSigStartValue" SG_ 192 VFC_Obj08A_HeadingAngle 157;
BA_ "GenSigSendType" SG_ 192 VFC_Obj08A_HeadingAngleStdDev 9;
BA_ "GenSigSendType" SG_ 192 VFC_Obj08A_HeadOrientation 9;
BA_ "GenSigSendType" SG_ 192 VFC_Obj08A_CompletelyInImg 9;
BA_ "GenSigSendType" SG_ 192 VFC_Obj08A_ProbMovingLat 9;
BA_ "GenSigSendType" SG_ 192 VFC_Obj08A_ProbMovingLong 9;
BA_ "GenSigSendType" SG_ 192 VFC_Obj08A_ProbExist 9;
BA_ "GenSigSendType" SG_ 192 VFC_Obj08A_MeasSource 9;
BA_ "GenSigSendType" SG_ 192 VFC_Obj08A_Reliability 9;
BA_ "GenSigSendType" SG_ 192 VFC_Obj08A_Measured 9;
BA_ "GenSigSendType" SG_ 192 VFC_Obj08A_VisibleView 9;
BA_ "GenSigSendType" SG_ 192 VFC_Obj08A_ClassifiedView 9;
BA_ "GenSigSendType" SG_ 192 VFC_Obj08A_DirIndicator 9;
BA_ "GenSigSendType" SG_ 192 VFC_Obj08A_BrakeLight 9;
BA_ "GenSigSendType" SG_ 194 VFC_Obj09A_CRC 9;
BA_ "GenSigSendType" SG_ 194 VFC_Obj09A_AliveCtr 9;
BA_ "GenSigSendType" SG_ 194 VFC_Obj09A_ProtBlockCtr 9;
BA_ "GenSigSendType" SG_ 194 VFC_Obj09A_ID 9;
BA_ "GenSigSendType" SG_ 194 VFC_Obj09A_Type 9;
BA_ "GenSigSendType" SG_ 194 VFC_Obj09A_TypeProb 9;
BA_ "GenSigSendType" SG_ 194 VFC_Obj09A_Dx 9;
BA_ "GenSigSendType" SG_ 194 VFC_Obj09A_Dy 9;
BA_ "GenSigStartValue" SG_ 194 VFC_Obj09A_Dy 8000;
BA_ "GenSigSendType" SG_ 194 VFC_Obj09A_Vx 9;
BA_ "GenSigStartValue" SG_ 194 VFC_Obj09A_Vx 1540;
BA_ "GenSigSendType" SG_ 194 VFC_Obj09A_Vy 9;
BA_ "GenSigStartValue" SG_ 194 VFC_Obj09A_Vy 500;
BA_ "GenSigSendType" SG_ 194 VFC_Obj09A_Ax 9;
BA_ "GenSigStartValue" SG_ 194 VFC_Obj09A_Ax 160;
BA_ "GenSigSendType" SG_ 194 VFC_Obj09A_Ay 9;
BA_ "GenSigStartValue" SG_ 194 VFC_Obj09A_Ay 120;
BA_ "GenSigSendType" SG_ 194 VFC_Obj09A_DxStdDev 9;
BA_ "GenSigSendType" SG_ 194 VFC_Obj09A_DyStdDev 9;
BA_ "GenSigSendType" SG_ 194 VFC_Obj09A_VxStdDev 9;
BA_ "GenSigSendType" SG_ 194 VFC_Obj09A_VyStdDev 9;
BA_ "GenSigSendType" SG_ 194 VFC_Obj09A_AxStdDev 9;
BA_ "GenSigSendType" SG_ 194 VFC_Obj09A_AyStdDev 9;
BA_ "GenSigSendType" SG_ 194 VFC_Obj09A_Length 9;
BA_ "GenSigSendType" SG_ 194 VFC_Obj09A_Width 9;
BA_ "GenSigSendType" SG_ 194 VFC_Obj09A_Height 9;
BA_ "GenSigSendType" SG_ 194 VFC_Obj09A_LengthStdDev 9;
BA_ "GenSigSendType" SG_ 194 VFC_Obj09A_WidthStdDev 9;
BA_ "GenSigSendType" SG_ 194 VFC_Obj09A_HeightStdDev 9;
BA_ "GenSigSendType" SG_ 194 VFC_Obj09A_EdgeLeft 9;
BA_ "GenSigStartValue" SG_ 194 VFC_Obj09A_EdgeLeft 4000;
BA_ "GenSigSendType" SG_ 194 VFC_Obj09A_EdgeMid 9;
BA_ "GenSigStartValue" SG_ 194 VFC_Obj09A_EdgeMid 4000;
BA_ "GenSigSendType" SG_ 194 VFC_Obj09A_EdgeRight 9;
BA_ "GenSigStartValue" SG_ 194 VFC_Obj09A_EdgeRight 4000;
BA_ "GenSigSendType" SG_ 194 VFC_Obj09A_EdgeTop 9;
BA_ "GenSigStartValue" SG_ 194 VFC_Obj09A_EdgeTop 2000;
BA_ "GenSigSendType" SG_ 194 VFC_Obj09A_EdgeBottom 9;
BA_ "GenSigStartValue" SG_ 194 VFC_Obj09A_EdgeBottom 2000;
BA_ "GenSigSendType" SG_ 194 VFC_Obj09A_EdgeLeftStdDev 9;
BA_ "GenSigSendType" SG_ 194 VFC_Obj09A_EdgeMidStdDev 9;
BA_ "GenSigSendType" SG_ 194 VFC_Obj09A_EdgeRightStdDev 9;
BA_ "GenSigSendType" SG_ 194 VFC_Obj09A_EdgeTopStdDev 9;
BA_ "GenSigSendType" SG_ 194 VFC_Obj09A_EdgeBottomStdDev 9;
BA_ "GenSigSendType" SG_ 194 VFC_Obj09A_NormVx 9;
BA_ "GenSigStartValue" SG_ 194 VFC_Obj09A_NormVx 40000;
BA_ "GenSigSendType" SG_ 194 VFC_Obj09A_NormAx 9;
BA_ "GenSigStartValue" SG_ 194 VFC_Obj09A_NormAx 5000;
BA_ "GenSigSendType" SG_ 194 VFC_Obj09A_NormVyEdgeLeft 9;
BA_ "GenSigStartValue" SG_ 194 VFC_Obj09A_NormVyEdgeLeft 4000;
BA_ "GenSigSendType" SG_ 194 VFC_Obj09A_NormVyEdgeRight 9;
BA_ "GenSigStartValue" SG_ 194 VFC_Obj09A_NormVyEdgeRight 4000;
BA_ "GenSigSendType" SG_ 194 VFC_Obj09A_NormVxStdDev 9;
BA_ "GenSigSendType" SG_ 194 VFC_Obj09A_NormAxStdDev 9;
BA_ "GenSigSendType" SG_ 194 VFC_Obj09A_NormVyEdgeLeftStdDev 9;
BA_ "GenSigSendType" SG_ 194 VFC_Obj09A_NormVyEdgeRightStdDev 9;
BA_ "GenSigSendType" SG_ 194 VFC_Obj09A_ScaleChange 9;
BA_ "GenSigSendType" SG_ 194 VFC_Obj09A_ScaleChngStdDev 9;
BA_ "GenSigSendType" SG_ 194 VFC_Obj09A_HeadingAngle 9;
BA_ "GenSigStartValue" SG_ 194 VFC_Obj09A_HeadingAngle 157;
BA_ "GenSigSendType" SG_ 194 VFC_Obj09A_HeadingAngleStdDev 9;
BA_ "GenSigSendType" SG_ 194 VFC_Obj09A_HeadOrientation 9;
BA_ "GenSigSendType" SG_ 194 VFC_Obj09A_CompletelyInImg 9;
BA_ "GenSigSendType" SG_ 194 VFC_Obj09A_ProbMovingLat 9;
BA_ "GenSigSendType" SG_ 194 VFC_Obj09A_ProbMovingLong 9;
BA_ "GenSigSendType" SG_ 194 VFC_Obj09A_ProbExist 9;
BA_ "GenSigSendType" SG_ 194 VFC_Obj09A_MeasSource 9;
BA_ "GenSigSendType" SG_ 194 VFC_Obj09A_Reliability 9;
BA_ "GenSigSendType" SG_ 194 VFC_Obj09A_Measured 9;
BA_ "GenSigSendType" SG_ 194 VFC_Obj09A_VisibleView 9;
BA_ "GenSigSendType" SG_ 194 VFC_Obj09A_ClassifiedView 9;
BA_ "GenSigSendType" SG_ 194 VFC_Obj09A_DirIndicator 9;
BA_ "GenSigSendType" SG_ 194 VFC_Obj09A_BrakeLight 9;
BA_ "GenSigSendType" SG_ 196 VFC_Obj10A_CRC 9;
BA_ "GenSigSendType" SG_ 196 VFC_Obj10A_AliveCtr 9;
BA_ "GenSigSendType" SG_ 196 VFC_Obj10A_ProtBlockCtr 9;
BA_ "GenSigSendType" SG_ 196 VFC_Obj10A_ID 9;
BA_ "GenSigSendType" SG_ 196 VFC_Obj10A_Type 9;
BA_ "GenSigSendType" SG_ 196 VFC_Obj10A_TypeProb 9;
BA_ "GenSigSendType" SG_ 196 VFC_Obj10A_Dx 9;
BA_ "GenSigSendType" SG_ 196 VFC_Obj10A_Dy 9;
BA_ "GenSigStartValue" SG_ 196 VFC_Obj10A_Dy 8000;
BA_ "GenSigSendType" SG_ 196 VFC_Obj10A_Vx 9;
BA_ "GenSigStartValue" SG_ 196 VFC_Obj10A_Vx 1540;
BA_ "GenSigSendType" SG_ 196 VFC_Obj10A_Vy 9;
BA_ "GenSigStartValue" SG_ 196 VFC_Obj10A_Vy 500;
BA_ "GenSigSendType" SG_ 196 VFC_Obj10A_Ax 9;
BA_ "GenSigStartValue" SG_ 196 VFC_Obj10A_Ax 160;
BA_ "GenSigSendType" SG_ 196 VFC_Obj10A_Ay 9;
BA_ "GenSigStartValue" SG_ 196 VFC_Obj10A_Ay 120;
BA_ "GenSigSendType" SG_ 196 VFC_Obj10A_DxStdDev 9;
BA_ "GenSigSendType" SG_ 196 VFC_Obj10A_DyStdDev 9;
BA_ "GenSigSendType" SG_ 196 VFC_Obj10A_VxStdDev 9;
BA_ "GenSigSendType" SG_ 196 VFC_Obj10A_VyStdDev 9;
BA_ "GenSigSendType" SG_ 196 VFC_Obj10A_AxStdDev 9;
BA_ "GenSigSendType" SG_ 196 VFC_Obj10A_AyStdDev 9;
BA_ "GenSigSendType" SG_ 196 VFC_Obj10A_Length 9;
BA_ "GenSigSendType" SG_ 196 VFC_Obj10A_Width 9;
BA_ "GenSigSendType" SG_ 196 VFC_Obj10A_Height 9;
BA_ "GenSigSendType" SG_ 196 VFC_Obj10A_LengthStdDev 9;
BA_ "GenSigSendType" SG_ 196 VFC_Obj10A_WidthStdDev 9;
BA_ "GenSigSendType" SG_ 196 VFC_Obj10A_HeightStdDev 9;
BA_ "GenSigSendType" SG_ 196 VFC_Obj10A_EdgeLeft 9;
BA_ "GenSigStartValue" SG_ 196 VFC_Obj10A_EdgeLeft 4000;
BA_ "GenSigSendType" SG_ 196 VFC_Obj10A_EdgeMid 9;
BA_ "GenSigStartValue" SG_ 196 VFC_Obj10A_EdgeMid 4000;
BA_ "GenSigSendType" SG_ 196 VFC_Obj10A_EdgeRight 9;
BA_ "GenSigStartValue" SG_ 196 VFC_Obj10A_EdgeRight 4000;
BA_ "GenSigSendType" SG_ 196 VFC_Obj10A_EdgeTop 9;
BA_ "GenSigStartValue" SG_ 196 VFC_Obj10A_EdgeTop 2000;
BA_ "GenSigSendType" SG_ 196 VFC_Obj10A_EdgeBottom 9;
BA_ "GenSigStartValue" SG_ 196 VFC_Obj10A_EdgeBottom 2000;
BA_ "GenSigSendType" SG_ 196 VFC_Obj10A_EdgeLeftStdDev 9;
BA_ "GenSigSendType" SG_ 196 VFC_Obj10A_EdgeMidStdDev 9;
BA_ "GenSigSendType" SG_ 196 VFC_Obj10A_EdgeRightStdDev 9;
BA_ "GenSigSendType" SG_ 196 VFC_Obj10A_EdgeTopStdDev 9;
BA_ "GenSigSendType" SG_ 196 VFC_Obj10A_EdgeBottomStdDev 9;
BA_ "GenSigSendType" SG_ 196 VFC_Obj10A_NormVx 9;
BA_ "GenSigStartValue" SG_ 196 VFC_Obj10A_NormVx 40000;
BA_ "GenSigSendType" SG_ 196 VFC_Obj10A_NormAx 9;
BA_ "GenSigStartValue" SG_ 196 VFC_Obj10A_NormAx 5000;
BA_ "GenSigSendType" SG_ 196 VFC_Obj10A_NormVyEdgeLeft 9;
BA_ "GenSigStartValue" SG_ 196 VFC_Obj10A_NormVyEdgeLeft 4000;
BA_ "GenSigSendType" SG_ 196 VFC_Obj10A_NormVyEdgeRight 9;
BA_ "GenSigStartValue" SG_ 196 VFC_Obj10A_NormVyEdgeRight 4000;
BA_ "GenSigSendType" SG_ 196 VFC_Obj10A_NormVxStdDev 9;
BA_ "GenSigSendType" SG_ 196 VFC_Obj10A_NormAxStdDev 9;
BA_ "GenSigSendType" SG_ 196 VFC_Obj10A_NormVyEdgeLeftStdDev 9;
BA_ "GenSigSendType" SG_ 196 VFC_Obj10A_NormVyEdgeRightStdDev 9;
BA_ "GenSigSendType" SG_ 196 VFC_Obj10A_ScaleChange 9;
BA_ "GenSigSendType" SG_ 196 VFC_Obj10A_ScaleChngStdDev 9;
BA_ "GenSigSendType" SG_ 196 VFC_Obj10A_HeadingAngle 9;
BA_ "GenSigStartValue" SG_ 196 VFC_Obj10A_HeadingAngle 157;
BA_ "GenSigSendType" SG_ 196 VFC_Obj10A_HeadingAngleStdDev 9;
BA_ "GenSigSendType" SG_ 196 VFC_Obj10A_HeadOrientation 9;
BA_ "GenSigSendType" SG_ 196 VFC_Obj10A_CompletelyInImg 9;
BA_ "GenSigSendType" SG_ 196 VFC_Obj10A_ProbMovingLat 9;
BA_ "GenSigSendType" SG_ 196 VFC_Obj10A_ProbMovingLong 9;
BA_ "GenSigSendType" SG_ 196 VFC_Obj10A_ProbExist 9;
BA_ "GenSigSendType" SG_ 196 VFC_Obj10A_MeasSource 9;
BA_ "GenSigSendType" SG_ 196 VFC_Obj10A_Reliability 9;
BA_ "GenSigSendType" SG_ 196 VFC_Obj10A_Measured 9;
BA_ "GenSigSendType" SG_ 196 VFC_Obj10A_VisibleView 9;
BA_ "GenSigSendType" SG_ 196 VFC_Obj10A_ClassifiedView 9;
BA_ "GenSigSendType" SG_ 196 VFC_Obj10A_DirIndicator 9;
BA_ "GenSigSendType" SG_ 196 VFC_Obj10A_BrakeLight 9;
BA_ "GenSigSendType" SG_ 198 VFC_Obj11A_CRC 9;
BA_ "GenSigSendType" SG_ 198 VFC_Obj11A_AliveCtr 9;
BA_ "GenSigSendType" SG_ 198 VFC_Obj11A_ProtBlockCtr 9;
BA_ "GenSigSendType" SG_ 198 VFC_Obj11A_ID 9;
BA_ "GenSigSendType" SG_ 198 VFC_Obj11A_Type 9;
BA_ "GenSigSendType" SG_ 198 VFC_Obj11A_TypeProb 9;
BA_ "GenSigSendType" SG_ 198 VFC_Obj11A_Dx 9;
BA_ "GenSigSendType" SG_ 198 VFC_Obj11A_Dy 9;
BA_ "GenSigStartValue" SG_ 198 VFC_Obj11A_Dy 8000;
BA_ "GenSigSendType" SG_ 198 VFC_Obj11A_Vx 9;
BA_ "GenSigStartValue" SG_ 198 VFC_Obj11A_Vx 1540;
BA_ "GenSigSendType" SG_ 198 VFC_Obj11A_Vy 9;
BA_ "GenSigStartValue" SG_ 198 VFC_Obj11A_Vy 500;
BA_ "GenSigSendType" SG_ 198 VFC_Obj11A_Ax 9;
BA_ "GenSigStartValue" SG_ 198 VFC_Obj11A_Ax 160;
BA_ "GenSigSendType" SG_ 198 VFC_Obj11A_Ay 9;
BA_ "GenSigStartValue" SG_ 198 VFC_Obj11A_Ay 120;
BA_ "GenSigSendType" SG_ 198 VFC_Obj11A_DxStdDev 9;
BA_ "GenSigSendType" SG_ 198 VFC_Obj11A_DyStdDev 9;
BA_ "GenSigSendType" SG_ 198 VFC_Obj11A_VxStdDev 9;
BA_ "GenSigSendType" SG_ 198 VFC_Obj11A_VyStdDev 9;
BA_ "GenSigSendType" SG_ 198 VFC_Obj11A_AxStdDev 9;
BA_ "GenSigSendType" SG_ 198 VFC_Obj11A_AyStdDev 9;
BA_ "GenSigSendType" SG_ 198 VFC_Obj11A_Length 9;
BA_ "GenSigSendType" SG_ 198 VFC_Obj11A_Width 9;
BA_ "GenSigSendType" SG_ 198 VFC_Obj11A_Height 9;
BA_ "GenSigSendType" SG_ 198 VFC_Obj11A_LengthStdDev 9;
BA_ "GenSigSendType" SG_ 198 VFC_Obj11A_WidthStdDev 9;
BA_ "GenSigSendType" SG_ 198 VFC_Obj11A_HeightStdDev 9;
BA_ "GenSigSendType" SG_ 198 VFC_Obj11A_EdgeLeft 9;
BA_ "GenSigStartValue" SG_ 198 VFC_Obj11A_EdgeLeft 4000;
BA_ "GenSigSendType" SG_ 198 VFC_Obj11A_EdgeMid 9;
BA_ "GenSigStartValue" SG_ 198 VFC_Obj11A_EdgeMid 4000;
BA_ "GenSigSendType" SG_ 198 VFC_Obj11A_EdgeRight 9;
BA_ "GenSigStartValue" SG_ 198 VFC_Obj11A_EdgeRight 4000;
BA_ "GenSigSendType" SG_ 198 VFC_Obj11A_EdgeTop 9;
BA_ "GenSigStartValue" SG_ 198 VFC_Obj11A_EdgeTop 2000;
BA_ "GenSigSendType" SG_ 198 VFC_Obj11A_EdgeBottom 9;
BA_ "GenSigStartValue" SG_ 198 VFC_Obj11A_EdgeBottom 2000;
BA_ "GenSigSendType" SG_ 198 VFC_Obj11A_EdgeLeftStdDev 9;
BA_ "GenSigSendType" SG_ 198 VFC_Obj11A_EdgeMidStdDev 9;
BA_ "GenSigSendType" SG_ 198 VFC_Obj11A_EdgeRightStdDev 9;
BA_ "GenSigSendType" SG_ 198 VFC_Obj11A_EdgeTopStdDev 9;
BA_ "GenSigSendType" SG_ 198 VFC_Obj11A_EdgeBottomStdDev 9;
BA_ "GenSigSendType" SG_ 198 VFC_Obj11A_NormVx 9;
BA_ "GenSigStartValue" SG_ 198 VFC_Obj11A_NormVx 40000;
BA_ "GenSigSendType" SG_ 198 VFC_Obj11A_NormAx 9;
BA_ "GenSigStartValue" SG_ 198 VFC_Obj11A_NormAx 5000;
BA_ "GenSigSendType" SG_ 198 VFC_Obj11A_NormVyEdgeLeft 9;
BA_ "GenSigStartValue" SG_ 198 VFC_Obj11A_NormVyEdgeLeft 4000;
BA_ "GenSigSendType" SG_ 198 VFC_Obj11A_NormVyEdgeRight 9;
BA_ "GenSigStartValue" SG_ 198 VFC_Obj11A_NormVyEdgeRight 4000;
BA_ "GenSigSendType" SG_ 198 VFC_Obj11A_NormVxStdDev 9;
BA_ "GenSigSendType" SG_ 198 VFC_Obj11A_NormAxStdDev 9;
BA_ "GenSigSendType" SG_ 198 VFC_Obj11A_NormVyEdgeLeftStdDev 9;
BA_ "GenSigSendType" SG_ 198 VFC_Obj11A_NormVyEdgeRightStdDev 9;
BA_ "GenSigSendType" SG_ 198 VFC_Obj11A_ScaleChange 9;
BA_ "GenSigSendType" SG_ 198 VFC_Obj11A_ScaleChngStdDev 9;
BA_ "GenSigSendType" SG_ 198 VFC_Obj11A_HeadingAngle 9;
BA_ "GenSigStartValue" SG_ 198 VFC_Obj11A_HeadingAngle 157;
BA_ "GenSigSendType" SG_ 198 VFC_Obj11A_HeadingAngleStdDev 9;
BA_ "GenSigSendType" SG_ 198 VFC_Obj11A_HeadOrientation 9;
BA_ "GenSigSendType" SG_ 198 VFC_Obj11A_CompletelyInImg 9;
BA_ "GenSigSendType" SG_ 198 VFC_Obj11A_ProbMovingLat 9;
BA_ "GenSigSendType" SG_ 198 VFC_Obj11A_ProbMovingLong 9;
BA_ "GenSigSendType" SG_ 198 VFC_Obj11A_ProbExist 9;
BA_ "GenSigSendType" SG_ 198 VFC_Obj11A_MeasSource 9;
BA_ "GenSigSendType" SG_ 198 VFC_Obj11A_Reliability 9;
BA_ "GenSigSendType" SG_ 198 VFC_Obj11A_Measured 9;
BA_ "GenSigSendType" SG_ 198 VFC_Obj11A_VisibleView 9;
BA_ "GenSigSendType" SG_ 198 VFC_Obj11A_ClassifiedView 9;
BA_ "GenSigSendType" SG_ 198 VFC_Obj11A_DirIndicator 9;
BA_ "GenSigSendType" SG_ 198 VFC_Obj11A_BrakeLight 9;
VAL_ 160 VFC_ObjHdr_State 0 "off" 1 "on" 2 "Reduced" 3 "HW_Error" 4 "SW_Error" 5 "FID_Active" 6 "Reserved6" 7 "Reserved7" ;
VAL_ 176 VFC_Obj00A_ID 0 "INVALID" ;
VAL_ 176 VFC_Obj00A_Type 0 "NOTYPE" 1 "CAR" 2 "TRUCK" 3 "MOTORCYCLIST" 4 "PEDESTRIAN" 5 "CYCLIST" ;
VAL_ 176 VFC_Obj00A_HeadOrientation 0 "N/A" 1 "Head front" 2 "Head left front" 3 "Head left" 4 "Head left back" 5 "Head back" 6 "Head right back" 7 "Head right" 8 "Head right front" 9 "Reserved09" 10 "Reserved10" 11 "Reserved11" 12 "Reserved12" 13 "Reserved13" 14 "Reserved14" 15 "Unknown" ;
VAL_ 176 VFC_Obj00A_CompletelyInImg 0 "not completely measured" 1 "completely measured" ;
VAL_ 176 VFC_Obj00A_Measured 0 "Invalid" 1 "Measured" 2 "Predicted" 3 "Reserved3" ;
VAL_ 176 VFC_Obj00A_VisibleView 0 "UNKNOWN" 1 "CLASSIC" 2 "SIDE" 3 "CLASSIC_SIDE" 4 "SIDE_CLASSIC" ;
VAL_ 176 VFC_Obj00A_ClassifiedView 0 "Unknown" 1 "Front" 2 "Rear" 3 "Left" 4 "Right" ;
VAL_ 176 VFC_Obj00A_DirIndicator 0 "Unknown" 1 "No direction indicator" 2 "Left indicator" 3 "Right indicator" 4 "Warning Lights" ;
VAL_ 176 VFC_Obj00A_BrakeLight 0 "Unknown" 1 "No light detected" 2 "One light detected" 3 "Two lights detected" 4 "Three lights detected" 5 "Reserved5" 6 "Reserved6" 7 "Reserved7" ;
VAL_ 178 VFC_Obj01A_ID 0 "INVALID" ;
VAL_ 178 VFC_Obj01A_Type 0 "NOTYPE" 1 "CAR" 2 "TRUCK" 3 "MOTORCYCLIST" 4 "PEDESTRIAN" 5 "CYCLIST" ;
VAL_ 178 VFC_Obj01A_HeadOrientation 0 "N/A" 1 "Head front" 2 "Head left front" 3 "Head left" 4 "Head left back" 5 "Head back" 6 "Head right back" 7 "Head right" 8 "Head right front" 9 "Reserved09" 10 "Reserved10" 11 "Reserved11" 12 "Reserved12" 13 "Reserved13" 14 "Reserved14" 15 "Unknown" ;
VAL_ 178 VFC_Obj01A_CompletelyInImg 0 "not completely measured" 1 "completely measured" ;
VAL_ 178 VFC_Obj01A_Measured 0 "Invalid" 1 "Measured" 2 "Predicted" 3 "Reserved3" ;
VAL_ 178 VFC_Obj01A_VisibleView 0 "UNKNOWN" 1 "CLASSIC" 2 "SIDE" 3 "CLASSIC_SIDE" 4 "SIDE_CLASSIC" ;
VAL_ 178 VFC_Obj01A_ClassifiedView 0 "Unknown" 1 "Front" 2 "Rear" 3 "Left" 4 "Right" ;
VAL_ 178 VFC_Obj01A_DirIndicator 0 "Unknown" 1 "No direction indicator" 2 "Left indicator" 3 "Right indicator" 4 "Warning Lights" ;
VAL_ 178 VFC_Obj01A_BrakeLight 0 "Unknown" 1 "No light detected" 2 "One light detected" 3 "Two lights detected" 4 "Three lights detected" 5 "Reserved5" 6 "Reserved6" 7 "Reserved7" ;
VAL_ 180 VFC_Obj02A_ID 0 "INVALID" ;
VAL_ 180 VFC_Obj02A_Type 0 "NOTYPE" 1 "CAR" 2 "TRUCK" 3 "MOTORCYCLIST" 4 "PEDESTRIAN" 5 "CYCLIST" ;
VAL_ 180 VFC_Obj02A_HeadOrientation 0 "N/A" 1 "Head front" 2 "Head left front" 3 "Head left" 4 "Head left back" 5 "Head back" 6 "Head right back" 7 "Head right" 8 "Head right front" 9 "Reserved09" 10 "Reserved10" 11 "Reserved11" 12 "Reserved12" 13 "Reserved13" 14 "Reserved14" 15 "Unknown" ;
VAL_ 180 VFC_Obj02A_CompletelyInImg 0 "not completely measured" 1 "completely measured" ;
VAL_ 180 VFC_Obj02A_Measured 0 "Invalid" 1 "Measured" 2 "Predicted" 3 "Reserved3" ;
VAL_ 180 VFC_Obj02A_VisibleView 0 "UNKNOWN" 1 "CLASSIC" 2 "SIDE" 3 "CLASSIC_SIDE" 4 "SIDE_CLASSIC" ;
VAL_ 180 VFC_Obj02A_ClassifiedView 0 "Unknown" 1 "Front" 2 "Rear" 3 "Left" 4 "Right" ;
VAL_ 180 VFC_Obj02A_DirIndicator 0 "Unknown" 1 "No direction indicator" 2 "Left indicator" 3 "Right indicator" 4 "Warning Lights" ;
VAL_ 180 VFC_Obj02A_BrakeLight 0 "Unknown" 1 "No light detected" 2 "One light detected" 3 "Two lights detected" 4 "Three lights detected" 5 "Reserved5" 6 "Reserved6" 7 "Reserved7" ;
VAL_ 182 VFC_Obj03A_ID 0 "INVALID" ;
VAL_ 182 VFC_Obj03A_Type 0 "NOTYPE" 1 "CAR" 2 "TRUCK" 3 "MOTORCYCLIST" 4 "PEDESTRIAN" 5 "CYCLIST" ;
VAL_ 182 VFC_Obj03A_HeadOrientation 0 "N/A" 1 "Head front" 2 "Head left front" 3 "Head left" 4 "Head left back" 5 "Head back" 6 "Head right back" 7 "Head right" 8 "Head right front" 9 "Reserved09" 10 "Reserved10" 11 "Reserved11" 12 "Reserved12" 13 "Reserved13" 14 "Reserved14" 15 "Unknown" ;
VAL_ 182 VFC_Obj03A_CompletelyInImg 0 "not completely measured" 1 "completely measured" ;
VAL_ 182 VFC_Obj03A_Measured 0 "Invalid" 1 "Measured" 2 "Predicted" 3 "Reserved3" ;
VAL_ 182 VFC_Obj03A_VisibleView 0 "UNKNOWN" 1 "CLASSIC" 2 "SIDE" 3 "CLASSIC_SIDE" 4 "SIDE_CLASSIC" ;
VAL_ 182 VFC_Obj03A_ClassifiedView 0 "Unknown" 1 "Front" 2 "Rear" 3 "Left" 4 "Right" ;
VAL_ 182 VFC_Obj03A_DirIndicator 0 "Unknown" 1 "No direction indicator" 2 "Left indicator" 3 "Right indicator" 4 "Warning Lights" ;
VAL_ 182 VFC_Obj03A_BrakeLight 0 "Unknown" 1 "No light detected" 2 "One light detected" 3 "Two lights detected" 4 "Three lights detected" 5 "Reserved5" 6 "Reserved6" 7 "Reserved7" ;
VAL_ 184 VFC_Obj04A_ID 0 "INVALID" ;
VAL_ 184 VFC_Obj04A_Type 0 "NOTYPE" 1 "CAR" 2 "TRUCK" 3 "MOTORCYCLIST" 4 "PEDESTRIAN" 5 "CYCLIST" ;
VAL_ 184 VFC_Obj04A_HeadOrientation 0 "N/A" 1 "Head front" 2 "Head left front" 3 "Head left" 4 "Head left back" 5 "Head back" 6 "Head right back" 7 "Head right" 8 "Head right front" 9 "Reserved09" 10 "Reserved10" 11 "Reserved11" 12 "Reserved12" 13 "Reserved13" 14 "Reserved14" 15 "Unknown" ;
VAL_ 184 VFC_Obj04A_CompletelyInImg 0 "not completely measured" 1 "completely measured" ;
VAL_ 184 VFC_Obj04A_Measured 0 "Invalid" 1 "Measured" 2 "Predicted" 3 "Reserved3" ;
VAL_ 184 VFC_Obj04A_VisibleView 0 "UNKNOWN" 1 "CLASSIC" 2 "SIDE" 3 "CLASSIC_SIDE" 4 "SIDE_CLASSIC" ;
VAL_ 184 VFC_Obj04A_ClassifiedView 0 "Unknown" 1 "Front" 2 "Rear" 3 "Left" 4 "Right" ;
VAL_ 184 VFC_Obj04A_DirIndicator 0 "Unknown" 1 "No direction indicator" 2 "Left indicator" 3 "Right indicator" 4 "Warning Lights" ;
VAL_ 184 VFC_Obj04A_BrakeLight 0 "Unknown" 1 "No light detected" 2 "One light detected" 3 "Two lights detected" 4 "Three lights detected" 5 "Reserved5" 6 "Reserved6" 7 "Reserved7" ;
VAL_ 186 VFC_Obj05A_ID 0 "INVALID" ;
VAL_ 186 VFC_Obj05A_Type 0 "NOTYPE" 1 "CAR" 2 "TRUCK" 3 "MOTORCYCLIST" 4 "PEDESTRIAN" 5 "CYCLIST" ;
VAL_ 186 VFC_Obj05A_HeadOrientation 0 "N/A" 1 "Head front" 2 "Head left front" 3 "Head left" 4 "Head left back" 5 "Head back" 6 "Head right back" 7 "Head right" 8 "Head right front" 9 "Reserved09" 10 "Reserved10" 11 "Reserved11" 12 "Reserved12" 13 "Reserved13" 14 "Reserved14" 15 "Unknown" ;
VAL_ 186 VFC_Obj05A_CompletelyInImg 0 "not completely measured" 1 "completely measured" ;
VAL_ 186 VFC_Obj05A_Measured 0 "Invalid" 1 "Measured" 2 "Predicted" 3 "Reserved3" ;
VAL_ 186 VFC_Obj05A_VisibleView 0 "UNKNOWN" 1 "CLASSIC" 2 "SIDE" 3 "CLASSIC_SIDE" 4 "SIDE_CLASSIC" ;
VAL_ 186 VFC_Obj05A_ClassifiedView 0 "Unknown" 1 "Front" 2 "Rear" 3 "Left" 4 "Right" ;
VAL_ 186 VFC_Obj05A_DirIndicator 0 "Unknown" 1 "No direction indicator" 2 "Left indicator" 3 "Right indicator" 4 "Warning Lights" ;
VAL_ 186 VFC_Obj05A_BrakeLight 0 "Unknown" 1 "No light detected" 2 "One light detected" 3 "Two lights detected" 4 "Three lights detected" 5 "Reserved5" 6 "Reserved6" 7 "Reserved7" ;
VAL_ 188 VFC_Obj06A_ID 0 "INVALID" ;
VAL_ 188 VFC_Obj06A_Type 0 "NOTYPE" 1 "CAR" 2 "TRUCK" 3 "MOTORCYCLIST" 4 "PEDESTRIAN" 5 "CYCLIST" ;
VAL_ 188 VFC_Obj06A_HeadOrientation 0 "N/A" 1 "Head front" 2 "Head left front" 3 "Head left" 4 "Head left back" 5 "Head back" 6 "Head right back" 7 "Head right" 8 "Head right front" 9 "Reserved09" 10 "Reserved10" 11 "Reserved11" 12 "Reserved12" 13 "Reserved13" 14 "Reserved14" 15 "Unknown" ;
VAL_ 188 VFC_Obj06A_CompletelyInImg 0 "not completely measured" 1 "completely measured" ;
VAL_ 188 VFC_Obj06A_Measured 0 "Invalid" 1 "Measured" 2 "Predicted" 3 "Reserved3" ;
VAL_ 188 VFC_Obj06A_VisibleView 0 "UNKNOWN" 1 "CLASSIC" 2 "SIDE" 3 "CLASSIC_SIDE" 4 "SIDE_CLASSIC" ;
VAL_ 188 VFC_Obj06A_ClassifiedView 0 "Unknown" 1 "Front" 2 "Rear" 3 "Left" 4 "Right" ;
VAL_ 188 VFC_Obj06A_DirIndicator 0 "Unknown" 1 "No direction indicator" 2 "Left indicator" 3 "Right indicator" 4 "Warning Lights" ;
VAL_ 188 VFC_Obj06A_BrakeLight 0 "Unknown" 1 "No light detected" 2 "One light detected" 3 "Two lights detected" 4 "Three lights detected" 5 "Reserved5" 6 "Reserved6" 7 "Reserved7" ;
VAL_ 190 VFC_Obj07A_ID 0 "INVALID" ;
VAL_ 190 VFC_Obj07A_Type 0 "NOTYPE" 1 "CAR" 2 "TRUCK" 3 "MOTORCYCLIST" 4 "PEDESTRIAN" 5 "CYCLIST" ;
VAL_ 190 VFC_Obj07A_HeadOrientation 0 "N/A" 1 "Head front" 2 "Head left front" 3 "Head left" 4 "Head left back" 5 "Head back" 6 "Head right back" 7 "Head right" 8 "Head right front" 9 "Reserved09" 10 "Reserved10" 11 "Reserved11" 12 "Reserved12" 13 "Reserved13" 14 "Reserved14" 15 "Unknown" ;
VAL_ 190 VFC_Obj07A_CompletelyInImg 0 "not completely measured" 1 "completely measured" ;
VAL_ 190 VFC_Obj07A_Measured 0 "Invalid" 1 "Measured" 2 "Predicted" 3 "Reserved3" ;
VAL_ 190 VFC_Obj07A_VisibleView 0 "UNKNOWN" 1 "CLASSIC" 2 "SIDE" 3 "CLASSIC_SIDE" 4 "SIDE_CLASSIC" ;
VAL_ 190 VFC_Obj07A_ClassifiedView 0 "Unknown" 1 "Front" 2 "Rear" 3 "Left" 4 "Right" ;
VAL_ 190 VFC_Obj07A_DirIndicator 0 "Unknown" 1 "No direction indicator" 2 "Left indicator" 3 "Right indicator" 4 "Warning Lights" ;
VAL_ 190 VFC_Obj07A_BrakeLight 0 "Unknown" 1 "No light detected" 2 "One light detected" 3 "Two lights detected" 4 "Three lights detected" 5 "Reserved5" 6 "Reserved6" 7 "Reserved7" ;
VAL_ 192 VFC_Obj08A_ID 0 "INVALID" ;
VAL_ 192 VFC_Obj08A_Type 0 "NOTYPE" 1 "CAR" 2 "TRUCK" 3 "MOTORCYCLIST" 4 "PEDESTRIAN" 5 "CYCLIST" ;
VAL_ 192 VFC_Obj08A_HeadOrientation 0 "N/A" 1 "Head front" 2 "Head left front" 3 "Head left" 4 "Head left back" 5 "Head back" 6 "Head right back" 7 "Head right" 8 "Head right front" 9 "Reserved09" 10 "Reserved10" 11 "Reserved11" 12 "Reserved12" 13 "Reserved13" 14 "Reserved14" 15 "Unknown" ;
VAL_ 192 VFC_Obj08A_CompletelyInImg 0 "not completely measured" 1 "completely measured" ;
VAL_ 192 VFC_Obj08A_Measured 0 "Invalid" 1 "Measured" 2 "Predicted" 3 "Reserved3" ;
VAL_ 192 VFC_Obj08A_VisibleView 0 "UNKNOWN" 1 "CLASSIC" 2 "SIDE" 3 "CLASSIC_SIDE" 4 "SIDE_CLASSIC" ;
VAL_ 192 VFC_Obj08A_ClassifiedView 0 "Unknown" 1 "Front" 2 "Rear" 3 "Left" 4 "Right" ;
VAL_ 192 VFC_Obj08A_DirIndicator 0 "Unknown" 1 "No direction indicator" 2 "Left indicator" 3 "Right indicator" 4 "Warning Lights" ;
VAL_ 192 VFC_Obj08A_BrakeLight 0 "Unknown" 1 "No light detected" 2 "One light detected" 3 "Two lights detected" 4 "Three lights detected" 5 "Reserved5" 6 "Reserved6" 7 "Reserved7" ;
VAL_ 194 VFC_Obj09A_ID 0 "INVALID" ;
VAL_ 194 VFC_Obj09A_Type 0 "NOTYPE" 1 "CAR" 2 "TRUCK" 3 "MOTORCYCLIST" 4 "PEDESTRIAN" 5 "CYCLIST" ;
VAL_ 194 VFC_Obj09A_HeadOrientation 0 "N/A" 1 "Head front" 2 "Head left front" 3 "Head left" 4 "Head left back" 5 "Head back" 6 "Head right back" 7 "Head right" 8 "Head right front" 9 "Reserved09" 10 "Reserved10" 11 "Reserved11" 12 "Reserved12" 13 "Reserved13" 14 "Reserved14" 15 "Unknown" ;
VAL_ 194 VFC_Obj09A_CompletelyInImg 0 "not completely measured" 1 "completely measured" ;
VAL_ 194 VFC_Obj09A_Measured 0 "Invalid" 1 "Measured" 2 "Predicted" 3 "Reserved3" ;
VAL_ 194 VFC_Obj09A_VisibleView 0 "UNKNOWN" 1 "CLASSIC" 2 "SIDE" 3 "CLASSIC_SIDE" 4 "SIDE_CLASSIC" ;
VAL_ 194 VFC_Obj09A_ClassifiedView 0 "Unknown" 1 "Front" 2 "Rear" 3 "Left" 4 "Right" ;
VAL_ 194 VFC_Obj09A_DirIndicator 0 "Unknown" 1 "No direction indicator" 2 "Left indicator" 3 "Right indicator" 4 "Warning Lights" ;
VAL_ 194 VFC_Obj09A_BrakeLight 0 "Unknown" 1 "No light detected" 2 "One light detected" 3 "Two lights detected" 4 "Three lights detected" 5 "Reserved5" 6 "Reserved6" 7 "Reserved7" ;
VAL_ 196 VFC_Obj10A_ID 0 "INVALID" ;
VAL_ 196 VFC_Obj10A_Type 0 "NOTYPE" 1 "CAR" 2 "TRUCK" 3 "MOTORCYCLIST" 4 "PEDESTRIAN" 5 "CYCLIST" ;
VAL_ 196 VFC_Obj10A_HeadOrientation 0 "N/A" 1 "Head front" 2 "Head left front" 3 "Head left" 4 "Head left back" 5 "Head back" 6 "Head right back" 7 "Head right" 8 "Head right front" 9 "Reserved09" 10 "Reserved10" 11 "Reserved11" 12 "Reserved12" 13 "Reserved13" 14 "Reserved14" 15 "Unknown" ;
VAL_ 196 VFC_Obj10A_CompletelyInImg 0 "not completely measured" 1 "completely measured" ;
VAL_ 196 VFC_Obj10A_Measured 0 "Invalid" 1 "Measured" 2 "Predicted" 3 "Reserved3" ;
VAL_ 196 VFC_Obj10A_VisibleView 0 "UNKNOWN" 1 "CLASSIC" 2 "SIDE" 3 "CLASSIC_SIDE" 4 "SIDE_CLASSIC" ;
VAL_ 196 VFC_Obj10A_ClassifiedView 0 "Unknown" 1 "Front" 2 "Rear" 3 "Left" 4 "Right" ;
VAL_ 196 VFC_Obj10A_DirIndicator 0 "Unknown" 1 "No direction indicator" 2 "Left indicator" 3 "Right indicator" 4 "Warning Lights" ;
VAL_ 196 VFC_Obj10A_BrakeLight 0 "Unknown" 1 "No light detected" 2 "One light detected" 3 "Two lights detected" 4 "Three lights detected" 5 "Reserved5" 6 "Reserved6" 7 "Reserved7" ;
VAL_ 198 VFC_Obj11A_ID 0 "INVALID" ;
VAL_ 198 VFC_Obj11A_Type 0 "NOTYPE" 1 "CAR" 2 "TRUCK" 3 "MOTORCYCLIST" 4 "PEDESTRIAN" 5 "CYCLIST" ;
VAL_ 198 VFC_Obj11A_HeadOrientation 0 "N/A" 1 "Head front" 2 "Head left front" 3 "Head left" 4 "Head left back" 5 "Head back" 6 "Head right back" 7 "Head right" 8 "Head right front" 9 "Reserved09" 10 "Reserved10" 11 "Reserved11" 12 "Reserved12" 13 "Reserved13" 14 "Reserved14" 15 "Unknown" ;
VAL_ 198 VFC_Obj11A_CompletelyInImg 0 "not completely measured" 1 "completely measured" ;
VAL_ 198 VFC_Obj11A_Measured 0 "Invalid" 1 "Measured" 2 "Predicted" 3 "Reserved3" ;
VAL_ 198 VFC_Obj11A_VisibleView 0 "UNKNOWN" 1 "CLASSIC" 2 "SIDE" 3 "CLASSIC_SIDE" 4 "SIDE_CLASSIC" ;
VAL_ 198 VFC_Obj11A_ClassifiedView 0 "Unknown" 1 "Front" 2 "Rear" 3 "Left" 4 "Right" ;
VAL_ 198 VFC_Obj11A_DirIndicator 0 "Unknown" 1 "No direction indicator" 2 "Left indicator" 3 "Right indicator" 4 "Warning Lights" ;
VAL_ 198 VFC_Obj11A_BrakeLight 0 "Unknown" 1 "No light detected" 2 "One light detected" 3 "Two lights detected" 4 "Three lights detected" 5 "Reserved5" 6 "Reserved6" 7 "Reserved7" ;
