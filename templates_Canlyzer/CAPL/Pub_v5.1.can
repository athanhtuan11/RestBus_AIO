/*@!Encoding:1252*/
includes
{

}

variables
{

	//-----------------GEN: Define MSG Start----------------------

	message can1.ABS_ESP_1	ABS_ESP_1 = {DIR = TX};
	message can1.ABS_ESP_3	ABS_ESP_3 = {DIR = TX};
	message can1.ABS_ESP_4	ABS_ESP_4 = {DIR = TX};
	message can1.ABS_ESP_7	ABS_ESP_7 = {DIR = TX};
	message can1.ABS_ESP_8	ABS_ESP_8 = {DIR = TX};
	message can1.ABS_ESP_G	ABS_ESP_G = {DIR = TX};
	message can1.BCM_1	BCM_1 = {DIR = TX};
	message can1.BCM_9	BCM_9 = {DIR = TX};
	message can1.CLM_2	CLM_2 = {DIR = TX};
	message can1.DMS_1	DMS_1 = {DIR = TX};
	message can1.EMS_1	EMS_1 = {DIR = TX};
	message can1.EMS_2	EMS_2 = {DIR = TX};
	message can1.EMS_2_G	EMS_2_G = {DIR = TX};
	message can1.EMS_3	EMS_3 = {DIR = TX};
	message can1.EMS_6	EMS_6 = {DIR = TX};
	message can1.EPB_G	EPB_G = {DIR = TX};
	message can1.EPS_1	EPS_1 = {DIR = TX};
	message can1.EPS_2	EPS_2 = {DIR = TX};
	message can1.EPS_3	EPS_3 = {DIR = TX};
	message can1.EPS_4	EPS_4 = {DIR = TX};
	message can1.HCU_17	HCU_17 = {DIR = TX};
	message can1.HCU_1_G	HCU_1_G = {DIR = TX};
	message can1.HCU_3_G	HCU_3_G = {DIR = TX};
	message can1.HCU_6	HCU_6 = {DIR = TX};
	message can1.ICM_1	ICM_1 = {DIR = TX};
	message can1.ICM_2	ICM_2 = {DIR = TX};
	message can1.ICM_3	ICM_3 = {DIR = TX};
	message can1.ICM_5	ICM_5 = {DIR = TX};
	message can1.IHU_10	IHU_10 = {DIR = TX};
	message can1.IHU_11	IHU_11 = {DIR = TX};
	message can1.IHU_29	IHU_29 = {DIR = TX};
	message can1.IHU_30	IHU_30 = {DIR = TX};
	message can1.IHU_31	IHU_31 = {DIR = TX};
	message can1.IPB_11	IPB_11 = {DIR = TX};
	message can1.MFS_2	MFS_2 = {DIR = TX};
	message can1.RLCR_1	RLCR_1 = {DIR = TX};
	message can1.RLCR_3	RLCR_3 = {DIR = TX};
	message can1.RLCR_4	RLCR_4 = {DIR = TX};
	message can1.RLCR_5	RLCR_5 = {DIR = TX};
	message can1.RLCR_6	RLCR_6 = {DIR = TX};
	message can1.RLCR_7	RLCR_7 = {DIR = TX};
	message can1.RLCR_8	RLCR_8 = {DIR = TX};
	message can1.RLCR_9	RLCR_9 = {DIR = TX};
	message can1.RRCR_1	RRCR_1 = {DIR = TX};
	message can1.RRCR_2	RRCR_2 = {DIR = TX};
	message can1.RRCR_3	RRCR_3 = {DIR = TX};
	message can1.RRCR_4	RRCR_4 = {DIR = TX};
	message can1.RRCR_5	RRCR_5 = {DIR = TX};
	message can1.RRCR_6	RRCR_6 = {DIR = TX};
	message can1.RRCR_7	RRCR_7 = {DIR = TX};
	message can1.RRCR_8	RRCR_8 = {DIR = TX};
	message can1.SAM_1_G	SAM_1_G = {DIR = TX};
	message can1.TCU_2	TCU_2 = {DIR = TX};
	message can1.TCU_4	TCU_4 = {DIR = TX};
	message can1.VCU_2	VCU_2 = {DIR = TX};
	message can1.VCU_6	VCU_6 = {DIR = TX};
	message can1.YAS_1	YAS_1 = {DIR = TX};
	message can1.YAS_2	YAS_2 = {DIR = TX};
	message can1.Z_EPB_State_R	Z_EPB_State_R = {DIR = TX};
	message can1.Z_FCM_FRM_6	Z_FCM_FRM_6 = {DIR = TX};

	//-----------------GEN: Define MSG End------------------------


	//----------------GEN: MSG ID End-------------------

	// Generate MSG TX CONFIG
	enum MSG_CONFIG_TX_ENUM {
	/* 0 */ MSG_CONFIG_TX_ENUM_START = 0,
	/* 1 */	MSG_CONFIG_TX_ABS_ESP_1,
	/* 2 */	MSG_CONFIG_TX_ABS_ESP_3,
	/* 3 */	MSG_CONFIG_TX_ABS_ESP_4,
	/* 4 */	MSG_CONFIG_TX_ABS_ESP_7,
	/* 5 */	MSG_CONFIG_TX_ABS_ESP_8,
	/* 6 */	MSG_CONFIG_TX_ABS_ESP_G,
	/* 7 */	MSG_CONFIG_TX_BCM_1,
	/* 8 */	MSG_CONFIG_TX_BCM_9,
	/* 9 */	MSG_CONFIG_TX_CLM_2,
	/* 10 */	MSG_CONFIG_TX_DMS_1,
	/* 11 */	MSG_CONFIG_TX_EMS_1,
	/* 12 */	MSG_CONFIG_TX_EMS_2,
	/* 13 */	MSG_CONFIG_TX_EMS_2_G,
	/* 14 */	MSG_CONFIG_TX_EMS_3,
	/* 15 */	MSG_CONFIG_TX_EMS_6,
	/* 16 */	MSG_CONFIG_TX_EPB_G,
	/* 17 */	MSG_CONFIG_TX_EPS_1,
	/* 18 */	MSG_CONFIG_TX_EPS_2,
	/* 19 */	MSG_CONFIG_TX_EPS_3,
	/* 20 */	MSG_CONFIG_TX_EPS_4,
	/* 21 */	MSG_CONFIG_TX_HCU_17,
	/* 22 */	MSG_CONFIG_TX_HCU_1_G,
	/* 23 */	MSG_CONFIG_TX_HCU_3_G,
	/* 24 */	MSG_CONFIG_TX_HCU_6,
	/* 25 */	MSG_CONFIG_TX_ICM_1,
	/* 26 */	MSG_CONFIG_TX_ICM_2,
	/* 27 */	MSG_CONFIG_TX_ICM_3,
	/* 28 */	MSG_CONFIG_TX_ICM_5,
	/* 29 */	MSG_CONFIG_TX_IHU_10,
	/* 30 */	MSG_CONFIG_TX_IHU_11,
	/* 31 */	MSG_CONFIG_TX_IHU_29,
	/* 32 */	MSG_CONFIG_TX_IHU_30,
	/* 33 */	MSG_CONFIG_TX_IHU_31,
	/* 34 */	MSG_CONFIG_TX_IPB_11,
	/* 35 */	MSG_CONFIG_TX_MFS_2,
	/* 36 */	MSG_CONFIG_TX_RLCR_1,
	/* 37 */	MSG_CONFIG_TX_RLCR_3,
	/* 38 */	MSG_CONFIG_TX_RLCR_4,
	/* 39 */	MSG_CONFIG_TX_RLCR_5,
	/* 40 */	MSG_CONFIG_TX_RLCR_6,
	/* 41 */	MSG_CONFIG_TX_RLCR_7,
	/* 42 */	MSG_CONFIG_TX_RLCR_8,
	/* 43 */	MSG_CONFIG_TX_RLCR_9,
	/* 44 */	MSG_CONFIG_TX_RRCR_1,
	/* 45 */	MSG_CONFIG_TX_RRCR_2,
	/* 46 */	MSG_CONFIG_TX_RRCR_3,
	/* 47 */	MSG_CONFIG_TX_RRCR_4,
	/* 48 */	MSG_CONFIG_TX_RRCR_5,
	/* 49 */	MSG_CONFIG_TX_RRCR_6,
	/* 50 */	MSG_CONFIG_TX_RRCR_7,
	/* 51 */	MSG_CONFIG_TX_RRCR_8,
	/* 52 */	MSG_CONFIG_TX_SAM_1_G,
	/* 53 */	MSG_CONFIG_TX_TCU_2,
	/* 54 */	MSG_CONFIG_TX_TCU_4,
	/* 55 */	MSG_CONFIG_TX_VCU_2,
	/* 56 */	MSG_CONFIG_TX_VCU_6,
	/* 57 */	MSG_CONFIG_TX_YAS_1,
	/* 58 */	MSG_CONFIG_TX_YAS_2,
	/* 59 */	MSG_CONFIG_TX_Z_EPB_State_R,
	/* 60 */	MSG_CONFIG_TX_Z_FCM_FRM_6,
	/* 61 */	MSG_CONFIG_TX_ENUM_TX_END 
	};

	//----------------GEN: MSG ID End-------------------


	//----------------GEN: Define Timer Start-------------------

	msTimer PROJ_SendMSGTimer_10ms;
	msTimer PROJ_SendMSGTimer_20ms;
	msTimer PROJ_SendMSGTimer_50ms;
	msTimer PROJ_SendMSGTimer_100ms;
	msTimer PROJ_SendMSGTimer_500ms;

	//----------------GEN: Define Timer End-------------------


	//----------------GEN: E2E CFG Start-------------------



	const MSG_E2E_CFG_NULL=0;
	const E2E_NONE = 0;
	const E2E_CRC8 = 1;
	const E2E_XOR = 2;
	const E2E_CRC8_MULT = 3;



	struct CAN_MSG_E2E_TX_ST
	{
		byte PROJ_E2E_TYPE;
		 byte PROJ_E2E_CFG;
	};


	struct CAN_MSG_E2E_TX_ST PROJ_MSG_E2E_TX_ARR[MSG_CONFIG_TX_ENUM_TX_END +1] =
	{
	/* 0  MSG_CONFIG_TX_ENUM_START*/    {E2E_NONE,   MSG_E2E_CFG_NULL  },
	/* 1  MSG_CONFIG_TX_ABS_ESP_1 */    {E2E_XOR,   MSG_E2E_CFG_NULL  },
	/* 2  MSG_CONFIG_TX_ABS_ESP_3 */    {E2E_XOR,   MSG_E2E_CFG_NULL  },
	/* 3  MSG_CONFIG_TX_ABS_ESP_4 */    {E2E_XOR,   MSG_E2E_CFG_NULL  },
	/* 4  MSG_CONFIG_TX_ABS_ESP_7 */    {E2E_XOR,   MSG_E2E_CFG_NULL  },
	/* 5  MSG_CONFIG_TX_ABS_ESP_8 */    {E2E_XOR,   MSG_E2E_CFG_NULL  },
	/* 6  MSG_CONFIG_TX_ABS_ESP_G */    {E2E_NONE,   MSG_E2E_CFG_NULL  },
	/* 7  MSG_CONFIG_TX_BCM_1 */    {E2E_XOR,   MSG_E2E_CFG_NULL  },
	/* 8  MSG_CONFIG_TX_BCM_9 */    {E2E_NONE,   MSG_E2E_CFG_NULL  },
	/* 9  MSG_CONFIG_TX_CLM_2 */    {E2E_CRC8,   MSG_E2E_CFG_NULL  },
	/* 10  MSG_CONFIG_TX_DMS_1 */    {E2E_CRC8,   MSG_E2E_CFG_NULL  },
	/* 11  MSG_CONFIG_TX_EMS_1 */    {E2E_XOR,   MSG_E2E_CFG_NULL  },
	/* 12  MSG_CONFIG_TX_EMS_2 */    {E2E_NONE,   MSG_E2E_CFG_NULL  },
	/* 13  MSG_CONFIG_TX_EMS_2_G */    {E2E_CRC8,   MSG_E2E_CFG_NULL  },
	/* 14  MSG_CONFIG_TX_EMS_3 */    {E2E_XOR,   MSG_E2E_CFG_NULL  },
	/* 15  MSG_CONFIG_TX_EMS_6 */    {E2E_CRC8,   MSG_E2E_CFG_NULL  },
	/* 16  MSG_CONFIG_TX_EPB_G */    {E2E_NONE,   MSG_E2E_CFG_NULL  },
	/* 17  MSG_CONFIG_TX_EPS_1 */    {E2E_NONE,   MSG_E2E_CFG_NULL  },
	/* 18  MSG_CONFIG_TX_EPS_2 */    {E2E_CRC8,   MSG_E2E_CFG_NULL  },
	/* 19  MSG_CONFIG_TX_EPS_3 */    {E2E_CRC8,   MSG_E2E_CFG_NULL  },
	/* 20  MSG_CONFIG_TX_EPS_4 */    {E2E_CRC8,   MSG_E2E_CFG_NULL  },
	/* 21  MSG_CONFIG_TX_HCU_17 */    {E2E_CRC8,   MSG_E2E_CFG_NULL  },
	/* 22  MSG_CONFIG_TX_HCU_1_G */    {E2E_NONE,   MSG_E2E_CFG_NULL  },
	/* 23  MSG_CONFIG_TX_HCU_3_G */    {E2E_NONE,   MSG_E2E_CFG_NULL  },
	/* 24  MSG_CONFIG_TX_HCU_6 */    {E2E_CRC8,   MSG_E2E_CFG_NULL  },
	/* 25  MSG_CONFIG_TX_ICM_1 */    {E2E_XOR,   MSG_E2E_CFG_NULL  },
	/* 26  MSG_CONFIG_TX_ICM_2 */    {E2E_NONE,   MSG_E2E_CFG_NULL  },
	/* 27  MSG_CONFIG_TX_ICM_3 */    {E2E_NONE,   MSG_E2E_CFG_NULL  },
	/* 28  MSG_CONFIG_TX_ICM_5 */    {E2E_XOR,   MSG_E2E_CFG_NULL  },
	/* 29  MSG_CONFIG_TX_IHU_10 */    {E2E_NONE,   MSG_E2E_CFG_NULL  },
	/* 30  MSG_CONFIG_TX_IHU_11 */    {E2E_NONE,   MSG_E2E_CFG_NULL  },
	/* 31  MSG_CONFIG_TX_IHU_29 */    {E2E_NONE,   MSG_E2E_CFG_NULL  },
	/* 32  MSG_CONFIG_TX_IHU_30 */    {E2E_NONE,   MSG_E2E_CFG_NULL  },
	/* 33  MSG_CONFIG_TX_IHU_31 */    {E2E_NONE,   MSG_E2E_CFG_NULL  },
	/* 34  MSG_CONFIG_TX_IPB_11 */    {E2E_CRC8,   MSG_E2E_CFG_NULL  },
	/* 35  MSG_CONFIG_TX_MFS_2 */    {E2E_CRC8,   MSG_E2E_CFG_NULL  },
	/* 36  MSG_CONFIG_TX_RLCR_1 */    {E2E_CRC8,   MSG_E2E_CFG_NULL  },
	/* 37  MSG_CONFIG_TX_RLCR_3 */    {E2E_CRC8,   MSG_E2E_CFG_NULL  },
	/* 38  MSG_CONFIG_TX_RLCR_4 */    {E2E_CRC8,   MSG_E2E_CFG_NULL  },
	/* 39  MSG_CONFIG_TX_RLCR_5 */    {E2E_CRC8,   MSG_E2E_CFG_NULL  },
	/* 40  MSG_CONFIG_TX_RLCR_6 */    {E2E_CRC8,   MSG_E2E_CFG_NULL  },
	/* 41  MSG_CONFIG_TX_RLCR_7 */    {E2E_CRC8,   MSG_E2E_CFG_NULL  },
	/* 42  MSG_CONFIG_TX_RLCR_8 */    {E2E_CRC8,   MSG_E2E_CFG_NULL  },
	/* 43  MSG_CONFIG_TX_RLCR_9 */    {E2E_CRC8,   MSG_E2E_CFG_NULL  },
	/* 44  MSG_CONFIG_TX_RRCR_1 */    {E2E_CRC8,   MSG_E2E_CFG_NULL  },
	/* 45  MSG_CONFIG_TX_RRCR_2 */    {E2E_CRC8,   MSG_E2E_CFG_NULL  },
	/* 46  MSG_CONFIG_TX_RRCR_3 */    {E2E_CRC8,   MSG_E2E_CFG_NULL  },
	/* 47  MSG_CONFIG_TX_RRCR_4 */    {E2E_CRC8,   MSG_E2E_CFG_NULL  },
	/* 48  MSG_CONFIG_TX_RRCR_5 */    {E2E_CRC8,   MSG_E2E_CFG_NULL  },
	/* 49  MSG_CONFIG_TX_RRCR_6 */    {E2E_CRC8,   MSG_E2E_CFG_NULL  },
	/* 50  MSG_CONFIG_TX_RRCR_7 */    {E2E_CRC8,   MSG_E2E_CFG_NULL  },
	/* 51  MSG_CONFIG_TX_RRCR_8 */    {E2E_CRC8,   MSG_E2E_CFG_NULL  },
	/* 52  MSG_CONFIG_TX_SAM_1_G */    {E2E_CRC8,   MSG_E2E_CFG_NULL  },
	/* 53  MSG_CONFIG_TX_TCU_2 */    {E2E_XOR,   MSG_E2E_CFG_NULL  },
	/* 54  MSG_CONFIG_TX_TCU_4 */    {E2E_CRC8,   MSG_E2E_CFG_NULL  },
	/* 55  MSG_CONFIG_TX_VCU_2 */    {E2E_CRC8_MULT,   MSG_E2E_CFG_NULL  },
	/* 56  MSG_CONFIG_TX_VCU_6 */    {E2E_CRC8,   MSG_E2E_CFG_NULL  },
	/* 57  MSG_CONFIG_TX_YAS_1 */    {E2E_XOR,   MSG_E2E_CFG_NULL  },
	/* 58  MSG_CONFIG_TX_YAS_2 */    {E2E_XOR,   MSG_E2E_CFG_NULL  },
	/* 59  MSG_CONFIG_TX_Z_EPB_State_R */    {E2E_CRC8,   MSG_E2E_CFG_NULL  },
	/* 60  MSG_CONFIG_TX_Z_FCM_FRM_6 */    {E2E_CRC8,   MSG_E2E_CFG_NULL  },
	/* 61  MSG_CONFIG_TX_ENUM_TX_END */ {E2E_NONE,   MSG_E2E_CFG_NULL  }
	};

	//----------------GEN: E2E CFG End-------------------
  byte CRC_8_H1D_Tbl[256] =
  {
      /*  0:*/ 0x00, 0x1d, 0x3a, 0x27, 0x74, 0x69, 0x4e, 0x53,
      /*  8:*/ 0xe8, 0xf5, 0xd2, 0xcf, 0x9c, 0x81, 0xa6, 0xbb,
      /* 16:*/ 0xcd, 0xd0, 0xf7, 0xea, 0xb9, 0xa4, 0x83, 0x9e,
      /* 24:*/ 0x25, 0x38, 0x1f, 0x02, 0x51, 0x4c, 0x6b, 0x76,
      /* 32:*/ 0x87, 0x9a, 0xbd, 0xa0, 0xf3, 0xee, 0xc9, 0xd4,
      /* 40:*/ 0x6f, 0x72, 0x55, 0x48, 0x1b, 0x06, 0x21, 0x3c,
      /* 48:*/ 0x4a, 0x57, 0x70, 0x6d, 0x3e, 0x23, 0x04, 0x19,
      /* 56:*/ 0xa2, 0xbf, 0x98, 0x85, 0xd6, 0xcb, 0xec, 0xf1,
      /* 64:*/ 0x13, 0x0e, 0x29, 0x34, 0x67, 0x7a, 0x5d, 0x40,
      /* 72:*/ 0xfb, 0xe6, 0xc1, 0xdc, 0x8f, 0x92, 0xb5, 0xa8,
      /* 80:*/ 0xde, 0xc3, 0xe4, 0xf9, 0xaa, 0xb7, 0x90, 0x8d,
      /* 88:*/ 0x36, 0x2b, 0x0c, 0x11, 0x42, 0x5f, 0x78, 0x65,
      /* 96:*/ 0x94, 0x89, 0xae, 0xb3, 0xe0, 0xfd, 0xda, 0xc7,
      /*104:*/ 0x7c, 0x61, 0x46, 0x5b, 0x08, 0x15, 0x32, 0x2f,
      /*112:*/ 0x59, 0x44, 0x63, 0x7e, 0x2d, 0x30, 0x17, 0x0a,
      /*120:*/ 0xb1, 0xac, 0x8b, 0x96, 0xc5, 0xd8, 0xff, 0xe2,
      /*128:*/ 0x26, 0x3b, 0x1c, 0x01, 0x52, 0x4f, 0x68, 0x75,
      /*136:*/ 0xce, 0xd3, 0xf4, 0xe9, 0xba, 0xa7, 0x80, 0x9d,
      /*144:*/ 0xeb, 0xf6, 0xd1, 0xcc, 0x9f, 0x82, 0xa5, 0xb8,
      /*152:*/ 0x03, 0x1e, 0x39, 0x24, 0x77, 0x6a, 0x4d, 0x50,
      /*160:*/ 0xa1, 0xbc, 0x9b, 0x86, 0xd5, 0xc8, 0xef, 0xf2,
      /*168:*/ 0x49, 0x54, 0x73, 0x6e, 0x3d, 0x20, 0x07, 0x1a,
      /*176:*/ 0x6c, 0x71, 0x56, 0x4b, 0x18, 0x05, 0x22, 0x3f,
      /*184:*/ 0x84, 0x99, 0xbe, 0xa3, 0xf0, 0xed, 0xca, 0xd7,
      /*192:*/ 0x35, 0x28, 0x0f, 0x12, 0x41, 0x5c, 0x7b, 0x66,
      /*200:*/ 0xdd, 0xc0, 0xe7, 0xfa, 0xa9, 0xb4, 0x93, 0x8e,
      /*208:*/ 0xf8, 0xe5, 0xc2, 0xdf, 0x8c, 0x91, 0xb6, 0xab,
      /*216:*/ 0x10, 0x0d, 0x2a, 0x37, 0x64, 0x79, 0x5e, 0x43,
      /*224:*/ 0xb2, 0xaf, 0x88, 0x95, 0xc6, 0xdb, 0xfc, 0xe1,
      /*232:*/ 0x5a, 0x47, 0x60, 0x7d, 0x2e, 0x33, 0x14, 0x09,
      /*240:*/ 0x7f, 0x62, 0x45, 0x58, 0x0b, 0x16, 0x31, 0x2c,
      /*248:*/ 0x97, 0x8a, 0xad, 0xb0, 0xe3, 0xfe, 0xd9, 0xc4
  };
}
// varaiable End


ON Start
{
	PROJ_Init();
	PROJ_Sim_vehicle_Signals_Init();
}

PROJ_Init ()
{

	//----------------GEN: Set Timer Start-------------------
	{
		setTimer (PROJ_SendMSGTimer_10ms,  10);
		setTimer (PROJ_SendMSGTimer_20ms,  10);
		setTimer (PROJ_SendMSGTimer_50ms,  10);
		setTimer (PROJ_SendMSGTimer_100ms,  10);
		setTimer (PROJ_SendMSGTimer_500ms,  10);
	}
	//----------------GEN: Set Timer End-------------------

}

//----------------GEN: On Timer Start-------------------

on timer PROJ_SendMSGTimer_10ms
{
	//reset Timer
	setTimer(PROJ_SendMSGTimer_10ms, 10);

	//Calc and send MSG
	{
		PROJ_CalcMsg_ABS_ESP_1();
		SendMSG_vehicle(MSG_CONFIG_TX_ABS_ESP_1, ABS_ESP_1);

		PROJ_CalcMsg_EMS_1();
		SendMSG_vehicle(MSG_CONFIG_TX_EMS_1, EMS_1);

		PROJ_CalcMsg_EMS_2();
		SendMSG_vehicle(MSG_CONFIG_TX_EMS_2, EMS_2);

		PROJ_CalcMsg_EMS_3();
		SendMSG_vehicle(MSG_CONFIG_TX_EMS_3, EMS_3);

		PROJ_CalcMsg_EMS_6();
		SendMSG_vehicle(MSG_CONFIG_TX_EMS_6, EMS_6);

		PROJ_CalcMsg_EPS_3();
		SendMSG_vehicle(MSG_CONFIG_TX_EPS_3, EPS_3);

		PROJ_CalcMsg_EPS_4();
		SendMSG_vehicle(MSG_CONFIG_TX_EPS_4, EPS_4);

		PROJ_CalcMsg_HCU_17();
		SendMSG_vehicle(MSG_CONFIG_TX_HCU_17, HCU_17);

		PROJ_CalcMsg_HCU_6();
		SendMSG_vehicle(MSG_CONFIG_TX_HCU_6, HCU_6);

		PROJ_CalcMsg_SAM_1_G();
		SendMSG_vehicle(MSG_CONFIG_TX_SAM_1_G, SAM_1_G);

		PROJ_CalcMsg_TCU_2();
		SendMSG_vehicle(MSG_CONFIG_TX_TCU_2, TCU_2);

		PROJ_CalcMsg_TCU_4();
		SendMSG_vehicle(MSG_CONFIG_TX_TCU_4, TCU_4);

		PROJ_CalcMsg_VCU_2();
		SendMSG_vehicle(MSG_CONFIG_TX_VCU_2, VCU_2);

	}
}
on timer PROJ_SendMSGTimer_20ms
{
	//reset Timer
	setTimer(PROJ_SendMSGTimer_20ms, 20);

	//Calc and send MSG
	{
		PROJ_CalcMsg_ABS_ESP_3();
		SendMSG_vehicle(MSG_CONFIG_TX_ABS_ESP_3, ABS_ESP_3);

		PROJ_CalcMsg_ABS_ESP_4();
		SendMSG_vehicle(MSG_CONFIG_TX_ABS_ESP_4, ABS_ESP_4);

		PROJ_CalcMsg_ABS_ESP_7();
		SendMSG_vehicle(MSG_CONFIG_TX_ABS_ESP_7, ABS_ESP_7);

		PROJ_CalcMsg_ABS_ESP_8();
		SendMSG_vehicle(MSG_CONFIG_TX_ABS_ESP_8, ABS_ESP_8);

		PROJ_CalcMsg_BCM_1();
		SendMSG_vehicle(MSG_CONFIG_TX_BCM_1, BCM_1);

		PROJ_CalcMsg_EPS_2();
		SendMSG_vehicle(MSG_CONFIG_TX_EPS_2, EPS_2);

		PROJ_CalcMsg_ICM_1();
		SendMSG_vehicle(MSG_CONFIG_TX_ICM_1, ICM_1);

		PROJ_CalcMsg_ICM_5();
		SendMSG_vehicle(MSG_CONFIG_TX_ICM_5, ICM_5);

		PROJ_CalcMsg_IPB_11();
		SendMSG_vehicle(MSG_CONFIG_TX_IPB_11, IPB_11);

		PROJ_CalcMsg_YAS_1();
		SendMSG_vehicle(MSG_CONFIG_TX_YAS_1, YAS_1);

		PROJ_CalcMsg_YAS_2();
		SendMSG_vehicle(MSG_CONFIG_TX_YAS_2, YAS_2);

		PROJ_CalcMsg_Z_EPB_State_R();
		SendMSG_vehicle(MSG_CONFIG_TX_Z_EPB_State_R, Z_EPB_State_R);

	}
}
on timer PROJ_SendMSGTimer_50ms
{
	//reset Timer
	setTimer(PROJ_SendMSGTimer_50ms, 50);

	//Calc and send MSG
	{
		PROJ_CalcMsg_RLCR_3();
		SendMSG_vehicle(MSG_CONFIG_TX_RLCR_3, RLCR_3);

		PROJ_CalcMsg_RLCR_4();
		SendMSG_vehicle(MSG_CONFIG_TX_RLCR_4, RLCR_4);

		PROJ_CalcMsg_RLCR_5();
		SendMSG_vehicle(MSG_CONFIG_TX_RLCR_5, RLCR_5);

		PROJ_CalcMsg_RLCR_6();
		SendMSG_vehicle(MSG_CONFIG_TX_RLCR_6, RLCR_6);

		PROJ_CalcMsg_RLCR_7();
		SendMSG_vehicle(MSG_CONFIG_TX_RLCR_7, RLCR_7);

		PROJ_CalcMsg_RLCR_8();
		SendMSG_vehicle(MSG_CONFIG_TX_RLCR_8, RLCR_8);

		PROJ_CalcMsg_RLCR_9();
		SendMSG_vehicle(MSG_CONFIG_TX_RLCR_9, RLCR_9);

		PROJ_CalcMsg_RRCR_2();
		SendMSG_vehicle(MSG_CONFIG_TX_RRCR_2, RRCR_2);

		PROJ_CalcMsg_RRCR_3();
		SendMSG_vehicle(MSG_CONFIG_TX_RRCR_3, RRCR_3);

		PROJ_CalcMsg_RRCR_4();
		SendMSG_vehicle(MSG_CONFIG_TX_RRCR_4, RRCR_4);

		PROJ_CalcMsg_RRCR_5();
		SendMSG_vehicle(MSG_CONFIG_TX_RRCR_5, RRCR_5);

		PROJ_CalcMsg_RRCR_6();
		SendMSG_vehicle(MSG_CONFIG_TX_RRCR_6, RRCR_6);

		PROJ_CalcMsg_RRCR_7();
		SendMSG_vehicle(MSG_CONFIG_TX_RRCR_7, RRCR_7);

		PROJ_CalcMsg_RRCR_8();
		SendMSG_vehicle(MSG_CONFIG_TX_RRCR_8, RRCR_8);

		PROJ_CalcMsg_Z_FCM_FRM_6();
		SendMSG_vehicle(MSG_CONFIG_TX_Z_FCM_FRM_6, Z_FCM_FRM_6);

	}
}
on timer PROJ_SendMSGTimer_100ms
{
	//reset Timer
	setTimer(PROJ_SendMSGTimer_100ms, 100);

	//Calc and send MSG
	{
		PROJ_CalcMsg_ABS_ESP_G();
		SendMSG_vehicle(MSG_CONFIG_TX_ABS_ESP_G, ABS_ESP_G);

		PROJ_CalcMsg_BCM_9();
		SendMSG_vehicle(MSG_CONFIG_TX_BCM_9, BCM_9);

		PROJ_CalcMsg_CLM_2();
		SendMSG_vehicle(MSG_CONFIG_TX_CLM_2, CLM_2);

		PROJ_CalcMsg_DMS_1();
		SendMSG_vehicle(MSG_CONFIG_TX_DMS_1, DMS_1);

		PROJ_CalcMsg_EMS_2_G();
		SendMSG_vehicle(MSG_CONFIG_TX_EMS_2_G, EMS_2_G);

		PROJ_CalcMsg_EPB_G();
		SendMSG_vehicle(MSG_CONFIG_TX_EPB_G, EPB_G);

		PROJ_CalcMsg_EPS_1();
		SendMSG_vehicle(MSG_CONFIG_TX_EPS_1, EPS_1);

		PROJ_CalcMsg_HCU_1_G();
		SendMSG_vehicle(MSG_CONFIG_TX_HCU_1_G, HCU_1_G);

		PROJ_CalcMsg_HCU_3_G();
		SendMSG_vehicle(MSG_CONFIG_TX_HCU_3_G, HCU_3_G);

		PROJ_CalcMsg_ICM_2();
		SendMSG_vehicle(MSG_CONFIG_TX_ICM_2, ICM_2);

		PROJ_CalcMsg_IHU_10();
		SendMSG_vehicle(MSG_CONFIG_TX_IHU_10, IHU_10);

		PROJ_CalcMsg_IHU_11();
		SendMSG_vehicle(MSG_CONFIG_TX_IHU_11, IHU_11);

		PROJ_CalcMsg_IHU_29();
		SendMSG_vehicle(MSG_CONFIG_TX_IHU_29, IHU_29);

		PROJ_CalcMsg_IHU_30();
		SendMSG_vehicle(MSG_CONFIG_TX_IHU_30, IHU_30);

		PROJ_CalcMsg_IHU_31();
		SendMSG_vehicle(MSG_CONFIG_TX_IHU_31, IHU_31);

		PROJ_CalcMsg_MFS_2();
		SendMSG_vehicle(MSG_CONFIG_TX_MFS_2, MFS_2);

		PROJ_CalcMsg_RLCR_1();
		SendMSG_vehicle(MSG_CONFIG_TX_RLCR_1, RLCR_1);

		PROJ_CalcMsg_RRCR_1();
		SendMSG_vehicle(MSG_CONFIG_TX_RRCR_1, RRCR_1);

		PROJ_CalcMsg_VCU_6();
		SendMSG_vehicle(MSG_CONFIG_TX_VCU_6, VCU_6);

	}
}
on timer PROJ_SendMSGTimer_500ms
{
	//reset Timer
	setTimer(PROJ_SendMSGTimer_500ms, 500);

	//Calc and send MSG
	{
		PROJ_CalcMsg_ICM_3();
		SendMSG_vehicle(MSG_CONFIG_TX_ICM_3, ICM_3);

	}
}

//----------------GEN: On Timer End-------------------



SendMSG_vehicle(int MSGIndex, message* MSG)
{
		PROJ_Sim_Timeout(MSGIndex, MSG);
}


PROJ_Sim_Timeout(int MSGIndex, message* MSG)
{
    /* Timeout */
    if (@Error_panel_vehicle::i_TOError[MSGIndex] != 0)
    {
        if (@Error_panel_vehicle::i_TOErrorCounter[MSGIndex] > 0)
        {
            @Error_panel_vehicle::i_TOErrorCounter[MSGIndex] --;
        }

        if (@Error_panel_vehicle::i_TOErrorCounter[MSGIndex] == 0)
        {
            @Error_panel_vehicle::i_TOError[MSGIndex] = 0;
            @Error_panel_vehicle::i_TOErrorCounter[MSGIndex] = -1;
        }
       
    }
    else
    {
        output(MSG);
    }
}


PROJ_Sim_vehicle_Signals_Init ()
{


	/* ABS_ESP_1 */
	{
		ABS_ESP_1.ABS_ESP_1_ABSActive=0;
		ABS_ESP_1.ABS_ESP_1_ABSFailSts=0;
		ABS_ESP_1.ABS_ESP_1_EBDFailSts=0;
		ABS_ESP_1.ABS_ESP_1_ESPSwitchStatus=0;
		ABS_ESP_1.ABS_ESP_1_HDCCtrlSts=0;
		ABS_ESP_1.ABS_ESP_1_HDCFailSts=0;
		ABS_ESP_1.ABS_ESP_1_PressureMasterCylinder=0;
		ABS_ESP_1.ABS_ESP_1_TCSActive=0;
		ABS_ESP_1.ABS_ESP_1_TCSFailSts=0;
		ABS_ESP_1.ABS_ESP_1_VDCActive=0;
		ABS_ESP_1.ABS_ESP_1_VDCFailSts=0;
		ABS_ESP_1.ABS_ESP_1_VehicleSpeedVSOSig=0;
		ABS_ESP_1.ESP1_PressureMasCylindValidData=0;
		ABS_ESP_1.ESP1_VehicleSpeedVSOSigValidData=0;
		ABS_ESP_1.SwitchOffCruiseControl=0;
	}


	/* ABS_ESP_3 */
	{
		ABS_ESP_3.ABS_ESP_3_AVHFailSts=0;
		ABS_ESP_3.ABS_ESP_3_AVHSts=0;
		ABS_ESP_3.NoBrakeForce=0;
	}


	/* ABS_ESP_4 */
	{
		ABS_ESP_4.ABAactive=0;
		ABS_ESP_4.ABAavailable=0;
		ABS_ESP_4.AWBactive=0;
		ABS_ESP_4.AWBavailable=0;
		ABS_ESP_4.CDDActive=0;
		ABS_ESP_4.CDDAvailable=0;
		ABS_ESP_4.DCFail=0;
		ABS_ESP_4.ECDTempOff=0;
		ABS_ESP_4.VLC_Active=0;
		ABS_ESP_4.VLC_Available=0;
		ABS_ESP_4.VLC_InternalTargetAcceleration=0;
		ABS_ESP_4.VehicleStandstill=0;
	}


	/* ABS_ESP_7 */
	{
		ABS_ESP_7.LHFWheelDriveDirection=0;
		ABS_ESP_7.LHFWheelSpeedRaw=0;
		ABS_ESP_7.LHFWheelSpeedRawValidData=0;
		ABS_ESP_7.QDCACC=0;
		ABS_ESP_7.RHFWheelDriveDirection=0;
		ABS_ESP_7.RHFWheelSpeedRaw=0;
		ABS_ESP_7.RHFWheelSpeedRawValidData=0;
		ABS_ESP_7.VLCFail=0;
		ABS_ESP_7.WheelBrakeForce=0;
	}


	/* ABS_ESP_8 */
	{
		ABS_ESP_8.ABPActive=0;
		ABS_ESP_8.ABPAvailable=0;
		ABS_ESP_8.AEBdecActive=0;
		ABS_ESP_8.AEBdecAvailable=0;
		ABS_ESP_8.LHRWheelDriveDirection=0;
		ABS_ESP_8.LHRWheelSpeedRaw=0;
		ABS_ESP_8.LHRWheelSpeedRawValidData=0;
		ABS_ESP_8.RHRWheelDriveDirection=0;
		ABS_ESP_8.RHRWheelSpeedRaw=0;
		ABS_ESP_8.RHRWheelSpeedRawValidData=0;
	}


	/* ABS_ESP_G */
	{
		ABS_ESP_G.CDPActive=0;
	}


	/* BCM_1 */
	{
		BCM_1.AutoHighSpeedRequest=0;
		BCM_1.AutoLightSW=0;
		BCM_1.DirectionIndLeft=0;
		BCM_1.DirectionIndRight=0;
		BCM_1.DriverDoorLockSts=0;
		BCM_1.DriverDoorSts=0;
		BCM_1.DriverDoorStsQbit=0;
		BCM_1.FGHeat_Request_CommandFeedback=0;
		BCM_1.FlashSWSts=0;
		BCM_1.FrontFogLightSts=0;
		BCM_1.HMASW=0;
		BCM_1.HazardLightSW=0;
		BCM_1.HighBeamSWSts=0;
		BCM_1.HighBeamSts=0;
		BCM_1.HoodSts=0;
		BCM_1.KeySts=0;
		BCM_1.LHRdoorSts=0;
		BCM_1.LHTurnSW=0;
		BCM_1.LHTurnlightSts=0;
		BCM_1.LowBeamSts=0;
		BCM_1.PsngrDoorSts=0;
		BCM_1.RHRDoorSts=0;
		BCM_1.RHTurnSW=0;
		BCM_1.RHTurnlightSts=0;
		BCM_1.RainDetected=0;
		BCM_1.RearFogLightSts=0;
		BCM_1.ReverseGearSts=0;
		BCM_1.TrunkSts=0;
		BCM_1.WiperSts=0;
	}


	/* BCM_9 */
	{
		BCM_9.TrailerConnectSts=0;
	}


	/* CLM_2 */
	{
		CLM_2.CLM2_ExternalTempFailSts=0;
		CLM_2.CLM2_ExternalTemperature_C=0;
	}


	/* DMS_1 */
	{
		DMS_1.DMS_1_CameraSt=0;
		DMS_1.DMS_1_DMSSt=0;
		DMS_1.DMS_1_DriverSts=0;
	}


	/* EMS_1 */
	{
		EMS_1.AcceleratorPosRaw=0;
		EMS_1.CruiseControlStatus=0;
		EMS_1.ECFail=0;
		EMS_1.ECGPOvrd=0;
		EMS_1.EMS1_EngineSpeed=0;
		EMS_1.NeutralGearSts=0;
	}


	/* EMS_2 */
	{
		EMS_2.BrakePedalStsForTCU=0;
		EMS_2.BrakePedalStsValidDataForTCU=0;
		EMS_2.EngineStsForDCT=0;
	}


	/* EMS_2_G */
	{
		EMS_2_G.GasPedalPosition=0;
		EMS_2_G.GasPedalPositionInvalidData=0;
		EMS_2_G.LimitSpeedSts=0;
	}


	/* EMS_3 */
	{
		EMS_3.EMS3_SSMStatus=0;
	}


	/* EMS_6 */
	{
		EMS_6.BrakePedalStsForTCU=0;
		EMS_6.BrakePedalStsValidDataForTCU=0;
		EMS_6.ECGPOvrd=0;
		EMS_6.ECGPOvrdInvalidData=0;
	}


	/* EPB_G */
	{
		EPB_G.EPBErrorStatus=0;
		EPB_G.EPBStatus=0;
		EPB_G.EPBStatus=0;
		EPB_G.RWUActive=0;
	}


	/* EPS_1 */
	{
		EPS_1.EPSFailSts=0;
		EPS_1.EPSSteeringAngleCalibrationSts=0;
		EPS_1.EPS_AssistanceStyle_Sts=0;
	}


	/* EPS_2 */
	{
		EPS_2.EpsControlStatus=0;
		EPS_2.TorsionBarTorque=0;
		EPS_2.TorsionBarTorqueDir=0;
		EPS_2.TosionBarTorqueValid=0;
	}


	/* EPS_3 */
	{
		EPS_3.EPS_3_AgFailr=0;
		EPS_3.EPS_3_StrngAgSpd=0;
		EPS_3.EPS_3_StrngAgSpdValidData=0;
		EPS_3.EPS_3_StrngWhlAg=0;
		EPS_3.EPS_3_StrngWhlAgValid=0;
	}


	/* EPS_4 */
	{
		EPS_4.EPS_4_AgCtrlLimActvd=0;
		EPS_4.EPS_4_HptcVibSrvAvl=0;
		EPS_4.EPS_4_LatDrvgAvlForLvl=0;
		EPS_4.EPS_4_LoASts=0;
		EPS_4.EPS_4_MotorTorque=0;
		EPS_4.EPS_4_PSCMActRPCTrq=0;
		EPS_4.EPS_4_PSCMActRPCTrqValid=0;
		EPS_4.EPS_4_StrngWhlAgResActive=0;
	}


	/* HCU_17 */
	{
		HCU_17.PRNDGearAct=0;
		HCU_17.PRNDGearActValidData=0;
		HCU_17.PRNDGearTarget=0;
	}


	/* HCU_1_G */
	{
		HCU_1_G.HCU_PTReady=0;
		HCU_1_G.HCU_PowertrainFault=0;
	}


	/* HCU_3_G */
	{
		HCU_3_G.HCU_BrakePedalSts=0;
		HCU_3_G.HCU_BrakePedalStsValidData=0;
		HCU_3_G.HCU_GasPedalPosition=0;
		HCU_3_G.HCU_GasPedalPositionInvalidData=0;
		HCU_3_G.HCU_PowerLimit=0;
	}


	/* HCU_6 */
	{
		HCU_6.HCU_6_BrakePedalStsForTCU=0;
		HCU_6.HCU_6_ECGPOvrd=0;
		HCU_6.HCU_6_ECGPOvrdInvalidData=0;
		HCU_6.HCU_6_MaxTorqueWheel=0;
		HCU_6.HCU_6_MinTorqueWheel=0;
		HCU_6.HCU_BrakePedalStsValidDataForTCU=0;
	}


	/* ICM_1 */
	{
		ICM_1.DisplayVehicleSpeed=0;
		ICM_1.ECOModeSWSts=0;
		ICM_1.LDWLKA_LaneAssitTypeReq=0;
		ICM_1.TotalOdometer_km=0;
	}


	/* ICM_2 */
	{
		ICM_2.DISFail=0;
		ICM_2.QDashACCFail=0;
	}


	/* ICM_3 */
	{
		ICM_3.CurrentTimeDay=0;
		ICM_3.CurrentTimeHour=0;
		ICM_3.CurrentTimeMinute=0;
		ICM_3.CurrentTimeMonth=0;
		ICM_3.CurrentTimeSecond=0;
		ICM_3.CurrentTimeYear=0;
	}


	/* ICM_5 */
	{
		ICM_5.ACC_Kilometre_Mile=0;
		ICM_5.DriverSeatBeltSwitchQbit=0;
		ICM_5.ICM_5_DriverSeatBeltSwitch=0;
	}


	/* IHU_10 */
	{
		IHU_10.IHU_DriveMode=0;
		IHU_10.NavCurrRoadType=0;
		IHU_10.NavSpeedLimit=0;
		IHU_10.NavSpeedLimitStatus=0;
		IHU_10.NavSpeedLimitUnits=0;
		IHU_10.Reserved_NavCountryCode=0;
		IHU_10.SLASpdLimChgAudSwSet=0;
	}


	/* IHU_11 */
	{
		IHU_11.IHU_11_AEBSwtSet=0;
		IHU_11.IHU_11_DAISwtSet=0;
		IHU_11.IHU_11_ELKSwtSet=0;
		IHU_11.IHU_11_FCWSnvtySet=0;
		IHU_11.IHU_11_FCWSwtSet=0;
		IHU_11.IHU_11_HMASwtSet=0;
		IHU_11.IHU_11_IESSwtSet=0;
		IHU_11.IHU_11_LDPSwtSet=0;
		IHU_11.IHU_11_LDWLDPSnvtySet=0;
		IHU_11.IHU_11_LDWSwtSet=0;
		IHU_11.IHU_11_SCFSwtSet=0;
		IHU_11.IHU_11_SLASwtSet=0;
		IHU_11.IHU_11_TJAICAExitTextInfoSwtSet=0;
		IHU_11.IHU_11_TLISwtSet=0;
		IHU_11.IHU_11_TSISwtSet=0;
		IHU_11.IHU_11_WarnModSwtSet=0;
	}


	/* IHU_29 */
	{
		IHU_29.IHU_29_SLAMode=0;
		IHU_29.IHU_29_SpeedLmtNmberAb=0;
		IHU_29.IHU_29_SpeedLmtNmberE=0;
		IHU_29.SLASpdlimitWarningAudSWSet=0;
		IHU_29.SLWFONOFFSet=0;
	}


	/* IHU_30 */
	{
		IHU_30.IHU_30_Reserved_2=0;
		IHU_30.NavCountryCodeInfo=0;
		IHU_30.NavFogSpeedLimit=0;
		IHU_30.NavJunctions=0;
		IHU_30.NavRainSpeedLimit=0;
		IHU_30.NavRampDistance=0;
		IHU_30.NavRampInfo=0;
		IHU_30.NavRoundabouts=0;
		IHU_30.NavSnowSpeedLimit=0;
		IHU_30.NavSpeedLimitType=0;
		IHU_30.NavSpeedLimit_EV=0;
	}


	/* IHU_31 */
	{
		IHU_31.AdasSignDistance=0;
		IHU_31.AdasSignType_reserve=0;
		IHU_31.NavTrafficlights=0;
		IHU_31.NavWinding=0;
	}


	/* IPB_11 */
	{
		IPB_11.IPB_InputRodStroke=0;
		IPB_11.IPB_InputRodStrokeStatus=0;
	}


	/* MFS_2 */
	{
		MFS_2.MFS_Cruise_Control=0;
		MFS_2.MFS_RESPlus=0;
		MFS_2.MFS_SETMinus=0;
		MFS_2.MFS_Speed_limit=0;
		MFS_2.MFS_Time_Gap_Add=0;
		MFS_2.MFS_Time_Gap_Reduce=0;
	}


	/* RLCR_1 */
	{
		RLCR_1.RLCR_1_BlkSts=0;
		RLCR_1.RLCR_1_ELKSts=0;
		RLCR_1.RLCR_1_SysSt=0;
	}


	/* RLCR_3 */
	{
		RLCR_3.RLCR_3_Le1HdTo=0;
		RLCR_3.RLCR_3_Le1ObjBoxLen=0;
		RLCR_3.RLCR_3_Le1ObjBoxWidth=0;
		RLCR_3.RLCR_3_Le1ObjConf=0;
		RLCR_3.RLCR_3_Le1ObjCoordX=0;
		RLCR_3.RLCR_3_Le1ObjCoordXDstStdDe=0;
		RLCR_3.RLCR_3_Le1ObjCoordY=0;
		RLCR_3.RLCR_3_Le1ObjCoordYDstStdDe=0;
		RLCR_3.RLCR_3_Le1ObjID=0;
		RLCR_3.RLCR_3_Le1ObjMtnChartc=0;
		RLCR_3.RLCR_3_Le1ObjNrOffocst=0;
		RLCR_3.RLCR_3_Le1ObjTrackSt=0;
		RLCR_3.RLCR_3_Le1ObjTyp=0;
		RLCR_3.RLCR_3_Le1ObjXDirAV=0;
		RLCR_3.RLCR_3_Le1ObjXDirV=0;
		RLCR_3.RLCR_3_Le1ObjXDirVStdDe=0;
		RLCR_3.RLCR_3_Le1ObjYDirV=0;
		RLCR_3.RLCR_3_Le1ObjYDirVStdDe=0;
	}


	/* RLCR_4 */
	{
		RLCR_4.RLCR_4_Le2HdTo=0;
		RLCR_4.RLCR_4_Le2ObjBoxLen=0;
		RLCR_4.RLCR_4_Le2ObjBoxWidth=0;
		RLCR_4.RLCR_4_Le2ObjConf=0;
		RLCR_4.RLCR_4_Le2ObjCoordX=0;
		RLCR_4.RLCR_4_Le2ObjCoordXDstStdDe=0;
		RLCR_4.RLCR_4_Le2ObjCoordY=0;
		RLCR_4.RLCR_4_Le2ObjCoordYDstStdDe=0;
		RLCR_4.RLCR_4_Le2ObjID=0;
		RLCR_4.RLCR_4_Le2ObjMtnChartc=0;
		RLCR_4.RLCR_4_Le2ObjNrOffocst=0;
		RLCR_4.RLCR_4_Le2ObjTrackSt=0;
		RLCR_4.RLCR_4_Le2ObjTyp=0;
		RLCR_4.RLCR_4_Le2ObjXDirAV=0;
		RLCR_4.RLCR_4_Le2ObjXDirV=0;
		RLCR_4.RLCR_4_Le2ObjXDirVStdDe=0;
		RLCR_4.RLCR_4_Le2ObjYDirV=0;
		RLCR_4.RLCR_4_Le2ObjYDirVStdDe=0;
	}


	/* RLCR_5 */
	{
		RLCR_5.RLCR_5_Le3HdTo=0;
		RLCR_5.RLCR_5_Le3ObjBoxLen=0;
		RLCR_5.RLCR_5_Le3ObjBoxWidth=0;
		RLCR_5.RLCR_5_Le3ObjConf=0;
		RLCR_5.RLCR_5_Le3ObjCoordX=0;
		RLCR_5.RLCR_5_Le3ObjCoordXDstStdDe=0;
		RLCR_5.RLCR_5_Le3ObjCoordY=0;
		RLCR_5.RLCR_5_Le3ObjCoordYDstStdDe=0;
		RLCR_5.RLCR_5_Le3ObjID=0;
		RLCR_5.RLCR_5_Le3ObjMtnChartc=0;
		RLCR_5.RLCR_5_Le3ObjNrOffocst=0;
		RLCR_5.RLCR_5_Le3ObjTrackSt=0;
		RLCR_5.RLCR_5_Le3ObjTyp=0;
		RLCR_5.RLCR_5_Le3ObjXDirAV=0;
		RLCR_5.RLCR_5_Le3ObjXDirV=0;
		RLCR_5.RLCR_5_Le3ObjXDirVStdDe=0;
		RLCR_5.RLCR_5_Le3ObjYDirV=0;
		RLCR_5.RLCR_5_Le3ObjYDirVStdDe=0;
	}


	/* RLCR_6 */
	{
		RLCR_6.RLCR_6_Le4HdTo=0;
		RLCR_6.RLCR_6_Le4ObjBoxLen=0;
		RLCR_6.RLCR_6_Le4ObjBoxWidth=0;
		RLCR_6.RLCR_6_Le4ObjConf=0;
		RLCR_6.RLCR_6_Le4ObjCoordX=0;
		RLCR_6.RLCR_6_Le4ObjCoordXDstStdDe=0;
		RLCR_6.RLCR_6_Le4ObjCoordY=0;
		RLCR_6.RLCR_6_Le4ObjCoordYDstStdDe=0;
		RLCR_6.RLCR_6_Le4ObjID=0;
		RLCR_6.RLCR_6_Le4ObjMtnChartc=0;
		RLCR_6.RLCR_6_Le4ObjNrOffocst=0;
		RLCR_6.RLCR_6_Le4ObjTrackSt=0;
		RLCR_6.RLCR_6_Le4ObjTyp=0;
		RLCR_6.RLCR_6_Le4ObjXDirAV=0;
		RLCR_6.RLCR_6_Le4ObjXDirV=0;
		RLCR_6.RLCR_6_Le4ObjXDirVStdDe=0;
		RLCR_6.RLCR_6_Le4ObjYDirV=0;
		RLCR_6.RLCR_6_Le4ObjYDirVStdDe=0;
	}


	/* RLCR_7 */
	{
		RLCR_7.RLCR_7_Le5HdTo=0;
		RLCR_7.RLCR_7_Le5ObjBoxLen=0;
		RLCR_7.RLCR_7_Le5ObjBoxWidth=0;
		RLCR_7.RLCR_7_Le5ObjConf=0;
		RLCR_7.RLCR_7_Le5ObjCoordX=0;
		RLCR_7.RLCR_7_Le5ObjCoordXDstStdDe=0;
		RLCR_7.RLCR_7_Le5ObjCoordY=0;
		RLCR_7.RLCR_7_Le5ObjCoordYDstStdDe=0;
		RLCR_7.RLCR_7_Le5ObjID=0;
		RLCR_7.RLCR_7_Le5ObjMtnChartc=0;
		RLCR_7.RLCR_7_Le5ObjNrOffocst=0;
		RLCR_7.RLCR_7_Le5ObjTrackSt=0;
		RLCR_7.RLCR_7_Le5ObjTyp=0;
		RLCR_7.RLCR_7_Le5ObjXDirAV=0;
		RLCR_7.RLCR_7_Le5ObjXDirV=0;
		RLCR_7.RLCR_7_Le5ObjXDirVStdDe=0;
		RLCR_7.RLCR_7_Le5ObjYDirV=0;
		RLCR_7.RLCR_7_Le5ObjYDirVStdDe=0;
	}


	/* RLCR_8 */
	{
		RLCR_8.RLCR_8_TiStampLaten=0;
	}


	/* RLCR_9 */
	{
		RLCR_9.RLCR_9_LgtDst=0;
		RLCR_9.RLCR_9_LgtRelV=0;
		RLCR_9.RLCR_9_ObjVldFlg=0;
	}


	/* RRCR_1 */
	{
		RRCR_1.RRCR_1_BlkSts=0;
		RRCR_1.RRCR_1_SysSt=0;
	}


	/* RRCR_2 */
	{
		RRCR_2.RRCR_2_Ri1HdTo=0;
		RRCR_2.RRCR_2_Ri1ObjBoxLen=0;
		RRCR_2.RRCR_2_Ri1ObjBoxWidth=0;
		RRCR_2.RRCR_2_Ri1ObjConf=0;
		RRCR_2.RRCR_2_Ri1ObjCoordX=0;
		RRCR_2.RRCR_2_Ri1ObjCoordXDstStdDe=0;
		RRCR_2.RRCR_2_Ri1ObjCoordY=0;
		RRCR_2.RRCR_2_Ri1ObjCoordYDstStdDe=0;
		RRCR_2.RRCR_2_Ri1ObjID=0;
		RRCR_2.RRCR_2_Ri1ObjMtnChartc=0;
		RRCR_2.RRCR_2_Ri1ObjNrOffocst=0;
		RRCR_2.RRCR_2_Ri1ObjTrackSt=0;
		RRCR_2.RRCR_2_Ri1ObjTyp=0;
		RRCR_2.RRCR_2_Ri1ObjXDirAV=0;
		RRCR_2.RRCR_2_Ri1ObjXDirV=0;
		RRCR_2.RRCR_2_Ri1ObjXDirVStdDe=0;
		RRCR_2.RRCR_2_Ri1ObjYDirV=0;
		RRCR_2.RRCR_2_Ri1ObjYDirVStdDe=0;
	}


	/* RRCR_3 */
	{
		RRCR_3.RRCR_3_Ri2HdTo=0;
		RRCR_3.RRCR_3_Ri2ObjBoxLen=0;
		RRCR_3.RRCR_3_Ri2ObjBoxWidth=0;
		RRCR_3.RRCR_3_Ri2ObjConf=0;
		RRCR_3.RRCR_3_Ri2ObjCoordX=0;
		RRCR_3.RRCR_3_Ri2ObjCoordXDstStdDe=0;
		RRCR_3.RRCR_3_Ri2ObjCoordY=0;
		RRCR_3.RRCR_3_Ri2ObjCoordYDstStdDe=0;
		RRCR_3.RRCR_3_Ri2ObjID=0;
		RRCR_3.RRCR_3_Ri2ObjMtnChartc=0;
		RRCR_3.RRCR_3_Ri2ObjNrOffocst=0;
		RRCR_3.RRCR_3_Ri2ObjTrackSt=0;
		RRCR_3.RRCR_3_Ri2ObjTyp=0;
		RRCR_3.RRCR_3_Ri2ObjXDirAV=0;
		RRCR_3.RRCR_3_Ri2ObjXDirV=0;
		RRCR_3.RRCR_3_Ri2ObjXDirVStdDe=0;
		RRCR_3.RRCR_3_Ri2ObjYDirV=0;
		RRCR_3.RRCR_3_Ri2ObjYDirVStdDe=0;
	}


	/* RRCR_4 */
	{
		RRCR_4.RRCR_4_Ri3HdTo=0;
		RRCR_4.RRCR_4_Ri3ObjBoxLen=0;
		RRCR_4.RRCR_4_Ri3ObjBoxWidth=0;
		RRCR_4.RRCR_4_Ri3ObjConf=0;
		RRCR_4.RRCR_4_Ri3ObjCoordX=0;
		RRCR_4.RRCR_4_Ri3ObjCoordXDstStdDe=0;
		RRCR_4.RRCR_4_Ri3ObjCoordY=0;
		RRCR_4.RRCR_4_Ri3ObjCoordYDstStdDe=0;
		RRCR_4.RRCR_4_Ri3ObjID=0;
		RRCR_4.RRCR_4_Ri3ObjMtnChartc=0;
		RRCR_4.RRCR_4_Ri3ObjNrOffocst=0;
		RRCR_4.RRCR_4_Ri3ObjTrackSt=0;
		RRCR_4.RRCR_4_Ri3ObjTyp=0;
		RRCR_4.RRCR_4_Ri3ObjXDirAV=0;
		RRCR_4.RRCR_4_Ri3ObjXDirV=0;
		RRCR_4.RRCR_4_Ri3ObjXDirVStdDe=0;
		RRCR_4.RRCR_4_Ri3ObjYDirV=0;
		RRCR_4.RRCR_4_Ri3ObjYDirVStdDe=0;
	}


	/* RRCR_5 */
	{
		RRCR_5.RRCR_5_Ri4HdTo=0;
		RRCR_5.RRCR_5_Ri4ObjBoxLen=0;
		RRCR_5.RRCR_5_Ri4ObjBoxWidth=0;
		RRCR_5.RRCR_5_Ri4ObjConf=0;
		RRCR_5.RRCR_5_Ri4ObjCoordX=0;
		RRCR_5.RRCR_5_Ri4ObjCoordXDstStdDe=0;
		RRCR_5.RRCR_5_Ri4ObjCoordY=0;
		RRCR_5.RRCR_5_Ri4ObjCoordYDstStdDe=0;
		RRCR_5.RRCR_5_Ri4ObjID=0;
		RRCR_5.RRCR_5_Ri4ObjMtnChartc=0;
		RRCR_5.RRCR_5_Ri4ObjNrOffocst=0;
		RRCR_5.RRCR_5_Ri4ObjTrackSt=0;
		RRCR_5.RRCR_5_Ri4ObjTyp=0;
		RRCR_5.RRCR_5_Ri4ObjXDirAV=0;
		RRCR_5.RRCR_5_Ri4ObjXDirV=0;
		RRCR_5.RRCR_5_Ri4ObjXDirVStdDe=0;
		RRCR_5.RRCR_5_Ri4ObjYDirV=0;
		RRCR_5.RRCR_5_Ri4ObjYDirVStdDe=0;
	}


	/* RRCR_6 */
	{
		RRCR_6.RRCR_6_Ri5HdTo=0;
		RRCR_6.RRCR_6_Ri5ObjBoxLen=0;
		RRCR_6.RRCR_6_Ri5ObjBoxWidth=0;
		RRCR_6.RRCR_6_Ri5ObjConf=0;
		RRCR_6.RRCR_6_Ri5ObjCoordX=0;
		RRCR_6.RRCR_6_Ri5ObjCoordXDstStdDe=0;
		RRCR_6.RRCR_6_Ri5ObjCoordY=0;
		RRCR_6.RRCR_6_Ri5ObjCoordYDstStdDe=0;
		RRCR_6.RRCR_6_Ri5ObjID=0;
		RRCR_6.RRCR_6_Ri5ObjMtnChartc=0;
		RRCR_6.RRCR_6_Ri5ObjNrOffocst=0;
		RRCR_6.RRCR_6_Ri5ObjTrackSt=0;
		RRCR_6.RRCR_6_Ri5ObjTyp=0;
		RRCR_6.RRCR_6_Ri5ObjXDirAV=0;
		RRCR_6.RRCR_6_Ri5ObjXDirV=0;
		RRCR_6.RRCR_6_Ri5ObjXDirVStdDe=0;
		RRCR_6.RRCR_6_Ri5ObjYDirV=0;
		RRCR_6.RRCR_6_Ri5ObjYDirVStdDe=0;
	}


	/* RRCR_7 */
	{
		RRCR_7.RRCR_7_TiStampLaten=0;
	}


	/* RRCR_8 */
	{
		RRCR_8.RRCR_8_LgtDst=0;
		RRCR_8.RRCR_8_LgtRelV=0;
		RRCR_8.RRCR_8_ObjVldFlg=0;
	}


	/* SAM_1_G */
	{
		SAM_1_G.AngleFailure=0;
		SAM_1_G.SteeringAngle=0;
		SAM_1_G.SteeringAngleSpeed=0;
		SAM_1_G.SteeringAngleSpeedValidData=0;
		SAM_1_G.SteeringAngleValidData=0;
	}


	/* TCU_2 */
	{
		TCU_2.DriverMode=0;
		TCU_2.GBPositoionDisplayForPEPS=0;
		TCU_2.ShiftInProgress=0;
		TCU_2.TargetGear=0;
		TCU_2.TargetGearValidData=0;
	}


	/* TCU_4 */
	{
		TCU_4.STAT_LimpHomeMode=0;
	}


	/* VCU_2 */
	{
		VCU_2.VCU_2_Resd1=0;
		VCU_2.VCU_2_Resd2=0;
		VCU_2.VCU_2_Resd3=0;
		VCU_2.VCU_2_Resd5=0;
		VCU_2.VCU_ActualGear=0;
		VCU_2.VCU_ActualGearValidData=0;
		VCU_2.VCU_BrakePedalSts=0;
		VCU_2.VCU_BrakePedalStsValidData=0;
		VCU_2.VCU_DrivePedalOverride=0;
		VCU_2.VCU_DrivePedalOverride_Valid=0;
		VCU_2.VCU_GasPedalPosition=0;
		VCU_2.VCU_GasPedalPositionInvalidData=0;
		VCU_2.VCU_LimitSpeedSts=0;
		VCU_2.VCU_MaxActualWheelTorque=0;
		VCU_2.VCU_MinActualWheelTorque=0;
		VCU_2.VCU_PTReady=0;
		VCU_2.VCU_TargetGear=0;
		VCU_2.VCU_TargetGearValidData=0;
	}


	/* VCU_6 */
	{
		VCU_6.VCU_LowSOCCLMLimitSts=0;
		VCU_6.VCU_VehicleSystemFailure=0;
	}


	/* YAS_1 */
	{
		YAS_1.LateralAcceleration=0;
		YAS_1.LateralAccelerationSigValidData=0;
		YAS_1.YAS_CalibrationSts=0;
		YAS_1.YawRate=0;
		YAS_1.YawrateSigValidData=0;
	}


	/* YAS_2 */
	{
		YAS_2.LongitudinalAcceleration=0;
		YAS_2.LongitudinalAccelerationSigValid=0;
	}


	/* Z_EPB_State_R */
	{
		Z_EPB_State_R.EPBStatus=0;
		Z_EPB_State_R.EPB_FltLvl=0;
	}


	/* Z_FCM_FRM_6 */
	{
		Z_FCM_FRM_6.FCM_FRM_6_ACCMode=0;
		Z_FCM_FRM_6.FCM_FRM_6_AEBDecCtrlRequest=0;
		Z_FCM_FRM_6.FCM_FRM_6_AEBMode=0;
		Z_FCM_FRM_6.FCM_FRM_6_DistanceWarning=0;
		Z_FCM_FRM_6.FCM_FRM_6_DrvrCfmSCFDispFb=0;
		Z_FCM_FRM_6.FCM_FRM_6_FCWMode=0;
		Z_FCM_FRM_6.FCM_FRM_6_FCW_preWarning=0;
		Z_FCM_FRM_6.FCM_FRM_6_HMI_Indicator=0;
		Z_FCM_FRM_6.FCM_FRM_6_Resd_1=0;
		Z_FCM_FRM_6.FCM_FRM_6_Resd_2=0;
		Z_FCM_FRM_6.FCM_FRM_6_SCF_PopoverReq=0;
		Z_FCM_FRM_6.FCM_FRM_6_SCF_SpdLimSts=0;
		Z_FCM_FRM_6.FCM_FRM_6_SCF_SpdLimUnit=0;
		Z_FCM_FRM_6.FCM_FRM_6_TakeOverReq=0;
		Z_FCM_FRM_6.FCM_FRM_6_TextinfoWarn=0;
		Z_FCM_FRM_6.FCM_FRM_6_Textinfo_Info=0;
		Z_FCM_FRM_6.FCM_FRM_6_TimeGapSetICM=0;
		Z_FCM_FRM_6.FCM_FRM_6_VSetDis=0;
	}
}


byte PROJ_CHK_SAE_J1850_0x1D (byte p_length, byte data[])
{
  byte t_RetCrc;
  byte t_CRC_temp;
  byte t_index;
  
  t_CRC_temp = 0xFF;
  for (t_index = 0; t_index < p_length; ++t_index)
  {
    if(t_index == 8)
    {
      continue;
    }
    t_CRC_temp ^= data.byte(t_index);
    t_CRC_temp = CRC_8_H1D_Tbl[t_CRC_temp];
    
  }
  t_CRC_temp ^= 0xFF;
  
  t_RetCrc = t_CRC_temp;
  
  return t_RetCrc;
}
PROJ_Sim_Rollingcounter(int MSGIndex, message* MSG)
{
  if ((PROJ_MSG_E2E_TX_ARR[MSGIndex].PROJ_E2E_TYPE == E2E_XOR))
  {
    char t_LastSeqCounter; 
    byte t_LastSeqCounter_byte; 
    byte t_ALC_position;
    byte t_ALC_Offset;
    

    switch(MSGIndex)
    {

      case MSG_CONFIG_TX_ABS_ESP_1:
              t_ALC_position = 7; 
              break;
	  case MSG_CONFIG_TX_ABS_ESP_3:
      case MSG_CONFIG_TX_ABS_ESP_4:   
      case MSG_CONFIG_TX_ABS_ESP_7:
      case MSG_CONFIG_TX_ABS_ESP_8:  
      case MSG_CONFIG_TX_BCM_1:
	  case MSG_CONFIG_TX_ICM_5:
	  case MSG_CONFIG_TX_TCU_2:
      case MSG_CONFIG_TX_EMS_3:
//	  case MSG_CONFIG_TX_Z_FCM_FRM_6:
              t_ALC_position = 6;   
              break;
	  case MSG_CONFIG_TX_EMS_1:
		  t_ALC_position = 7;   
		  break;
      case MSG_CONFIG_TX_YAS_1:
      case MSG_CONFIG_TX_YAS_2:  
              t_ALC_position = 0;   
              break;
//      case MSG_CONFIG_TX_Z_EPB_State_R:  
//              t_ALC_position = 1;   
//              break;			  
      default: 
              t_ALC_position = 3;
              break;
    }
    
    switch(MSGIndex)
    {

      case MSG_CONFIG_TX_ABS_ESP_1:
	    case MSG_CONFIG_TX_ABS_ESP_3:
      case MSG_CONFIG_TX_ABS_ESP_4:   
      case MSG_CONFIG_TX_ABS_ESP_7:
      case MSG_CONFIG_TX_ABS_ESP_8:  
      case MSG_CONFIG_TX_BCM_1: 
  	  case MSG_CONFIG_TX_EMS_1:
  	  case MSG_CONFIG_TX_TCU_2:
  	  case MSG_CONFIG_TX_ICM_5:
//	  case MSG_CONFIG_TX_Z_FCM_FRM_6:
//	  case MSG_CONFIG_TX_Z_EPB_State_R:
              t_ALC_Offset = 0;  
              break;
      case MSG_CONFIG_TX_YAS_1:
      case MSG_CONFIG_TX_YAS_2:  
              t_ALC_Offset = 1;
              break;
      default: 
              t_ALC_Offset = 4;
              break;
    }
    
    
    if (t_ALC_Offset == 0)
    {
      t_LastSeqCounter = (MSG.byte(t_ALC_position) & 0x0F); 
    }
    else if (t_ALC_Offset == 4)
    {
      t_LastSeqCounter = (MSG.byte(t_ALC_position) & 0xF0) >>4; 
    }
    else if (t_ALC_Offset == 1)
    {
    t_LastSeqCounter_byte = MSG.byte(0); 
    }
    else
    {
     t_LastSeqCounter = (MSG.byte(t_ALC_position) & 0xF0) >>4;  
    }
    
      
    /* Rolling Counter */
    if ( (@Error_panel_vehicle::i_TOError[MSGIndex] == 0)
        && (@Error_panel_vehicle::i_CRC_CHKError[MSGIndex] == 0)
        && (@Error_panel_vehicle::i_MCError[MSGIndex]))
    {
        if (@Error_panel_vehicle::i_MCErrorCounter[MSGIndex] > 0)
        {
            @Error_panel_vehicle::i_MCErrorCounter[MSGIndex] --;
        }
        
        
        if (@Error_panel_vehicle::i_MCErrorCounter[MSGIndex] ==0)
        {
            @Error_panel_vehicle::i_MCError[MSGIndex] = 0;
            @Error_panel_vehicle::i_MCErrorCounter[MSGIndex] = -1;
        }
    }
    else
    {
      
        t_LastSeqCounter = (t_LastSeqCounter +1) % 16;
        t_LastSeqCounter_byte = (t_LastSeqCounter_byte +1) % 256;
    }

    if (t_ALC_Offset == 0)
    {
      MSG.byte(t_ALC_position) = (MSG.byte(t_ALC_position) & 0xF0) | (t_LastSeqCounter);  
    }
    else if (t_ALC_Offset == 4)
    {
      MSG.byte(t_ALC_position) = (MSG.byte(t_ALC_position) & 0x0F) | (t_LastSeqCounter <<4); 
    }
    else if (t_ALC_Offset == 1)
    {
      MSG.byte(0) = (t_LastSeqCounter_byte & 0xFF) ; 
    }
    else
    {
      MSG.byte(t_ALC_position) = (MSG.byte(t_ALC_position) & 0x0F) | (t_LastSeqCounter <<4); //ICM_1
    }
    
  }
   else if ((PROJ_MSG_E2E_TX_ARR[MSGIndex].PROJ_E2E_TYPE == E2E_CRC8_MULT))
  {
    int msg_length;
    int t_cycle;
    int index;
    msg_length = MSG.DataLength;
    t_cycle=4;
    
    for (index=0; index< t_cycle; index ++)
    {
      char t_LastSeqCounter; 
      byte t_ALC_position;
      byte t_ALC_Offset;
      t_ALC_position = 1 + 8*index;  
      t_ALC_Offset = 0;//????VCU_2 ????counter,?counter?offset??0
      
      if (t_ALC_Offset == 0)
      {
        t_LastSeqCounter = (MSG.byte(t_ALC_position) & 0x0F); 
      }
      else if (t_ALC_Offset == 4)
      {
        t_LastSeqCounter = (MSG.byte(t_ALC_position) & 0xF0) >>4; 
      }
        
      /* Rolling Counter */
      if ( (@Error_panel_vehicle::i_TOError[MSGIndex] == 0)
          && (@Error_panel_vehicle::i_CRC_CHKError[MSGIndex] == 0)
          && (@Error_panel_vehicle::i_MCError[MSGIndex]))
      {
          if (@Error_panel_vehicle::i_MCErrorCounter[MSGIndex] > 0)
          {
              @Error_panel_vehicle::i_MCErrorCounter[MSGIndex] --;
          }
          
          
          if (@Error_panel_vehicle::i_MCErrorCounter[MSGIndex] ==0)
          {
              @Error_panel_vehicle::i_MCError[MSGIndex] = 0;
              @Error_panel_vehicle::i_MCErrorCounter[MSGIndex] = -1;
          }
      }
      else
      {
          t_LastSeqCounter = (t_LastSeqCounter +1) % 16;
      }

      if (t_ALC_Offset == 0)
      {
        MSG.byte(t_ALC_position) = (MSG.byte(t_ALC_position) & 0xF0) | (t_LastSeqCounter);  
      }
      else if (t_ALC_Offset == 4)
      {
        MSG.byte(t_ALC_position) = (MSG.byte(t_ALC_position) & 0x0F) | (t_LastSeqCounter <<4); 
      }
    }
    
    
  }
  else if ((PROJ_MSG_E2E_TX_ARR[MSGIndex].PROJ_E2E_TYPE == E2E_CRC8))
  {
    char t_LastSeqCounter; 
    byte t_ALC_position;
    byte t_ALC_Offset;
    

    switch(MSGIndex)
    {

      case MSG_CONFIG_TX_CLM_2:
      case MSG_CONFIG_TX_EMS_6:
              t_ALC_position = 2; 
              break;
      case MSG_CONFIG_TX_SAM_1_G:
              t_ALC_position = 5; 
              break;
      case MSG_CONFIG_TX_EPS_2:
      case MSG_CONFIG_TX_EPS_3: 
      case MSG_CONFIG_TX_EPS_4: 
      case MSG_CONFIG_TX_RLCR_1:  
      case MSG_CONFIG_TX_RLCR_8:  
      case MSG_CONFIG_TX_RLCR_9:  
      case MSG_CONFIG_TX_RRCR_1:  
      case MSG_CONFIG_TX_RRCR_7:  
      case MSG_CONFIG_TX_RRCR_8:   
      case MSG_CONFIG_TX_TCU_4:    
      case MSG_CONFIG_TX_IPB_11:    
      case MSG_CONFIG_TX_EMS_2_G: 
      case MSG_CONFIG_TX_DMS_1: 
      case MSG_CONFIG_TX_VCU_6: 
      case MSG_CONFIG_TX_HCU_17:
	  case MSG_CONFIG_TX_Z_FCM_FRM_6:	  
              t_ALC_position = 6;   
              break;
      case MSG_CONFIG_TX_HCU_6:
              t_ALC_position = 30;
              break;
      case MSG_CONFIG_TX_RLCR_3: 
      case MSG_CONFIG_TX_RLCR_4:  
      case MSG_CONFIG_TX_RLCR_5:  
      case MSG_CONFIG_TX_RLCR_6:  
      case MSG_CONFIG_TX_RLCR_7:  
      case MSG_CONFIG_TX_RRCR_2:  
      case MSG_CONFIG_TX_RRCR_3:  
      case MSG_CONFIG_TX_RRCR_4:  
      case MSG_CONFIG_TX_RRCR_5:  
      case MSG_CONFIG_TX_RRCR_6:   
              t_ALC_position = 22;   
              break;
      default: 
              t_ALC_position = 1;
              break;
    }
    
    switch(MSGIndex)
    {

      case MSG_CONFIG_TX_CLM_2:
      case MSG_CONFIG_TX_MFS_2:
      case MSG_CONFIG_TX_SAM_1_G:
              t_ALC_Offset = 4;  
              break;
      case MSG_CONFIG_TX_EPS_2:
      case MSG_CONFIG_TX_EPS_3:
      case MSG_CONFIG_TX_EPS_4:
      case MSG_CONFIG_TX_RLCR_3: 
      case MSG_CONFIG_TX_RLCR_4:  
      case MSG_CONFIG_TX_RLCR_5:  
      case MSG_CONFIG_TX_RLCR_6:  
      case MSG_CONFIG_TX_RLCR_7:  
      case MSG_CONFIG_TX_RRCR_2:  
      case MSG_CONFIG_TX_RRCR_3:  
      case MSG_CONFIG_TX_RRCR_4:  
      case MSG_CONFIG_TX_RRCR_5:  
      case MSG_CONFIG_TX_RRCR_6:
      case MSG_CONFIG_TX_RLCR_1:  
      case MSG_CONFIG_TX_RLCR_8:  
      case MSG_CONFIG_TX_RLCR_9:  
      case MSG_CONFIG_TX_RRCR_1:  
      case MSG_CONFIG_TX_RRCR_7:  
      case MSG_CONFIG_TX_RRCR_8:   
      case MSG_CONFIG_TX_TCU_4:    
      case MSG_CONFIG_TX_IPB_11: 
      case MSG_CONFIG_TX_EMS_6:    
      case MSG_CONFIG_TX_EMS_2_G: 
      case MSG_CONFIG_TX_DMS_1: 
      case MSG_CONFIG_TX_VCU_6: 
      case MSG_CONFIG_TX_HCU_17:
              t_ALC_Offset = 0;
              break;
      case MSG_CONFIG_TX_HCU_6:
	  case MSG_CONFIG_TX_Z_FCM_FRM_6:
	  case MSG_CONFIG_TX_Z_EPB_State_R:	  
              t_ALC_Offset = 0;
              break;
      default: 
              t_ALC_Offset = 1;
              break;
    }
    
    
    if (t_ALC_Offset == 0)
    {
      t_LastSeqCounter = (MSG.byte(t_ALC_position) & 0x0F); 
    }
    else if (t_ALC_Offset == 4)
    {
      t_LastSeqCounter = (MSG.byte(t_ALC_position) & 0xF0) >>4; 
    }
      
    /* Rolling Counter */
    if ( (@Error_panel_vehicle::i_TOError[MSGIndex] == 0)
        && (@Error_panel_vehicle::i_CRC_CHKError[MSGIndex] == 0)
        && (@Error_panel_vehicle::i_MCError[MSGIndex]))
    {
        if (@Error_panel_vehicle::i_MCErrorCounter[MSGIndex] > 0)
        {
            @Error_panel_vehicle::i_MCErrorCounter[MSGIndex] --;
        }
        
        
        if (@Error_panel_vehicle::i_MCErrorCounter[MSGIndex] ==0)
        {
            @Error_panel_vehicle::i_MCError[MSGIndex] = 0;
            @Error_panel_vehicle::i_MCErrorCounter[MSGIndex] = -1;
        }
    }
    else
    {
      
        t_LastSeqCounter = (t_LastSeqCounter +1) % 16;
    }

    if (t_ALC_Offset == 0)
    {
      MSG.byte(t_ALC_position) = (MSG.byte(t_ALC_position) & 0xF0) | (t_LastSeqCounter);  
    }
    else if (t_ALC_Offset == 4)
    {
      MSG.byte(t_ALC_position) = (MSG.byte(t_ALC_position) & 0x0F) | (t_LastSeqCounter <<4); 
    }
    
    
  }
}


PROJ_Sim_Checksum(int MSGIndex, message* MSG)
{
if ((PROJ_MSG_E2E_TX_ARR[MSGIndex].PROJ_E2E_TYPE == E2E_CRC8))
  {
    int msg_length;
    int t_cycle;
    int index;
    word data1_id_t;
		byte data1_id[2];
		byte data1_temp[64];
		byte index1_t;
		byte t_length1;
		word t_CRC16_value; 
    byte t_CRC8_value;
    byte t_DataPtr[64];
    byte t_length_ub;
    byte i;
    msg_length = MSG.DataLength;
    if(MSGIndex== 35)//MSG_CONFIG_TX_MFS_2,data_length=5,CRC Position=0,ALC counter position=1
    {
      
    for (i=1;i< msg_length;i++)
      {
        t_DataPtr[i] = MSG.byte(i);
      }
    }
    else if(MSGIndex== 15)//MSG_CONFIG_TX_EMS_6,data_length=8,CRC Position=3,ALC counter position=2
    {
      
	  for (i=0;i< 3;i++)
      {
        t_DataPtr[i] = MSG.byte(i);
      }
	  for (i=4;i< 8;i++)
      {
        t_DataPtr[i] = MSG.byte(i);
      }
    } 
	 else 
    {
       for (i=0;i< msg_length-1;i++)
      {
        t_DataPtr[i] = MSG.byte(i);
      }
    }
      
    t_CRC8_value = PROJ_CHK_SAE_J1850_0x1D(msg_length-1, t_DataPtr);
 
      
    if((@Error_panel_vehicle::i_TOError[MSGIndex] ==0)
          &&(@Error_panel_vehicle::i_CRC_CHKError[MSGIndex]))
      {
          if (@Error_panel_vehicle::i_CHKErrorCounter[MSGIndex] > 0)
          {
            @Error_panel_vehicle::i_CHKErrorCounter[MSGIndex] --;
          }

          if (@Error_panel_vehicle::i_CHKErrorCounter[MSGIndex] == 0)
          {
            @Error_panel_vehicle::i_CRC_CHKError[MSGIndex] = 0;
            @Error_panel_vehicle::i_CHKErrorCounter[MSGIndex] = -1;
          }

          t_CRC8_value = t_CRC8_value +1;
      }
      else
      {
          //Do nothing 
      }
      
      {
        byte t_CRC_Position;
        byte t_CRC_Offset;
     switch(MSGIndex)
    {

      case MSG_CONFIG_TX_CLM_2:
      case MSG_CONFIG_TX_EMS_2_G:
      case MSG_CONFIG_TX_EPS_2:
      case MSG_CONFIG_TX_EPS_3:
      case MSG_CONFIG_TX_EPS_4:
      case MSG_CONFIG_TX_RLCR_1:
      case MSG_CONFIG_TX_RLCR_8:
      case MSG_CONFIG_TX_RLCR_9:
      case MSG_CONFIG_TX_RRCR_1:
      case MSG_CONFIG_TX_RRCR_7:
      case MSG_CONFIG_TX_RRCR_8:
      case MSG_CONFIG_TX_TCU_4:
      case MSG_CONFIG_TX_IPB_11:
      case MSG_CONFIG_TX_DMS_1:
      case MSG_CONFIG_TX_VCU_6:
      case MSG_CONFIG_TX_HCU_17:
      case MSG_CONFIG_TX_SAM_1_G:
	  case MSG_CONFIG_TX_Z_FCM_FRM_6:
              t_CRC_Position = 7;  
              break;
      case MSG_CONFIG_TX_HCU_6: 
              t_CRC_Position = 31;  
              break;
      case MSG_CONFIG_TX_RLCR_3: 
      case MSG_CONFIG_TX_RLCR_4:  
      case MSG_CONFIG_TX_RLCR_5:  
      case MSG_CONFIG_TX_RLCR_6:  
      case MSG_CONFIG_TX_RLCR_7:  
      case MSG_CONFIG_TX_RRCR_2:  
      case MSG_CONFIG_TX_RRCR_3:  
      case MSG_CONFIG_TX_RRCR_4:  
      case MSG_CONFIG_TX_RRCR_5:  
      case MSG_CONFIG_TX_RRCR_6: 
              t_CRC_Position = 23;
              break;  
      case MSG_CONFIG_TX_EMS_6: 
              t_CRC_Position = 3;
              break;
      default: 
              t_CRC_Position = 0;
              break;
    }
      
        MSG.byte(t_CRC_Position) = t_CRC8_value;

      } 
    }  
else if ((PROJ_MSG_E2E_TX_ARR[MSGIndex].PROJ_E2E_TYPE == E2E_CRC8_MULT))
  {
    int msg_length;
    int t_cycle;
    int index;
    word data1_id_t;
		byte data1_id[2];
		byte data1_temp[64];
		byte index1_t;
		byte t_length1; 
    msg_length = MSG.DataLength;
    t_cycle = 4;//????VCU_2 ????crc
    for (index=0; index< t_cycle; index ++)
    {
      byte t_CRC_value;
      byte t_DataPtr[64];
      byte t_length_ub;
      byte i;
 
      t_length_ub = MSG.DataLength;
      for (i=1;i< 8;i++)
      {
        t_DataPtr[i] = MSG.byte((index*8)+i);
      }
      
      
      t_CRC_value = PROJ_CHK_SAE_J1850_0x1D(7, t_DataPtr);
 
	 
      
      if((@Error_panel_vehicle::i_TOError[MSGIndex] ==0)
          &&(@Error_panel_vehicle::i_CRC_CHKError[MSGIndex]))
      {
          if (@Error_panel_vehicle::i_CHKErrorCounter[MSGIndex] > 0)
          {
            @Error_panel_vehicle::i_CHKErrorCounter[MSGIndex] --;
          }

          if (@Error_panel_vehicle::i_CHKErrorCounter[MSGIndex] == 0)
          {
            @Error_panel_vehicle::i_CRC_CHKError[MSGIndex] = 0;
            @Error_panel_vehicle::i_CHKErrorCounter[MSGIndex] = -1;
          }

          t_CRC_value = t_CRC_value +1;
      }
      else
      {
          //Do nothing 
      }
      
      {
        byte t_CRC_Position;
        byte t_CRC_Offset;
        
        t_CRC_Position = 8*index;
      
        MSG.byte(t_CRC_Position) = t_CRC_value;
  		}
  

      
    }
    } 
  else if ((PROJ_MSG_E2E_TX_ARR[MSGIndex].PROJ_E2E_TYPE == E2E_XOR)&MSGIndex!= 25)
  {

    byte t_CRC8_value;
    byte t_CRC_position;
    byte t_CRC_flag;
    switch(MSGIndex)
    {  
      case MSG_CONFIG_TX_ABS_ESP_3:
      case MSG_CONFIG_TX_ABS_ESP_4:   
      case MSG_CONFIG_TX_ABS_ESP_7:
      case MSG_CONFIG_TX_ABS_ESP_8:   
      case MSG_CONFIG_TX_ICM_5:
      case MSG_CONFIG_TX_TCU_2:
      case MSG_CONFIG_TX_EMS_3:
              t_CRC_flag=0;
              t_CRC_position = 7; 
              break;
      case MSG_CONFIG_TX_ABS_ESP_1:
              t_CRC_flag=1;  
              t_CRC_position = 5;   
              break;
      case MSG_CONFIG_TX_BCM_1: 
              t_CRC_flag=2;
              t_CRC_position = 1;   
              break;
      case MSG_CONFIG_TX_YAS_1: 
              t_CRC_flag=3;
              t_CRC_position = 7;   
              break;
      case MSG_CONFIG_TX_YAS_2: 
              t_CRC_flag=4;
              t_CRC_position = 7; 
              break;
      case MSG_CONFIG_TX_EMS_1: 
              t_CRC_flag=5;
              t_CRC_position = 2;    
              break;
      default: 
              t_CRC_flag=5;
              t_CRC_position = 0;
              break;
    }
  if(t_CRC_flag == 0)
  {

    t_CRC8_value=((MSG.byte(0)+MSG.byte(1)+MSG.byte(2)+MSG.byte(3)+MSG.byte(4)+MSG.byte(5)+MSG.byte(6))&0xFF)^0xFF;
  }
  else if (t_CRC_flag == 1)
  {
    t_CRC8_value=((MSG.byte(0)+MSG.byte(1)+MSG.byte(2)+MSG.byte(3)+MSG.byte(4)+MSG.byte(6)+MSG.byte(7))&0xFF)^0xFF;
  }
  else if (t_CRC_flag == 2)
  {
    t_CRC8_value=((MSG.byte(0)+MSG.byte(2)+MSG.byte(3)+MSG.byte(4)+MSG.byte(5)+MSG.byte(6)+MSG.byte(7))&0xFF)^0xFF;
  }
  else if (t_CRC_flag == 3)
  {
   t_CRC8_value=0x01^0x27^MSG.byte(0)^MSG.byte(1) ^MSG.byte(2) ^MSG.byte(3) ^MSG.byte(4) ^MSG.byte(5) ^MSG.byte(6); 
  }
  else if (t_CRC_flag == 4)
  {
   t_CRC8_value=0x01^0x28^MSG.byte(0)^MSG.byte(1) ^MSG.byte(2) ^MSG.byte(3) ^MSG.byte(4) ^MSG.byte(5) ^MSG.byte(6); 
  }
  else if (t_CRC_flag == 5)
  {
   t_CRC8_value=((MSG.byte(0)+MSG.byte(1)+MSG.byte(3)+MSG.byte(4)+MSG.byte(5)+MSG.byte(6)+MSG.byte(7))&0xFF)^0xFF;
  }
  else
  {
  }
          
  if((@Error_panel_vehicle::i_TOError[MSGIndex] ==0)
        &&(@Error_panel_vehicle::i_CRC_CHKError[MSGIndex]))
    {
        if (@Error_panel_vehicle::i_CHKErrorCounter[MSGIndex] > 0)
        {
          @Error_panel_vehicle::i_CHKErrorCounter[MSGIndex] --;
        }

        if (@Error_panel_vehicle::i_CHKErrorCounter[MSGIndex] == 0)
        {
          @Error_panel_vehicle::i_CRC_CHKError[MSGIndex] = 0;
          @Error_panel_vehicle::i_CHKErrorCounter[MSGIndex] = -1;
        }

        t_CRC8_value = t_CRC8_value +1;
    }
    else
    {
        //Do nothing 
    }
    
    {
    
      MSG.byte(t_CRC_position) = t_CRC8_value;

    } 
  }
}


//--------------------------------------------------


//--------------------------------------------------

PROJ_CalcMsg_ABS_ESP_1()
{
	/* ABS_ESP_1_ABSActive */
	if(!@Vehicle_Signals::i_ABS_ESP_1_ABSActive_SIM)
	{
		if(@Vehicle_Signals::i_ABS_ESP_1_ABSActive_EN)
		{
			ABS_ESP_1.ABS_ESP_1_ABSActive = @Vehicle_Signals::i_ABS_ESP_1_ABSActive_Raw;
		}
		else
		{
			ABS_ESP_1.ABS_ESP_1_ABSActive.phys = @Vehicle_Signals::i_ABS_ESP_1_ABSActive;
		}
	}
	else
	{
		// To be completed in simulation
	}

	/* ABS_ESP_1_ABSFailSts */
	if(!@Vehicle_Signals::i_ABS_ESP_1_ABSFailSts_SIM)
	{
		if(@Vehicle_Signals::i_ABS_ESP_1_ABSFailSts_EN)
		{
			ABS_ESP_1.ABS_ESP_1_ABSFailSts = @Vehicle_Signals::i_ABS_ESP_1_ABSFailSts_Raw;
		}
		else
		{
			ABS_ESP_1.ABS_ESP_1_ABSFailSts.phys = @Vehicle_Signals::i_ABS_ESP_1_ABSFailSts;
		}
	}
	else
	{
		// To be completed in simulation
	}

	/* ABS_ESP_1_EBDFailSts */
	if(!@Vehicle_Signals::i_ABS_ESP_1_EBDFailSts_SIM)
	{
		if(@Vehicle_Signals::i_ABS_ESP_1_EBDFailSts_EN)
		{
			ABS_ESP_1.ABS_ESP_1_EBDFailSts = @Vehicle_Signals::i_ABS_ESP_1_EBDFailSts_Raw;
		}
		else
		{
			ABS_ESP_1.ABS_ESP_1_EBDFailSts.phys = @Vehicle_Signals::i_ABS_ESP_1_EBDFailSts;
		}
	}
	else
	{
		// To be completed in simulation
	}

	/* ABS_ESP_1_ESPSwitchStatus */
	if(!@Vehicle_Signals::i_ABS_ESP_1_ESPSwitchStatus_SIM)
	{
		if(@Vehicle_Signals::i_ABS_ESP_1_ESPSwitchStatus_EN)
		{
			ABS_ESP_1.ABS_ESP_1_ESPSwitchStatus = @Vehicle_Signals::i_ABS_ESP_1_ESPSwitchStatus_Raw;
		}
		else
		{
			ABS_ESP_1.ABS_ESP_1_ESPSwitchStatus.phys = @Vehicle_Signals::i_ABS_ESP_1_ESPSwitchStatus;
		}
	}
	else
	{
		// To be completed in simulation
	}

	/* ABS_ESP_1_HDCCtrlSts */
	if(!@Vehicle_Signals::i_ABS_ESP_1_HDCCtrlSts_SIM)
	{
		if(@Vehicle_Signals::i_ABS_ESP_1_HDCCtrlSts_EN)
		{
			ABS_ESP_1.ABS_ESP_1_HDCCtrlSts = @Vehicle_Signals::i_ABS_ESP_1_HDCCtrlSts_Raw;
		}
		else
		{
			ABS_ESP_1.ABS_ESP_1_HDCCtrlSts.phys = @Vehicle_Signals::i_ABS_ESP_1_HDCCtrlSts;
		}
	}
	else
	{
		// To be completed in simulation
	}

	/* ABS_ESP_1_HDCFailSts */
	if(!@Vehicle_Signals::i_ABS_ESP_1_HDCFailSts_SIM)
	{
		if(@Vehicle_Signals::i_ABS_ESP_1_HDCFailSts_EN)
		{
			ABS_ESP_1.ABS_ESP_1_HDCFailSts = @Vehicle_Signals::i_ABS_ESP_1_HDCFailSts_Raw;
		}
		else
		{
			ABS_ESP_1.ABS_ESP_1_HDCFailSts.phys = @Vehicle_Signals::i_ABS_ESP_1_HDCFailSts;
		}
	}
	else
	{
		// To be completed in simulation
	}

	/* ABS_ESP_1_PressureMasterCylinder */
	if(!@Vehicle_Signals::i_ABS_ESP_1_PressureMasterCylinder_SIM)
	{
		if(@Vehicle_Signals::i_ABS_ESP_1_PressureMasterCylinder_EN)
		{
			ABS_ESP_1.ABS_ESP_1_PressureMasterCylinder = @Vehicle_Signals::i_ABS_ESP_1_PressureMasterCylinder_Raw;
		}
		else
		{
			ABS_ESP_1.ABS_ESP_1_PressureMasterCylinder.phys = @Vehicle_Signals::i_ABS_ESP_1_PressureMasterCylinder;
		}
	}
	else
	{
		// To be completed in simulation
	}

	/* ABS_ESP_1_TCSActive */
	if(!@Vehicle_Signals::i_ABS_ESP_1_TCSActive_SIM)
	{
		if(@Vehicle_Signals::i_ABS_ESP_1_TCSActive_EN)
		{
			ABS_ESP_1.ABS_ESP_1_TCSActive = @Vehicle_Signals::i_ABS_ESP_1_TCSActive_Raw;
		}
		else
		{
			ABS_ESP_1.ABS_ESP_1_TCSActive.phys = @Vehicle_Signals::i_ABS_ESP_1_TCSActive;
		}
	}
	else
	{
		// To be completed in simulation
	}

	/* ABS_ESP_1_TCSFailSts */
	if(!@Vehicle_Signals::i_ABS_ESP_1_TCSFailSts_SIM)
	{
		if(@Vehicle_Signals::i_ABS_ESP_1_TCSFailSts_EN)
		{
			ABS_ESP_1.ABS_ESP_1_TCSFailSts = @Vehicle_Signals::i_ABS_ESP_1_TCSFailSts_Raw;
		}
		else
		{
			ABS_ESP_1.ABS_ESP_1_TCSFailSts.phys = @Vehicle_Signals::i_ABS_ESP_1_TCSFailSts;
		}
	}
	else
	{
		// To be completed in simulation
	}

	/* ABS_ESP_1_VDCActive */
	if(!@Vehicle_Signals::i_ABS_ESP_1_VDCActive_SIM)
	{
		if(@Vehicle_Signals::i_ABS_ESP_1_VDCActive_EN)
		{
			ABS_ESP_1.ABS_ESP_1_VDCActive = @Vehicle_Signals::i_ABS_ESP_1_VDCActive_Raw;
		}
		else
		{
			ABS_ESP_1.ABS_ESP_1_VDCActive.phys = @Vehicle_Signals::i_ABS_ESP_1_VDCActive;
		}
	}
	else
	{
		// To be completed in simulation
	}

	/* ABS_ESP_1_VDCFailSts */
	if(!@Vehicle_Signals::i_ABS_ESP_1_VDCFailSts_SIM)
	{
		if(@Vehicle_Signals::i_ABS_ESP_1_VDCFailSts_EN)
		{
			ABS_ESP_1.ABS_ESP_1_VDCFailSts = @Vehicle_Signals::i_ABS_ESP_1_VDCFailSts_Raw;
		}
		else
		{
			ABS_ESP_1.ABS_ESP_1_VDCFailSts.phys = @Vehicle_Signals::i_ABS_ESP_1_VDCFailSts;
		}
	}
	else
	{
		// To be completed in simulation
	}

	/* ABS_ESP_1_VehicleSpeedVSOSig */
	if(!@Vehicle_Signals::i_ABS_ESP_1_VehicleSpeedVSOSig_SIM)
	{
		if(@Vehicle_Signals::i_ABS_ESP_1_VehicleSpeedVSOSig_EN)
		{
			ABS_ESP_1.ABS_ESP_1_VehicleSpeedVSOSig = @Vehicle_Signals::i_ABS_ESP_1_VehicleSpeedVSOSig_Raw;
		}
		else
		{
			ABS_ESP_1.ABS_ESP_1_VehicleSpeedVSOSig.phys = @Vehicle_Signals::i_ABS_ESP_1_VehicleSpeedVSOSig;
		}
	}
	else
	{
		// To be completed in simulation
	}

	/* ESP1_PressureMasCylindValidData */
	if(!@Vehicle_Signals::i_ESP1_PressureMasCylindValidData_SIM)
	{
		if(@Vehicle_Signals::i_ESP1_PressureMasCylindValidData_EN)
		{
			ABS_ESP_1.ESP1_PressureMasCylindValidData = @Vehicle_Signals::i_ESP1_PressureMasCylindValidData_Raw;
		}
		else
		{
			ABS_ESP_1.ESP1_PressureMasCylindValidData.phys = @Vehicle_Signals::i_ESP1_PressureMasCylindValidData;
		}
	}
	else
	{
		// To be completed in simulation
	}

	/* ESP1_VehicleSpeedVSOSigValidData */
	if(!@Vehicle_Signals::i_ESP1_VehicleSpeedVSOSigValidData_SIM)
	{
		if(@Vehicle_Signals::i_ESP1_VehicleSpeedVSOSigValidData_EN)
		{
			ABS_ESP_1.ESP1_VehicleSpeedVSOSigValidData = @Vehicle_Signals::i_ESP1_VehicleSpeedVSOSigValidData_Raw;
		}
		else
		{
			ABS_ESP_1.ESP1_VehicleSpeedVSOSigValidData.phys = @Vehicle_Signals::i_ESP1_VehicleSpeedVSOSigValidData;
		}
	}
	else
	{
		// To be completed in simulation
	}

	/* SwitchOffCruiseControl */
	if(!@Vehicle_Signals::i_SwitchOffCruiseControl_SIM)
	{
		if(@Vehicle_Signals::i_SwitchOffCruiseControl_EN)
		{
			ABS_ESP_1.SwitchOffCruiseControl = @Vehicle_Signals::i_SwitchOffCruiseControl_Raw;
		}
		else
		{
			ABS_ESP_1.SwitchOffCruiseControl.phys = @Vehicle_Signals::i_SwitchOffCruiseControl;
		}
	}
	else
	{
		// To be completed in simulation
	}

	/* Rolling counter */
	PROJ_Sim_Rollingcounter(MSG_CONFIG_TX_ABS_ESP_1, ABS_ESP_1);

	/* CheckSum */
	PROJ_Sim_Checksum(MSG_CONFIG_TX_ABS_ESP_1, ABS_ESP_1);

	/* DLC Check */
	ABS_ESP_1.DataLength = @Error_panel_vehicle::i_DLCError[MSG_CONFIG_TX_ABS_ESP_1]?1:DBLookup(ABS_ESP_1).dlc;

}

PROJ_CalcMsg_ABS_ESP_3()
{
	/* ABS_ESP_3_AVHFailSts */
	if(!@Vehicle_Signals::i_ABS_ESP_3_AVHFailSts_SIM)
	{
		if(@Vehicle_Signals::i_ABS_ESP_3_AVHFailSts_EN)
		{
			ABS_ESP_3.ABS_ESP_3_AVHFailSts = @Vehicle_Signals::i_ABS_ESP_3_AVHFailSts_Raw;
		}
		else
		{
			ABS_ESP_3.ABS_ESP_3_AVHFailSts.phys = @Vehicle_Signals::i_ABS_ESP_3_AVHFailSts;
		}
	}
	else
	{
		// To be completed in simulation
	}

	/* ABS_ESP_3_AVHSts */
	if(!@Vehicle_Signals::i_ABS_ESP_3_AVHSts_SIM)
	{
		if(@Vehicle_Signals::i_ABS_ESP_3_AVHSts_EN)
		{
			ABS_ESP_3.ABS_ESP_3_AVHSts = @Vehicle_Signals::i_ABS_ESP_3_AVHSts_Raw;
		}
		else
		{
			ABS_ESP_3.ABS_ESP_3_AVHSts.phys = @Vehicle_Signals::i_ABS_ESP_3_AVHSts;
		}
	}
	else
	{
		// To be completed in simulation
	}

	/* NoBrakeForce */
	if(!@Vehicle_Signals::i_NoBrakeForce_SIM)
	{
		if(@Vehicle_Signals::i_NoBrakeForce_EN)
		{
			ABS_ESP_3.NoBrakeForce = @Vehicle_Signals::i_NoBrakeForce_Raw;
		}
		else
		{
			ABS_ESP_3.NoBrakeForce.phys = @Vehicle_Signals::i_NoBrakeForce;
		}
	}
	else
	{
		// To be completed in simulation
	}

	/* Rolling counter */
	PROJ_Sim_Rollingcounter(MSG_CONFIG_TX_ABS_ESP_3, ABS_ESP_3);

	/* CheckSum */
	PROJ_Sim_Checksum(MSG_CONFIG_TX_ABS_ESP_3, ABS_ESP_3);

	/* DLC Check */
	ABS_ESP_3.DataLength = @Error_panel_vehicle::i_DLCError[MSG_CONFIG_TX_ABS_ESP_3]?1:DBLookup(ABS_ESP_3).dlc;

}

PROJ_CalcMsg_ABS_ESP_4()
{
	/* ABAactive */
	if(!@Vehicle_Signals::i_ABAactive_SIM)
	{
		if(@Vehicle_Signals::i_ABAactive_EN)
		{
			ABS_ESP_4.ABAactive = @Vehicle_Signals::i_ABAactive_Raw;
		}
		else
		{
			ABS_ESP_4.ABAactive.phys = @Vehicle_Signals::i_ABAactive;
		}
	}
	else
	{
		// To be completed in simulation
	}

	/* ABAavailable */
	if(!@Vehicle_Signals::i_ABAavailable_SIM)
	{
		if(@Vehicle_Signals::i_ABAavailable_EN)
		{
			ABS_ESP_4.ABAavailable = @Vehicle_Signals::i_ABAavailable_Raw;
		}
		else
		{
			ABS_ESP_4.ABAavailable.phys = @Vehicle_Signals::i_ABAavailable;
		}
	}
	else
	{
		// To be completed in simulation
	}

	/* AWBactive */
	if(!@Vehicle_Signals::i_AWBactive_SIM)
	{
		if(@Vehicle_Signals::i_AWBactive_EN)
		{
			ABS_ESP_4.AWBactive = @Vehicle_Signals::i_AWBactive_Raw;
		}
		else
		{
			ABS_ESP_4.AWBactive.phys = @Vehicle_Signals::i_AWBactive;
		}
	}
	else
	{
		// To be completed in simulation
	}

	/* AWBavailable */
	if(!@Vehicle_Signals::i_AWBavailable_SIM)
	{
		if(@Vehicle_Signals::i_AWBavailable_EN)
		{
			ABS_ESP_4.AWBavailable = @Vehicle_Signals::i_AWBavailable_Raw;
		}
		else
		{
			ABS_ESP_4.AWBavailable.phys = @Vehicle_Signals::i_AWBavailable;
		}
	}
	else
	{
		// To be completed in simulation
	}

	/* CDDActive */
	if(!@Vehicle_Signals::i_CDDActive_SIM)
	{
		if(@Vehicle_Signals::i_CDDActive_EN)
		{
			ABS_ESP_4.CDDActive = @Vehicle_Signals::i_CDDActive_Raw;
		}
		else
		{
			ABS_ESP_4.CDDActive.phys = @Vehicle_Signals::i_CDDActive;
		}
	}
	else
	{
		// To be completed in simulation
	}

	/* CDDAvailable */
	if(!@Vehicle_Signals::i_CDDAvailable_SIM)
	{
		if(@Vehicle_Signals::i_CDDAvailable_EN)
		{
			ABS_ESP_4.CDDAvailable = @Vehicle_Signals::i_CDDAvailable_Raw;
		}
		else
		{
			ABS_ESP_4.CDDAvailable.phys = @Vehicle_Signals::i_CDDAvailable;
		}
	}
	else
	{
		// To be completed in simulation
	}

	/* DCFail */
	if(!@Vehicle_Signals::i_DCFail_SIM)
	{
		if(@Vehicle_Signals::i_DCFail_EN)
		{
			ABS_ESP_4.DCFail = @Vehicle_Signals::i_DCFail_Raw;
		}
		else
		{
			ABS_ESP_4.DCFail.phys = @Vehicle_Signals::i_DCFail;
		}
	}
	else
	{
		// To be completed in simulation
	}

	/* ECDTempOff */
	if(!@Vehicle_Signals::i_ECDTempOff_SIM)
	{
		if(@Vehicle_Signals::i_ECDTempOff_EN)
		{
			ABS_ESP_4.ECDTempOff = @Vehicle_Signals::i_ECDTempOff_Raw;
		}
		else
		{
			ABS_ESP_4.ECDTempOff.phys = @Vehicle_Signals::i_ECDTempOff;
		}
	}
	else
	{
		// To be completed in simulation
	}

	/* VLC_Active */
	if(!@Vehicle_Signals::i_VLC_Active_SIM)
	{
		if(@Vehicle_Signals::i_VLC_Active_EN)
		{
			ABS_ESP_4.VLC_Active = @Vehicle_Signals::i_VLC_Active_Raw;
		}
		else
		{
			ABS_ESP_4.VLC_Active.phys = @Vehicle_Signals::i_VLC_Active;
		}
	}
	else
	{
		// To be completed in simulation
	}

	/* VLC_Available */
	if(!@Vehicle_Signals::i_VLC_Available_SIM)
	{
		if(@Vehicle_Signals::i_VLC_Available_EN)
		{
			ABS_ESP_4.VLC_Available = @Vehicle_Signals::i_VLC_Available_Raw;
		}
		else
		{
			ABS_ESP_4.VLC_Available.phys = @Vehicle_Signals::i_VLC_Available;
		}
	}
	else
	{
		// To be completed in simulation
	}

	/* VLC_InternalTargetAcceleration */
	if(!@Vehicle_Signals::i_VLC_InternalTargetAcceleration_SIM)
	{
		if(@Vehicle_Signals::i_VLC_InternalTargetAcceleration_EN)
		{
			ABS_ESP_4.VLC_InternalTargetAcceleration = @Vehicle_Signals::i_VLC_InternalTargetAcceleration_Raw;
		}
		else
		{
			ABS_ESP_4.VLC_InternalTargetAcceleration.phys = @Vehicle_Signals::i_VLC_InternalTargetAcceleration;
		}
	}
	else
	{
		// To be completed in simulation
	}

	/* VehicleStandstill */
	if(!@Vehicle_Signals::i_VehicleStandstill_SIM)
	{
		if(@Vehicle_Signals::i_VehicleStandstill_EN)
		{
			ABS_ESP_4.VehicleStandstill = @Vehicle_Signals::i_VehicleStandstill_Raw;
		}
		else
		{
			ABS_ESP_4.VehicleStandstill.phys = @Vehicle_Signals::i_VehicleStandstill;
		}
	}
	else
	{
		// To be completed in simulation
	}

	/* Rolling counter */
	PROJ_Sim_Rollingcounter(MSG_CONFIG_TX_ABS_ESP_4, ABS_ESP_4);

	/* CheckSum */
	PROJ_Sim_Checksum(MSG_CONFIG_TX_ABS_ESP_4, ABS_ESP_4);

	/* DLC Check */
	ABS_ESP_4.DataLength = @Error_panel_vehicle::i_DLCError[MSG_CONFIG_TX_ABS_ESP_4]?1:DBLookup(ABS_ESP_4).dlc;

}

PROJ_CalcMsg_ABS_ESP_7()
{
	/* LHFWheelDriveDirection */
	if(!@Vehicle_Signals::i_LHFWheelDriveDirection_SIM)
	{
		if(@Vehicle_Signals::i_LHFWheelDriveDirection_EN)
		{
			ABS_ESP_7.LHFWheelDriveDirection = @Vehicle_Signals::i_LHFWheelDriveDirection_Raw;
		}
		else
		{
			ABS_ESP_7.LHFWheelDriveDirection.phys = @Vehicle_Signals::i_LHFWheelDriveDirection;
		}
	}
	else
	{
		// To be completed in simulation
	}

	/* LHFWheelSpeedRaw */
	if(!@Vehicle_Signals::i_LHFWheelSpeedRaw_SIM)
	{
		if(@Vehicle_Signals::i_LHFWheelSpeedRaw_EN)
		{
			ABS_ESP_7.LHFWheelSpeedRaw = @Vehicle_Signals::i_LHFWheelSpeedRaw_Raw;
		}
		else
		{
			ABS_ESP_7.LHFWheelSpeedRaw.phys = @Vehicle_Signals::i_LHFWheelSpeedRaw;
		}
	}
	else
	{
		// To be completed in simulation
	}

	/* LHFWheelSpeedRawValidData */
	if(!@Vehicle_Signals::i_LHFWheelSpeedRawValidData_SIM)
	{
		if(@Vehicle_Signals::i_LHFWheelSpeedRawValidData_EN)
		{
			ABS_ESP_7.LHFWheelSpeedRawValidData = @Vehicle_Signals::i_LHFWheelSpeedRawValidData_Raw;
		}
		else
		{
			ABS_ESP_7.LHFWheelSpeedRawValidData.phys = @Vehicle_Signals::i_LHFWheelSpeedRawValidData;
		}
	}
	else
	{
		// To be completed in simulation
	}

	/* QDCACC */
	if(!@Vehicle_Signals::i_QDCACC_SIM)
	{
		if(@Vehicle_Signals::i_QDCACC_EN)
		{
			ABS_ESP_7.QDCACC = @Vehicle_Signals::i_QDCACC_Raw;
		}
		else
		{
			ABS_ESP_7.QDCACC.phys = @Vehicle_Signals::i_QDCACC;
		}
	}
	else
	{
		// To be completed in simulation
	}

	/* RHFWheelDriveDirection */
	if(!@Vehicle_Signals::i_RHFWheelDriveDirection_SIM)
	{
		if(@Vehicle_Signals::i_RHFWheelDriveDirection_EN)
		{
			ABS_ESP_7.RHFWheelDriveDirection = @Vehicle_Signals::i_RHFWheelDriveDirection_Raw;
		}
		else
		{
			ABS_ESP_7.RHFWheelDriveDirection.phys = @Vehicle_Signals::i_RHFWheelDriveDirection;
		}
	}
	else
	{
		// To be completed in simulation
	}

	/* RHFWheelSpeedRaw */
	if(!@Vehicle_Signals::i_RHFWheelSpeedRaw_SIM)
	{
		if(@Vehicle_Signals::i_RHFWheelSpeedRaw_EN)
		{
			ABS_ESP_7.RHFWheelSpeedRaw = @Vehicle_Signals::i_RHFWheelSpeedRaw_Raw;
		}
		else
		{
			ABS_ESP_7.RHFWheelSpeedRaw.phys = @Vehicle_Signals::i_RHFWheelSpeedRaw;
		}
	}
	else
	{
		// To be completed in simulation
	}

	/* RHFWheelSpeedRawValidData */
	if(!@Vehicle_Signals::i_RHFWheelSpeedRawValidData_SIM)
	{
		if(@Vehicle_Signals::i_RHFWheelSpeedRawValidData_EN)
		{
			ABS_ESP_7.RHFWheelSpeedRawValidData = @Vehicle_Signals::i_RHFWheelSpeedRawValidData_Raw;
		}
		else
		{
			ABS_ESP_7.RHFWheelSpeedRawValidData.phys = @Vehicle_Signals::i_RHFWheelSpeedRawValidData;
		}
	}
	else
	{
		// To be completed in simulation
	}

	/* VLCFail */
	if(!@Vehicle_Signals::i_VLCFail_SIM)
	{
		if(@Vehicle_Signals::i_VLCFail_EN)
		{
			ABS_ESP_7.VLCFail = @Vehicle_Signals::i_VLCFail_Raw;
		}
		else
		{
			ABS_ESP_7.VLCFail.phys = @Vehicle_Signals::i_VLCFail;
		}
	}
	else
	{
		// To be completed in simulation
	}

	/* WheelBrakeForce */
	if(!@Vehicle_Signals::i_WheelBrakeForce_SIM)
	{
		if(@Vehicle_Signals::i_WheelBrakeForce_EN)
		{
			ABS_ESP_7.WheelBrakeForce = @Vehicle_Signals::i_WheelBrakeForce_Raw;
		}
		else
		{
			ABS_ESP_7.WheelBrakeForce.phys = @Vehicle_Signals::i_WheelBrakeForce;
		}
	}
	else
	{
		// To be completed in simulation
	}

	/* Rolling counter */
	PROJ_Sim_Rollingcounter(MSG_CONFIG_TX_ABS_ESP_7, ABS_ESP_7);

	/* CheckSum */
	PROJ_Sim_Checksum(MSG_CONFIG_TX_ABS_ESP_7, ABS_ESP_7);

	/* DLC Check */
	ABS_ESP_7.DataLength = @Error_panel_vehicle::i_DLCError[MSG_CONFIG_TX_ABS_ESP_7]?1:DBLookup(ABS_ESP_7).dlc;

}

PROJ_CalcMsg_ABS_ESP_8()
{
	/* ABPActive */
	if(!@Vehicle_Signals::i_ABPActive_SIM)
	{
		if(@Vehicle_Signals::i_ABPActive_EN)
		{
			ABS_ESP_8.ABPActive = @Vehicle_Signals::i_ABPActive_Raw;
		}
		else
		{
			ABS_ESP_8.ABPActive.phys = @Vehicle_Signals::i_ABPActive;
		}
	}
	else
	{
		// To be completed in simulation
	}

	/* ABPAvailable */
	if(!@Vehicle_Signals::i_ABPAvailable_SIM)
	{
		if(@Vehicle_Signals::i_ABPAvailable_EN)
		{
			ABS_ESP_8.ABPAvailable = @Vehicle_Signals::i_ABPAvailable_Raw;
		}
		else
		{
			ABS_ESP_8.ABPAvailable.phys = @Vehicle_Signals::i_ABPAvailable;
		}
	}
	else
	{
		// To be completed in simulation
	}

	/* AEBdecActive */
	if(!@Vehicle_Signals::i_AEBdecActive_SIM)
	{
		if(@Vehicle_Signals::i_AEBdecActive_EN)
		{
			ABS_ESP_8.AEBdecActive = @Vehicle_Signals::i_AEBdecActive_Raw;
		}
		else
		{
			ABS_ESP_8.AEBdecActive.phys = @Vehicle_Signals::i_AEBdecActive;
		}
	}
	else
	{
		// To be completed in simulation
	}

	/* AEBdecAvailable */
	if(!@Vehicle_Signals::i_AEBdecAvailable_SIM)
	{
		if(@Vehicle_Signals::i_AEBdecAvailable_EN)
		{
			ABS_ESP_8.AEBdecAvailable = @Vehicle_Signals::i_AEBdecAvailable_Raw;
		}
		else
		{
			ABS_ESP_8.AEBdecAvailable.phys = @Vehicle_Signals::i_AEBdecAvailable;
		}
	}
	else
	{
		// To be completed in simulation
	}

	/* LHRWheelDriveDirection */
	if(!@Vehicle_Signals::i_LHRWheelDriveDirection_SIM)
	{
		if(@Vehicle_Signals::i_LHRWheelDriveDirection_EN)
		{
			ABS_ESP_8.LHRWheelDriveDirection = @Vehicle_Signals::i_LHRWheelDriveDirection_Raw;
		}
		else
		{
			ABS_ESP_8.LHRWheelDriveDirection.phys = @Vehicle_Signals::i_LHRWheelDriveDirection;
		}
	}
	else
	{
		// To be completed in simulation
	}

	/* LHRWheelSpeedRaw */
	if(!@Vehicle_Signals::i_LHRWheelSpeedRaw_SIM)
	{
		if(@Vehicle_Signals::i_LHRWheelSpeedRaw_EN)
		{
			ABS_ESP_8.LHRWheelSpeedRaw = @Vehicle_Signals::i_LHRWheelSpeedRaw_Raw;
		}
		else
		{
			ABS_ESP_8.LHRWheelSpeedRaw.phys = @Vehicle_Signals::i_LHRWheelSpeedRaw;
		}
	}
	else
	{
		// To be completed in simulation
	}

	/* LHRWheelSpeedRawValidData */
	if(!@Vehicle_Signals::i_LHRWheelSpeedRawValidData_SIM)
	{
		if(@Vehicle_Signals::i_LHRWheelSpeedRawValidData_EN)
		{
			ABS_ESP_8.LHRWheelSpeedRawValidData = @Vehicle_Signals::i_LHRWheelSpeedRawValidData_Raw;
		}
		else
		{
			ABS_ESP_8.LHRWheelSpeedRawValidData.phys = @Vehicle_Signals::i_LHRWheelSpeedRawValidData;
		}
	}
	else
	{
		// To be completed in simulation
	}

	/* RHRWheelDriveDirection */
	if(!@Vehicle_Signals::i_RHRWheelDriveDirection_SIM)
	{
		if(@Vehicle_Signals::i_RHRWheelDriveDirection_EN)
		{
			ABS_ESP_8.RHRWheelDriveDirection = @Vehicle_Signals::i_RHRWheelDriveDirection_Raw;
		}
		else
		{
			ABS_ESP_8.RHRWheelDriveDirection.phys = @Vehicle_Signals::i_RHRWheelDriveDirection;
		}
	}
	else
	{
		// To be completed in simulation
	}

	/* RHRWheelSpeedRaw */
	if(!@Vehicle_Signals::i_RHRWheelSpeedRaw_SIM)
	{
		if(@Vehicle_Signals::i_RHRWheelSpeedRaw_EN)
		{
			ABS_ESP_8.RHRWheelSpeedRaw = @Vehicle_Signals::i_RHRWheelSpeedRaw_Raw;
		}
		else
		{
			ABS_ESP_8.RHRWheelSpeedRaw.phys = @Vehicle_Signals::i_RHRWheelSpeedRaw;
		}
	}
	else
	{
		// To be completed in simulation
	}

	/* RHRWheelSpeedRawValidData */
	if(!@Vehicle_Signals::i_RHRWheelSpeedRawValidData_SIM)
	{
		if(@Vehicle_Signals::i_RHRWheelSpeedRawValidData_EN)
		{
			ABS_ESP_8.RHRWheelSpeedRawValidData = @Vehicle_Signals::i_RHRWheelSpeedRawValidData_Raw;
		}
		else
		{
			ABS_ESP_8.RHRWheelSpeedRawValidData.phys = @Vehicle_Signals::i_RHRWheelSpeedRawValidData;
		}
	}
	else
	{
		// To be completed in simulation
	}

	/* Rolling counter */
	PROJ_Sim_Rollingcounter(MSG_CONFIG_TX_ABS_ESP_8, ABS_ESP_8);

	/* CheckSum */
	PROJ_Sim_Checksum(MSG_CONFIG_TX_ABS_ESP_8, ABS_ESP_8);

	/* DLC Check */
	ABS_ESP_8.DataLength = @Error_panel_vehicle::i_DLCError[MSG_CONFIG_TX_ABS_ESP_8]?1:DBLookup(ABS_ESP_8).dlc;

}

PROJ_CalcMsg_ABS_ESP_G()
{
	/* CDPActive */
	if(!@Vehicle_Signals::i_CDPActive_SIM)
	{
		if(@Vehicle_Signals::i_CDPActive_EN)
		{
			ABS_ESP_G.CDPActive = @Vehicle_Signals::i_CDPActive_Raw;
		}
		else
		{
			ABS_ESP_G.CDPActive.phys = @Vehicle_Signals::i_CDPActive;
		}
	}
	else
	{
		// To be completed in simulation
	}

	/* Rolling counter */
	PROJ_Sim_Rollingcounter(MSG_CONFIG_TX_ABS_ESP_G, ABS_ESP_G);

	/* CheckSum */
	PROJ_Sim_Checksum(MSG_CONFIG_TX_ABS_ESP_G, ABS_ESP_G);

	/* DLC Check */
	ABS_ESP_G.DataLength = @Error_panel_vehicle::i_DLCError[MSG_CONFIG_TX_ABS_ESP_G]?1:DBLookup(ABS_ESP_G).dlc;

}

PROJ_CalcMsg_BCM_1()
{
	/* AutoHighSpeedRequest */
	if(!@Vehicle_Signals::i_AutoHighSpeedRequest_SIM)
	{
		if(@Vehicle_Signals::i_AutoHighSpeedRequest_EN)
		{
			BCM_1.AutoHighSpeedRequest = @Vehicle_Signals::i_AutoHighSpeedRequest_Raw;
		}
		else
		{
			BCM_1.AutoHighSpeedRequest.phys = @Vehicle_Signals::i_AutoHighSpeedRequest;
		}
	}
	else
	{
		// To be completed in simulation
	}

	/* AutoLightSW */
	if(!@Vehicle_Signals::i_AutoLightSW_SIM)
	{
		if(@Vehicle_Signals::i_AutoLightSW_EN)
		{
			BCM_1.AutoLightSW = @Vehicle_Signals::i_AutoLightSW_Raw;
		}
		else
		{
			BCM_1.AutoLightSW.phys = @Vehicle_Signals::i_AutoLightSW;
		}
	}
	else
	{
		// To be completed in simulation
	}

	/* DirectionIndLeft */
	if(!@Vehicle_Signals::i_DirectionIndLeft_SIM)
	{
		if(@Vehicle_Signals::i_DirectionIndLeft_EN)
		{
			BCM_1.DirectionIndLeft = @Vehicle_Signals::i_DirectionIndLeft_Raw;
		}
		else
		{
			BCM_1.DirectionIndLeft.phys = @Vehicle_Signals::i_DirectionIndLeft;
		}
	}
	else
	{
		// To be completed in simulation
	}

	/* DirectionIndRight */
	if(!@Vehicle_Signals::i_DirectionIndRight_SIM)
	{
		if(@Vehicle_Signals::i_DirectionIndRight_EN)
		{
			BCM_1.DirectionIndRight = @Vehicle_Signals::i_DirectionIndRight_Raw;
		}
		else
		{
			BCM_1.DirectionIndRight.phys = @Vehicle_Signals::i_DirectionIndRight;
		}
	}
	else
	{
		// To be completed in simulation
	}

	/* DriverDoorLockSts */
	if(!@Vehicle_Signals::i_DriverDoorLockSts_SIM)
	{
		if(@Vehicle_Signals::i_DriverDoorLockSts_EN)
		{
			BCM_1.DriverDoorLockSts = @Vehicle_Signals::i_DriverDoorLockSts_Raw;
		}
		else
		{
			BCM_1.DriverDoorLockSts.phys = @Vehicle_Signals::i_DriverDoorLockSts;
		}
	}
	else
	{
		// To be completed in simulation
	}

	/* DriverDoorSts */
	if(!@Vehicle_Signals::i_DriverDoorSts_SIM)
	{
		if(@Vehicle_Signals::i_DriverDoorSts_EN)
		{
			BCM_1.DriverDoorSts = @Vehicle_Signals::i_DriverDoorSts_Raw;
		}
		else
		{
			BCM_1.DriverDoorSts.phys = @Vehicle_Signals::i_DriverDoorSts;
		}
	}
	else
	{
		// To be completed in simulation
	}

	/* DriverDoorStsQbit */
	if(!@Vehicle_Signals::i_DriverDoorStsQbit_SIM)
	{
		if(@Vehicle_Signals::i_DriverDoorStsQbit_EN)
		{
			BCM_1.DriverDoorStsQbit = @Vehicle_Signals::i_DriverDoorStsQbit_Raw;
		}
		else
		{
			BCM_1.DriverDoorStsQbit.phys = @Vehicle_Signals::i_DriverDoorStsQbit;
		}
	}
	else
	{
		// To be completed in simulation
	}

	/* FGHeat_Request_CommandFeedback */
	if(!@Vehicle_Signals::i_FGHeat_Request_CommandFeedback_SIM)
	{
		if(@Vehicle_Signals::i_FGHeat_Request_CommandFeedback_EN)
		{
			BCM_1.FGHeat_Request_CommandFeedback = @Vehicle_Signals::i_FGHeat_Request_CommandFeedback_Raw;
		}
		else
		{
			BCM_1.FGHeat_Request_CommandFeedback.phys = @Vehicle_Signals::i_FGHeat_Request_CommandFeedback;
		}
	}
	else
	{
		// To be completed in simulation
	}

	/* FlashSWSts */
	if(!@Vehicle_Signals::i_FlashSWSts_SIM)
	{
		if(@Vehicle_Signals::i_FlashSWSts_EN)
		{
			BCM_1.FlashSWSts = @Vehicle_Signals::i_FlashSWSts_Raw;
		}
		else
		{
			BCM_1.FlashSWSts.phys = @Vehicle_Signals::i_FlashSWSts;
		}
	}
	else
	{
		// To be completed in simulation
	}

	/* FrontFogLightSts */
	if(!@Vehicle_Signals::i_FrontFogLightSts_SIM)
	{
		if(@Vehicle_Signals::i_FrontFogLightSts_EN)
		{
			BCM_1.FrontFogLightSts = @Vehicle_Signals::i_FrontFogLightSts_Raw;
		}
		else
		{
			BCM_1.FrontFogLightSts.phys = @Vehicle_Signals::i_FrontFogLightSts;
		}
	}
	else
	{
		// To be completed in simulation
	}

	/* HMASW */
	if(!@Vehicle_Signals::i_HMASW_SIM)
	{
		if(@Vehicle_Signals::i_HMASW_EN)
		{
			BCM_1.HMASW = @Vehicle_Signals::i_HMASW_Raw;
		}
		else
		{
			BCM_1.HMASW.phys = @Vehicle_Signals::i_HMASW;
		}
	}
	else
	{
		// To be completed in simulation
	}

	/* HazardLightSW */
	if(!@Vehicle_Signals::i_HazardLightSW_SIM)
	{
		if(@Vehicle_Signals::i_HazardLightSW_EN)
		{
			BCM_1.HazardLightSW = @Vehicle_Signals::i_HazardLightSW_Raw;
		}
		else
		{
			BCM_1.HazardLightSW.phys = @Vehicle_Signals::i_HazardLightSW;
		}
	}
	else
	{
		// To be completed in simulation
	}

	/* HighBeamSWSts */
	if(!@Vehicle_Signals::i_HighBeamSWSts_SIM)
	{
		if(@Vehicle_Signals::i_HighBeamSWSts_EN)
		{
			BCM_1.HighBeamSWSts = @Vehicle_Signals::i_HighBeamSWSts_Raw;
		}
		else
		{
			BCM_1.HighBeamSWSts.phys = @Vehicle_Signals::i_HighBeamSWSts;
		}
	}
	else
	{
		// To be completed in simulation
	}

	/* HighBeamSts */
	if(!@Vehicle_Signals::i_HighBeamSts_SIM)
	{
		if(@Vehicle_Signals::i_HighBeamSts_EN)
		{
			BCM_1.HighBeamSts = @Vehicle_Signals::i_HighBeamSts_Raw;
		}
		else
		{
			BCM_1.HighBeamSts.phys = @Vehicle_Signals::i_HighBeamSts;
		}
	}
	else
	{
		// To be completed in simulation
	}

	/* HoodSts */
	if(!@Vehicle_Signals::i_HoodSts_SIM)
	{
		if(@Vehicle_Signals::i_HoodSts_EN)
		{
			BCM_1.HoodSts = @Vehicle_Signals::i_HoodSts_Raw;
		}
		else
		{
			BCM_1.HoodSts.phys = @Vehicle_Signals::i_HoodSts;
		}
	}
	else
	{
		// To be completed in simulation
	}

	/* KeySts */
	if(!@Vehicle_Signals::i_KeySts_SIM)
	{
		if(@Vehicle_Signals::i_KeySts_EN)
		{
			BCM_1.KeySts = @Vehicle_Signals::i_KeySts_Raw;
		}
		else
		{
			BCM_1.KeySts.phys = @Vehicle_Signals::i_KeySts;
		}
	}
	else
	{
		// To be completed in simulation
	}

	/* LHRdoorSts */
	if(!@Vehicle_Signals::i_LHRdoorSts_SIM)
	{
		if(@Vehicle_Signals::i_LHRdoorSts_EN)
		{
			BCM_1.LHRdoorSts = @Vehicle_Signals::i_LHRdoorSts_Raw;
		}
		else
		{
			BCM_1.LHRdoorSts.phys = @Vehicle_Signals::i_LHRdoorSts;
		}
	}
	else
	{
		// To be completed in simulation
	}

	/* LHTurnSW */
	if(!@Vehicle_Signals::i_LHTurnSW_SIM)
	{
		if(@Vehicle_Signals::i_LHTurnSW_EN)
		{
			BCM_1.LHTurnSW = @Vehicle_Signals::i_LHTurnSW_Raw;
		}
		else
		{
			BCM_1.LHTurnSW.phys = @Vehicle_Signals::i_LHTurnSW;
		}
	}
	else
	{
		// To be completed in simulation
	}

	/* LHTurnlightSts */
	if(!@Vehicle_Signals::i_LHTurnlightSts_SIM)
	{
		if(@Vehicle_Signals::i_LHTurnlightSts_EN)
		{
			BCM_1.LHTurnlightSts = @Vehicle_Signals::i_LHTurnlightSts_Raw;
		}
		else
		{
			BCM_1.LHTurnlightSts.phys = @Vehicle_Signals::i_LHTurnlightSts;
		}
	}
	else
	{
		// To be completed in simulation
	}

	/* LowBeamSts */
	if(!@Vehicle_Signals::i_LowBeamSts_SIM)
	{
		if(@Vehicle_Signals::i_LowBeamSts_EN)
		{
			BCM_1.LowBeamSts = @Vehicle_Signals::i_LowBeamSts_Raw;
		}
		else
		{
			BCM_1.LowBeamSts.phys = @Vehicle_Signals::i_LowBeamSts;
		}
	}
	else
	{
		// To be completed in simulation
	}

	/* PsngrDoorSts */
	if(!@Vehicle_Signals::i_PsngrDoorSts_SIM)
	{
		if(@Vehicle_Signals::i_PsngrDoorSts_EN)
		{
			BCM_1.PsngrDoorSts = @Vehicle_Signals::i_PsngrDoorSts_Raw;
		}
		else
		{
			BCM_1.PsngrDoorSts.phys = @Vehicle_Signals::i_PsngrDoorSts;
		}
	}
	else
	{
		// To be completed in simulation
	}

	/* RHRDoorSts */
	if(!@Vehicle_Signals::i_RHRDoorSts_SIM)
	{
		if(@Vehicle_Signals::i_RHRDoorSts_EN)
		{
			BCM_1.RHRDoorSts = @Vehicle_Signals::i_RHRDoorSts_Raw;
		}
		else
		{
			BCM_1.RHRDoorSts.phys = @Vehicle_Signals::i_RHRDoorSts;
		}
	}
	else
	{
		// To be completed in simulation
	}

	/* RHTurnSW */
	if(!@Vehicle_Signals::i_RHTurnSW_SIM)
	{
		if(@Vehicle_Signals::i_RHTurnSW_EN)
		{
			BCM_1.RHTurnSW = @Vehicle_Signals::i_RHTurnSW_Raw;
		}
		else
		{
			BCM_1.RHTurnSW.phys = @Vehicle_Signals::i_RHTurnSW;
		}
	}
	else
	{
		// To be completed in simulation
	}

	/* RHTurnlightSts */
	if(!@Vehicle_Signals::i_RHTurnlightSts_SIM)
	{
		if(@Vehicle_Signals::i_RHTurnlightSts_EN)
		{
			BCM_1.RHTurnlightSts = @Vehicle_Signals::i_RHTurnlightSts_Raw;
		}
		else
		{
			BCM_1.RHTurnlightSts.phys = @Vehicle_Signals::i_RHTurnlightSts;
		}
	}
	else
	{
		// To be completed in simulation
	}

	/* RainDetected */
	if(!@Vehicle_Signals::i_RainDetected_SIM)
	{
		if(@Vehicle_Signals::i_RainDetected_EN)
		{
			BCM_1.RainDetected = @Vehicle_Signals::i_RainDetected_Raw;
		}
		else
		{
			BCM_1.RainDetected.phys = @Vehicle_Signals::i_RainDetected;
		}
	}
	else
	{
		// To be completed in simulation
	}

	/* RearFogLightSts */
	if(!@Vehicle_Signals::i_RearFogLightSts_SIM)
	{
		if(@Vehicle_Signals::i_RearFogLightSts_EN)
		{
			BCM_1.RearFogLightSts = @Vehicle_Signals::i_RearFogLightSts_Raw;
		}
		else
		{
			BCM_1.RearFogLightSts.phys = @Vehicle_Signals::i_RearFogLightSts;
		}
	}
	else
	{
		// To be completed in simulation
	}

	/* ReverseGearSts */
	if(!@Vehicle_Signals::i_ReverseGearSts_SIM)
	{
		if(@Vehicle_Signals::i_ReverseGearSts_EN)
		{
			BCM_1.ReverseGearSts = @Vehicle_Signals::i_ReverseGearSts_Raw;
		}
		else
		{
			BCM_1.ReverseGearSts.phys = @Vehicle_Signals::i_ReverseGearSts;
		}
	}
	else
	{
		// To be completed in simulation
	}

	/* TrunkSts */
	if(!@Vehicle_Signals::i_TrunkSts_SIM)
	{
		if(@Vehicle_Signals::i_TrunkSts_EN)
		{
			BCM_1.TrunkSts = @Vehicle_Signals::i_TrunkSts_Raw;
		}
		else
		{
			BCM_1.TrunkSts.phys = @Vehicle_Signals::i_TrunkSts;
		}
	}
	else
	{
		// To be completed in simulation
	}

	/* WiperSts */
	if(!@Vehicle_Signals::i_WiperSts_SIM)
	{
		if(@Vehicle_Signals::i_WiperSts_EN)
		{
			BCM_1.WiperSts = @Vehicle_Signals::i_WiperSts_Raw;
		}
		else
		{
			BCM_1.WiperSts.phys = @Vehicle_Signals::i_WiperSts;
		}
	}
	else
	{
		// To be completed in simulation
	}

	/* Rolling counter */
	PROJ_Sim_Rollingcounter(MSG_CONFIG_TX_BCM_1, BCM_1);

	/* CheckSum */
	PROJ_Sim_Checksum(MSG_CONFIG_TX_BCM_1, BCM_1);

	/* DLC Check */
	BCM_1.DataLength = @Error_panel_vehicle::i_DLCError[MSG_CONFIG_TX_BCM_1]?1:DBLookup(BCM_1).dlc;

}

PROJ_CalcMsg_BCM_9()
{
	/* TrailerConnectSts */
	if(!@Vehicle_Signals::i_TrailerConnectSts_SIM)
	{
		if(@Vehicle_Signals::i_TrailerConnectSts_EN)
		{
			BCM_9.TrailerConnectSts = @Vehicle_Signals::i_TrailerConnectSts_Raw;
		}
		else
		{
			BCM_9.TrailerConnectSts.phys = @Vehicle_Signals::i_TrailerConnectSts;
		}
	}
	else
	{
		// To be completed in simulation
	}

	/* Rolling counter */
	PROJ_Sim_Rollingcounter(MSG_CONFIG_TX_BCM_9, BCM_9);

	/* CheckSum */
	PROJ_Sim_Checksum(MSG_CONFIG_TX_BCM_9, BCM_9);

	/* DLC Check */
	BCM_9.DataLength = @Error_panel_vehicle::i_DLCError[MSG_CONFIG_TX_BCM_9]?1:DBLookup(BCM_9).dlc;

}

PROJ_CalcMsg_CLM_2()
{
	/* CLM2_ExternalTempFailSts */
	if(!@Vehicle_Signals::i_CLM2_ExternalTempFailSts_SIM)
	{
		if(@Vehicle_Signals::i_CLM2_ExternalTempFailSts_EN)
		{
			CLM_2.CLM2_ExternalTempFailSts = @Vehicle_Signals::i_CLM2_ExternalTempFailSts_Raw;
		}
		else
		{
			CLM_2.CLM2_ExternalTempFailSts.phys = @Vehicle_Signals::i_CLM2_ExternalTempFailSts;
		}
	}
	else
	{
		// To be completed in simulation
	}

	/* CLM2_ExternalTemperature_C */
	if(!@Vehicle_Signals::i_CLM2_ExternalTemperature_C_SIM)
	{
		if(@Vehicle_Signals::i_CLM2_ExternalTemperature_C_EN)
		{
			CLM_2.CLM2_ExternalTemperature_C = @Vehicle_Signals::i_CLM2_ExternalTemperature_C_Raw;
		}
		else
		{
			CLM_2.CLM2_ExternalTemperature_C.phys = @Vehicle_Signals::i_CLM2_ExternalTemperature_C;
		}
	}
	else
	{
		// To be completed in simulation
	}

	/* Rolling counter */
	PROJ_Sim_Rollingcounter(MSG_CONFIG_TX_CLM_2, CLM_2);

	/* CheckSum */
	PROJ_Sim_Checksum(MSG_CONFIG_TX_CLM_2, CLM_2);

	/* DLC Check */
	CLM_2.DataLength = @Error_panel_vehicle::i_DLCError[MSG_CONFIG_TX_CLM_2]?1:DBLookup(CLM_2).dlc;

}

PROJ_CalcMsg_DMS_1()
{
	/* DMS_1_CameraSt */
	if(!@Vehicle_Signals::i_DMS_1_CameraSt_SIM)
	{
		if(@Vehicle_Signals::i_DMS_1_CameraSt_EN)
		{
			DMS_1.DMS_1_CameraSt = @Vehicle_Signals::i_DMS_1_CameraSt_Raw;
		}
		else
		{
			DMS_1.DMS_1_CameraSt.phys = @Vehicle_Signals::i_DMS_1_CameraSt;
		}
	}
	else
	{
		// To be completed in simulation
	}

	/* DMS_1_DMSSt */
	if(!@Vehicle_Signals::i_DMS_1_DMSSt_SIM)
	{
		if(@Vehicle_Signals::i_DMS_1_DMSSt_EN)
		{
			DMS_1.DMS_1_DMSSt = @Vehicle_Signals::i_DMS_1_DMSSt_Raw;
		}
		else
		{
			DMS_1.DMS_1_DMSSt.phys = @Vehicle_Signals::i_DMS_1_DMSSt;
		}
	}
	else
	{
		// To be completed in simulation
	}

	/* DMS_1_DriverSts */
	if(!@Vehicle_Signals::i_DMS_1_DriverSts_SIM)
	{
		if(@Vehicle_Signals::i_DMS_1_DriverSts_EN)
		{
			DMS_1.DMS_1_DriverSts = @Vehicle_Signals::i_DMS_1_DriverSts_Raw;
		}
		else
		{
			DMS_1.DMS_1_DriverSts.phys = @Vehicle_Signals::i_DMS_1_DriverSts;
		}
	}
	else
	{
		// To be completed in simulation
	}

	/* Rolling counter */
	PROJ_Sim_Rollingcounter(MSG_CONFIG_TX_DMS_1, DMS_1);

	/* CheckSum */
	PROJ_Sim_Checksum(MSG_CONFIG_TX_DMS_1, DMS_1);

	/* DLC Check */
	DMS_1.DataLength = @Error_panel_vehicle::i_DLCError[MSG_CONFIG_TX_DMS_1]?1:DBLookup(DMS_1).dlc;

}

PROJ_CalcMsg_EMS_1()
{
	/* AcceleratorPosRaw */
	if(!@Vehicle_Signals::i_AcceleratorPosRaw_SIM)
	{
		if(@Vehicle_Signals::i_AcceleratorPosRaw_EN)
		{
			EMS_1.AcceleratorPosRaw = @Vehicle_Signals::i_AcceleratorPosRaw_Raw;
		}
		else
		{
			EMS_1.AcceleratorPosRaw.phys = @Vehicle_Signals::i_AcceleratorPosRaw;
		}
	}
	else
	{
		// To be completed in simulation
	}

	/* CruiseControlStatus */
	if(!@Vehicle_Signals::i_CruiseControlStatus_SIM)
	{
		if(@Vehicle_Signals::i_CruiseControlStatus_EN)
		{
			EMS_1.CruiseControlStatus = @Vehicle_Signals::i_CruiseControlStatus_Raw;
		}
		else
		{
			EMS_1.CruiseControlStatus.phys = @Vehicle_Signals::i_CruiseControlStatus;
		}
	}
	else
	{
		// To be completed in simulation
	}

	/* ECFail */
	if(!@Vehicle_Signals::i_ECFail_SIM)
	{
		if(@Vehicle_Signals::i_ECFail_EN)
		{
			EMS_1.ECFail = @Vehicle_Signals::i_ECFail_Raw;
		}
		else
		{
			EMS_1.ECFail.phys = @Vehicle_Signals::i_ECFail;
		}
	}
	else
	{
		// To be completed in simulation
	}

	/* ECGPOvrd */
	if(!@Vehicle_Signals::i_ECGPOvrd_SIM)
	{
		if(@Vehicle_Signals::i_ECGPOvrd_EN)
		{
			EMS_1.ECGPOvrd = @Vehicle_Signals::i_ECGPOvrd_Raw;
		}
		else
		{
			EMS_1.ECGPOvrd.phys = @Vehicle_Signals::i_ECGPOvrd;
		}
	}
	else
	{
		// To be completed in simulation
	}

	/* EMS1_EngineSpeed */
	if(!@Vehicle_Signals::i_EMS1_EngineSpeed_SIM)
	{
		if(@Vehicle_Signals::i_EMS1_EngineSpeed_EN)
		{
			EMS_1.EMS1_EngineSpeed = @Vehicle_Signals::i_EMS1_EngineSpeed_Raw;
		}
		else
		{
			EMS_1.EMS1_EngineSpeed.phys = @Vehicle_Signals::i_EMS1_EngineSpeed;
		}
	}
	else
	{
		// To be completed in simulation
	}

	/* NeutralGearSts */
	if(!@Vehicle_Signals::i_NeutralGearSts_SIM)
	{
		if(@Vehicle_Signals::i_NeutralGearSts_EN)
		{
			EMS_1.NeutralGearSts = @Vehicle_Signals::i_NeutralGearSts_Raw;
		}
		else
		{
			EMS_1.NeutralGearSts.phys = @Vehicle_Signals::i_NeutralGearSts;
		}
	}
	else
	{
		// To be completed in simulation
	}

	/* Rolling counter */
	PROJ_Sim_Rollingcounter(MSG_CONFIG_TX_EMS_1, EMS_1);

	/* CheckSum */
	PROJ_Sim_Checksum(MSG_CONFIG_TX_EMS_1, EMS_1);

	/* DLC Check */
	EMS_1.DataLength = @Error_panel_vehicle::i_DLCError[MSG_CONFIG_TX_EMS_1]?1:DBLookup(EMS_1).dlc;

}

PROJ_CalcMsg_EMS_2()
{
	/* BrakePedalStsForTCU */
	if(!@Vehicle_Signals::i_BrakePedalStsForTCU_SIM)
	{
		if(@Vehicle_Signals::i_BrakePedalStsForTCU_EN)
		{
			EMS_2.BrakePedalStsForTCU = @Vehicle_Signals::i_BrakePedalStsForTCU_Raw;
		}
		else
		{
			EMS_2.BrakePedalStsForTCU.phys = @Vehicle_Signals::i_BrakePedalStsForTCU;
		}
	}
	else
	{
		// To be completed in simulation
	}

	/* BrakePedalStsValidDataForTCU */
	if(!@Vehicle_Signals::i_BrakePedalStsValidDataForTCU_SIM)
	{
		if(@Vehicle_Signals::i_BrakePedalStsValidDataForTCU_EN)
		{
			EMS_2.BrakePedalStsValidDataForTCU = @Vehicle_Signals::i_BrakePedalStsValidDataForTCU_Raw;
		}
		else
		{
			EMS_2.BrakePedalStsValidDataForTCU.phys = @Vehicle_Signals::i_BrakePedalStsValidDataForTCU;
		}
	}
	else
	{
		// To be completed in simulation
	}

	/* EngineStsForDCT */
	if(!@Vehicle_Signals::i_EngineStsForDCT_SIM)
	{
		if(@Vehicle_Signals::i_EngineStsForDCT_EN)
		{
			EMS_2.EngineStsForDCT = @Vehicle_Signals::i_EngineStsForDCT_Raw;
		}
		else
		{
			EMS_2.EngineStsForDCT.phys = @Vehicle_Signals::i_EngineStsForDCT;
		}
	}
	else
	{
		// To be completed in simulation
	}

	/* Rolling counter */
	PROJ_Sim_Rollingcounter(MSG_CONFIG_TX_EMS_2, EMS_2);

	/* CheckSum */
	PROJ_Sim_Checksum(MSG_CONFIG_TX_EMS_2, EMS_2);

	/* DLC Check */
	EMS_2.DataLength = @Error_panel_vehicle::i_DLCError[MSG_CONFIG_TX_EMS_2]?1:DBLookup(EMS_2).dlc;

}

PROJ_CalcMsg_EMS_2_G()
{
	/* GasPedalPosition */
	if(!@Vehicle_Signals::i_GasPedalPosition_SIM)
	{
		if(@Vehicle_Signals::i_GasPedalPosition_EN)
		{
			EMS_2_G.GasPedalPosition = @Vehicle_Signals::i_GasPedalPosition_Raw;
		}
		else
		{
			EMS_2_G.GasPedalPosition.phys = @Vehicle_Signals::i_GasPedalPosition;
		}
	}
	else
	{
		// To be completed in simulation
	}

	/* GasPedalPositionInvalidData */
	if(!@Vehicle_Signals::i_GasPedalPositionInvalidData_SIM)
	{
		if(@Vehicle_Signals::i_GasPedalPositionInvalidData_EN)
		{
			EMS_2_G.GasPedalPositionInvalidData = @Vehicle_Signals::i_GasPedalPositionInvalidData_Raw;
		}
		else
		{
			EMS_2_G.GasPedalPositionInvalidData.phys = @Vehicle_Signals::i_GasPedalPositionInvalidData;
		}
	}
	else
	{
		// To be completed in simulation
	}

	/* LimitSpeedSts */
	if(!@Vehicle_Signals::i_LimitSpeedSts_SIM)
	{
		if(@Vehicle_Signals::i_LimitSpeedSts_EN)
		{
			EMS_2_G.LimitSpeedSts = @Vehicle_Signals::i_LimitSpeedSts_Raw;
		}
		else
		{
			EMS_2_G.LimitSpeedSts.phys = @Vehicle_Signals::i_LimitSpeedSts;
		}
	}
	else
	{
		// To be completed in simulation
	}

	/* Rolling counter */
	PROJ_Sim_Rollingcounter(MSG_CONFIG_TX_EMS_2_G, EMS_2_G);

	/* CheckSum */
	PROJ_Sim_Checksum(MSG_CONFIG_TX_EMS_2_G, EMS_2_G);

	/* DLC Check */
	EMS_2_G.DataLength = @Error_panel_vehicle::i_DLCError[MSG_CONFIG_TX_EMS_2_G]?1:DBLookup(EMS_2_G).dlc;

}

PROJ_CalcMsg_EMS_3()
{
	/* EMS3_SSMStatus */
	if(!@Vehicle_Signals::i_EMS3_SSMStatus_SIM)
	{
		if(@Vehicle_Signals::i_EMS3_SSMStatus_EN)
		{
			EMS_3.EMS3_SSMStatus = @Vehicle_Signals::i_EMS3_SSMStatus_Raw;
		}
		else
		{
			EMS_3.EMS3_SSMStatus.phys = @Vehicle_Signals::i_EMS3_SSMStatus;
		}
	}
	else
	{
		// To be completed in simulation
	}

	/* Rolling counter */
	PROJ_Sim_Rollingcounter(MSG_CONFIG_TX_EMS_3, EMS_3);

	/* CheckSum */
	PROJ_Sim_Checksum(MSG_CONFIG_TX_EMS_3, EMS_3);

	/* DLC Check */
	EMS_3.DataLength = @Error_panel_vehicle::i_DLCError[MSG_CONFIG_TX_EMS_3]?1:DBLookup(EMS_3).dlc;

}

PROJ_CalcMsg_EMS_6()
{
	/* BrakePedalStsForTCU */
	if(!@Vehicle_Signals::i_BrakePedalStsForTCU_SIM)
	{
		if(@Vehicle_Signals::i_BrakePedalStsForTCU_EN)
		{
			EMS_6.BrakePedalStsForTCU = @Vehicle_Signals::i_BrakePedalStsForTCU_Raw;
		}
		else
		{
			EMS_6.BrakePedalStsForTCU.phys = @Vehicle_Signals::i_BrakePedalStsForTCU;
		}
	}
	else
	{
		// To be completed in simulation
	}

	/* BrakePedalStsValidDataForTCU */
	if(!@Vehicle_Signals::i_BrakePedalStsValidDataForTCU_SIM)
	{
		if(@Vehicle_Signals::i_BrakePedalStsValidDataForTCU_EN)
		{
			EMS_6.BrakePedalStsValidDataForTCU = @Vehicle_Signals::i_BrakePedalStsValidDataForTCU_Raw;
		}
		else
		{
			EMS_6.BrakePedalStsValidDataForTCU.phys = @Vehicle_Signals::i_BrakePedalStsValidDataForTCU;
		}
	}
	else
	{
		// To be completed in simulation
	}

	/* ECGPOvrd */
	if(!@Vehicle_Signals::i_ECGPOvrd_SIM)
	{
		if(@Vehicle_Signals::i_ECGPOvrd_EN)
		{
			EMS_6.ECGPOvrd = @Vehicle_Signals::i_ECGPOvrd_Raw;
		}
		else
		{
			EMS_6.ECGPOvrd.phys = @Vehicle_Signals::i_ECGPOvrd;
		}
	}
	else
	{
		// To be completed in simulation
	}

	/* ECGPOvrdInvalidData */
	if(!@Vehicle_Signals::i_ECGPOvrdInvalidData_SIM)
	{
		if(@Vehicle_Signals::i_ECGPOvrdInvalidData_EN)
		{
			EMS_6.ECGPOvrdInvalidData = @Vehicle_Signals::i_ECGPOvrdInvalidData_Raw;
		}
		else
		{
			EMS_6.ECGPOvrdInvalidData.phys = @Vehicle_Signals::i_ECGPOvrdInvalidData;
		}
	}
	else
	{
		// To be completed in simulation
	}

	/* Rolling counter */
	PROJ_Sim_Rollingcounter(MSG_CONFIG_TX_EMS_6, EMS_6);

	/* CheckSum */
	PROJ_Sim_Checksum(MSG_CONFIG_TX_EMS_6, EMS_6);

	/* DLC Check */
	EMS_6.DataLength = @Error_panel_vehicle::i_DLCError[MSG_CONFIG_TX_EMS_6]?1:DBLookup(EMS_6).dlc;

}

PROJ_CalcMsg_EPB_G()
{
	/* EPBErrorStatus */
	if(!@Vehicle_Signals::i_EPBErrorStatus_SIM)
	{
		if(@Vehicle_Signals::i_EPBErrorStatus_EN)
		{
			EPB_G.EPBErrorStatus = @Vehicle_Signals::i_EPBErrorStatus_Raw;
		}
		else
		{
			EPB_G.EPBErrorStatus.phys = @Vehicle_Signals::i_EPBErrorStatus;
		}
	}
	else
	{
		// To be completed in simulation
	}

	/* EPBStatus */
	if(!@Vehicle_Signals::i_EPBStatus_SIM)
	{
		if(@Vehicle_Signals::i_EPBStatus_EN)
		{
			EPB_G.EPBStatus = @Vehicle_Signals::i_EPBStatus_Raw;
		}
		else
		{
			EPB_G.EPBStatus.phys = @Vehicle_Signals::i_EPBStatus;
		}
	}
	else
	{
		// To be completed in simulation
	}

	/* EPBStatus */
	if(!@Vehicle_Signals::i_EPBStatus_SIM)
	{
		if(@Vehicle_Signals::i_EPBStatus_EN)
		{
			EPB_G.EPBStatus = @Vehicle_Signals::i_EPBStatus_Raw;
		}
		else
		{
			EPB_G.EPBStatus.phys = @Vehicle_Signals::i_EPBStatus;
		}
	}
	else
	{
		// To be completed in simulation
	}

	/* RWUActive */
	if(!@Vehicle_Signals::i_RWUActive_SIM)
	{
		if(@Vehicle_Signals::i_RWUActive_EN)
		{
			EPB_G.RWUActive = @Vehicle_Signals::i_RWUActive_Raw;
		}
		else
		{
			EPB_G.RWUActive.phys = @Vehicle_Signals::i_RWUActive;
		}
	}
	else
	{
		// To be completed in simulation
	}

	/* Rolling counter */
	PROJ_Sim_Rollingcounter(MSG_CONFIG_TX_EPB_G, EPB_G);

	/* CheckSum */
	PROJ_Sim_Checksum(MSG_CONFIG_TX_EPB_G, EPB_G);

	/* DLC Check */
	EPB_G.DataLength = @Error_panel_vehicle::i_DLCError[MSG_CONFIG_TX_EPB_G]?1:DBLookup(EPB_G).dlc;

}

PROJ_CalcMsg_EPS_1()
{
	/* EPSFailSts */
	if(!@Vehicle_Signals::i_EPSFailSts_SIM)
	{
		if(@Vehicle_Signals::i_EPSFailSts_EN)
		{
			EPS_1.EPSFailSts = @Vehicle_Signals::i_EPSFailSts_Raw;
		}
		else
		{
			EPS_1.EPSFailSts.phys = @Vehicle_Signals::i_EPSFailSts;
		}
	}
	else
	{
		// To be completed in simulation
	}

	/* EPSSteeringAngleCalibrationSts */
	if(!@Vehicle_Signals::i_EPSSteeringAngleCalibrationSts_SIM)
	{
		if(@Vehicle_Signals::i_EPSSteeringAngleCalibrationSts_EN)
		{
			EPS_1.EPSSteeringAngleCalibrationSts = @Vehicle_Signals::i_EPSSteeringAngleCalibrationSts_Raw;
		}
		else
		{
			EPS_1.EPSSteeringAngleCalibrationSts.phys = @Vehicle_Signals::i_EPSSteeringAngleCalibrationSts;
		}
	}
	else
	{
		// To be completed in simulation
	}

	/* EPS_AssistanceStyle_Sts */
	if(!@Vehicle_Signals::i_EPS_AssistanceStyle_Sts_SIM)
	{
		if(@Vehicle_Signals::i_EPS_AssistanceStyle_Sts_EN)
		{
			EPS_1.EPS_AssistanceStyle_Sts = @Vehicle_Signals::i_EPS_AssistanceStyle_Sts_Raw;
		}
		else
		{
			EPS_1.EPS_AssistanceStyle_Sts.phys = @Vehicle_Signals::i_EPS_AssistanceStyle_Sts;
		}
	}
	else
	{
		// To be completed in simulation
	}

	/* Rolling counter */
	PROJ_Sim_Rollingcounter(MSG_CONFIG_TX_EPS_1, EPS_1);

	/* CheckSum */
	PROJ_Sim_Checksum(MSG_CONFIG_TX_EPS_1, EPS_1);

	/* DLC Check */
	EPS_1.DataLength = @Error_panel_vehicle::i_DLCError[MSG_CONFIG_TX_EPS_1]?1:DBLookup(EPS_1).dlc;

}

PROJ_CalcMsg_EPS_2()
{
	/* EpsControlStatus */
	if(!@Vehicle_Signals::i_EpsControlStatus_SIM)
	{
		if(@Vehicle_Signals::i_EpsControlStatus_EN)
		{
			EPS_2.EpsControlStatus = @Vehicle_Signals::i_EpsControlStatus_Raw;
		}
		else
		{
			EPS_2.EpsControlStatus.phys = @Vehicle_Signals::i_EpsControlStatus;
		}
	}
	else
	{
		// To be completed in simulation
	}

	/* TorsionBarTorque */
	if(!@Vehicle_Signals::i_TorsionBarTorque_SIM)
	{
		if(@Vehicle_Signals::i_TorsionBarTorque_EN)
		{
			EPS_2.TorsionBarTorque = @Vehicle_Signals::i_TorsionBarTorque_Raw;
		}
		else
		{
			EPS_2.TorsionBarTorque.phys = @Vehicle_Signals::i_TorsionBarTorque;
		}
	}
	else
	{
		// To be completed in simulation
	}

	/* TorsionBarTorqueDir */
	if(!@Vehicle_Signals::i_TorsionBarTorqueDir_SIM)
	{
		if(@Vehicle_Signals::i_TorsionBarTorqueDir_EN)
		{
			EPS_2.TorsionBarTorqueDir = @Vehicle_Signals::i_TorsionBarTorqueDir_Raw;
		}
		else
		{
			EPS_2.TorsionBarTorqueDir.phys = @Vehicle_Signals::i_TorsionBarTorqueDir;
		}
	}
	else
	{
		// To be completed in simulation
	}

	/* TosionBarTorqueValid */
	if(!@Vehicle_Signals::i_TosionBarTorqueValid_SIM)
	{
		if(@Vehicle_Signals::i_TosionBarTorqueValid_EN)
		{
			EPS_2.TosionBarTorqueValid = @Vehicle_Signals::i_TosionBarTorqueValid_Raw;
		}
		else
		{
			EPS_2.TosionBarTorqueValid.phys = @Vehicle_Signals::i_TosionBarTorqueValid;
		}
	}
	else
	{
		// To be completed in simulation
	}

	/* Rolling counter */
	PROJ_Sim_Rollingcounter(MSG_CONFIG_TX_EPS_2, EPS_2);

	/* CheckSum */
	PROJ_Sim_Checksum(MSG_CONFIG_TX_EPS_2, EPS_2);

	/* DLC Check */
	EPS_2.DataLength = @Error_panel_vehicle::i_DLCError[MSG_CONFIG_TX_EPS_2]?1:DBLookup(EPS_2).dlc;

}

PROJ_CalcMsg_EPS_3()
{
	/* EPS_3_AgFailr */
	if(!@Vehicle_Signals::i_EPS_3_AgFailr_SIM)
	{
		if(@Vehicle_Signals::i_EPS_3_AgFailr_EN)
		{
			EPS_3.EPS_3_AgFailr = @Vehicle_Signals::i_EPS_3_AgFailr_Raw;
		}
		else
		{
			EPS_3.EPS_3_AgFailr.phys = @Vehicle_Signals::i_EPS_3_AgFailr;
		}
	}
	else
	{
		// To be completed in simulation
	}

	/* EPS_3_StrngAgSpd */
	if(!@Vehicle_Signals::i_EPS_3_StrngAgSpd_SIM)
	{
		if(@Vehicle_Signals::i_EPS_3_StrngAgSpd_EN)
		{
			EPS_3.EPS_3_StrngAgSpd = @Vehicle_Signals::i_EPS_3_StrngAgSpd_Raw;
		}
		else
		{
			EPS_3.EPS_3_StrngAgSpd.phys = @Vehicle_Signals::i_EPS_3_StrngAgSpd;
		}
	}
	else
	{
		// To be completed in simulation
	}

	/* EPS_3_StrngAgSpdValidData */
	if(!@Vehicle_Signals::i_EPS_3_StrngAgSpdValidData_SIM)
	{
		if(@Vehicle_Signals::i_EPS_3_StrngAgSpdValidData_EN)
		{
			EPS_3.EPS_3_StrngAgSpdValidData = @Vehicle_Signals::i_EPS_3_StrngAgSpdValidData_Raw;
		}
		else
		{
			EPS_3.EPS_3_StrngAgSpdValidData.phys = @Vehicle_Signals::i_EPS_3_StrngAgSpdValidData;
		}
	}
	else
	{
		// To be completed in simulation
	}

	/* EPS_3_StrngWhlAg */
	if(!@Vehicle_Signals::i_EPS_3_StrngWhlAg_SIM)
	{
		if(@Vehicle_Signals::i_EPS_3_StrngWhlAg_EN)
		{
			EPS_3.EPS_3_StrngWhlAg = @Vehicle_Signals::i_EPS_3_StrngWhlAg_Raw;
		}
		else
		{
			EPS_3.EPS_3_StrngWhlAg.phys = @Vehicle_Signals::i_EPS_3_StrngWhlAg;
		}
	}
	else
	{
		// To be completed in simulation
	}

	/* EPS_3_StrngWhlAgValid */
	if(!@Vehicle_Signals::i_EPS_3_StrngWhlAgValid_SIM)
	{
		if(@Vehicle_Signals::i_EPS_3_StrngWhlAgValid_EN)
		{
			EPS_3.EPS_3_StrngWhlAgValid = @Vehicle_Signals::i_EPS_3_StrngWhlAgValid_Raw;
		}
		else
		{
			EPS_3.EPS_3_StrngWhlAgValid.phys = @Vehicle_Signals::i_EPS_3_StrngWhlAgValid;
		}
	}
	else
	{
		// To be completed in simulation
	}

	/* Rolling counter */
	PROJ_Sim_Rollingcounter(MSG_CONFIG_TX_EPS_3, EPS_3);

	/* CheckSum */
	PROJ_Sim_Checksum(MSG_CONFIG_TX_EPS_3, EPS_3);

	/* DLC Check */
	EPS_3.DataLength = @Error_panel_vehicle::i_DLCError[MSG_CONFIG_TX_EPS_3]?1:DBLookup(EPS_3).dlc;

}

PROJ_CalcMsg_EPS_4()
{
	/* EPS_4_AgCtrlLimActvd */
	if(!@Vehicle_Signals::i_EPS_4_AgCtrlLimActvd_SIM)
	{
		if(@Vehicle_Signals::i_EPS_4_AgCtrlLimActvd_EN)
		{
			EPS_4.EPS_4_AgCtrlLimActvd = @Vehicle_Signals::i_EPS_4_AgCtrlLimActvd_Raw;
		}
		else
		{
			EPS_4.EPS_4_AgCtrlLimActvd.phys = @Vehicle_Signals::i_EPS_4_AgCtrlLimActvd;
		}
	}
	else
	{
		// To be completed in simulation
	}

	/* EPS_4_HptcVibSrvAvl */
	if(!@Vehicle_Signals::i_EPS_4_HptcVibSrvAvl_SIM)
	{
		if(@Vehicle_Signals::i_EPS_4_HptcVibSrvAvl_EN)
		{
			EPS_4.EPS_4_HptcVibSrvAvl = @Vehicle_Signals::i_EPS_4_HptcVibSrvAvl_Raw;
		}
		else
		{
			EPS_4.EPS_4_HptcVibSrvAvl.phys = @Vehicle_Signals::i_EPS_4_HptcVibSrvAvl;
		}
	}
	else
	{
		// To be completed in simulation
	}

	/* EPS_4_LatDrvgAvlForLvl */
	if(!@Vehicle_Signals::i_EPS_4_LatDrvgAvlForLvl_SIM)
	{
		if(@Vehicle_Signals::i_EPS_4_LatDrvgAvlForLvl_EN)
		{
			EPS_4.EPS_4_LatDrvgAvlForLvl = @Vehicle_Signals::i_EPS_4_LatDrvgAvlForLvl_Raw;
		}
		else
		{
			EPS_4.EPS_4_LatDrvgAvlForLvl.phys = @Vehicle_Signals::i_EPS_4_LatDrvgAvlForLvl;
		}
	}
	else
	{
		// To be completed in simulation
	}

	/* EPS_4_LoASts */
	if(!@Vehicle_Signals::i_EPS_4_LoASts_SIM)
	{
		if(@Vehicle_Signals::i_EPS_4_LoASts_EN)
		{
			EPS_4.EPS_4_LoASts = @Vehicle_Signals::i_EPS_4_LoASts_Raw;
		}
		else
		{
			EPS_4.EPS_4_LoASts.phys = @Vehicle_Signals::i_EPS_4_LoASts;
		}
	}
	else
	{
		// To be completed in simulation
	}

	/* EPS_4_MotorTorque */
	if(!@Vehicle_Signals::i_EPS_4_MotorTorque_SIM)
	{
		if(@Vehicle_Signals::i_EPS_4_MotorTorque_EN)
		{
			EPS_4.EPS_4_MotorTorque = @Vehicle_Signals::i_EPS_4_MotorTorque_Raw;
		}
		else
		{
			EPS_4.EPS_4_MotorTorque.phys = @Vehicle_Signals::i_EPS_4_MotorTorque;
		}
	}
	else
	{
		// To be completed in simulation
	}

	/* EPS_4_PSCMActRPCTrq */
	if(!@Vehicle_Signals::i_EPS_4_PSCMActRPCTrq_SIM)
	{
		if(@Vehicle_Signals::i_EPS_4_PSCMActRPCTrq_EN)
		{
			EPS_4.EPS_4_PSCMActRPCTrq = @Vehicle_Signals::i_EPS_4_PSCMActRPCTrq_Raw;
		}
		else
		{
			EPS_4.EPS_4_PSCMActRPCTrq.phys = @Vehicle_Signals::i_EPS_4_PSCMActRPCTrq;
		}
	}
	else
	{
		// To be completed in simulation
	}

	/* EPS_4_PSCMActRPCTrqValid */
	if(!@Vehicle_Signals::i_EPS_4_PSCMActRPCTrqValid_SIM)
	{
		if(@Vehicle_Signals::i_EPS_4_PSCMActRPCTrqValid_EN)
		{
			EPS_4.EPS_4_PSCMActRPCTrqValid = @Vehicle_Signals::i_EPS_4_PSCMActRPCTrqValid_Raw;
		}
		else
		{
			EPS_4.EPS_4_PSCMActRPCTrqValid.phys = @Vehicle_Signals::i_EPS_4_PSCMActRPCTrqValid;
		}
	}
	else
	{
		// To be completed in simulation
	}

	/* EPS_4_StrngWhlAgResActive */
	if(!@Vehicle_Signals::i_EPS_4_StrngWhlAgResActive_SIM)
	{
		if(@Vehicle_Signals::i_EPS_4_StrngWhlAgResActive_EN)
		{
			EPS_4.EPS_4_StrngWhlAgResActive = @Vehicle_Signals::i_EPS_4_StrngWhlAgResActive_Raw;
		}
		else
		{
			EPS_4.EPS_4_StrngWhlAgResActive.phys = @Vehicle_Signals::i_EPS_4_StrngWhlAgResActive;
		}
	}
	else
	{
		// To be completed in simulation
	}

	/* Rolling counter */
	PROJ_Sim_Rollingcounter(MSG_CONFIG_TX_EPS_4, EPS_4);

	/* CheckSum */
	PROJ_Sim_Checksum(MSG_CONFIG_TX_EPS_4, EPS_4);

	/* DLC Check */
	EPS_4.DataLength = @Error_panel_vehicle::i_DLCError[MSG_CONFIG_TX_EPS_4]?1:DBLookup(EPS_4).dlc;

}

PROJ_CalcMsg_HCU_17()
{
	/* PRNDGearAct */
	if(!@Vehicle_Signals::i_PRNDGearAct_SIM)
	{
		if(@Vehicle_Signals::i_PRNDGearAct_EN)
		{
			HCU_17.PRNDGearAct = @Vehicle_Signals::i_PRNDGearAct_Raw;
		}
		else
		{
			HCU_17.PRNDGearAct.phys = @Vehicle_Signals::i_PRNDGearAct;
		}
	}
	else
	{
		// To be completed in simulation
	}

	/* PRNDGearActValidData */
	if(!@Vehicle_Signals::i_PRNDGearActValidData_SIM)
	{
		if(@Vehicle_Signals::i_PRNDGearActValidData_EN)
		{
			HCU_17.PRNDGearActValidData = @Vehicle_Signals::i_PRNDGearActValidData_Raw;
		}
		else
		{
			HCU_17.PRNDGearActValidData.phys = @Vehicle_Signals::i_PRNDGearActValidData;
		}
	}
	else
	{
		// To be completed in simulation
	}

	/* PRNDGearTarget */
	if(!@Vehicle_Signals::i_PRNDGearTarget_SIM)
	{
		if(@Vehicle_Signals::i_PRNDGearTarget_EN)
		{
			HCU_17.PRNDGearTarget = @Vehicle_Signals::i_PRNDGearTarget_Raw;
		}
		else
		{
			HCU_17.PRNDGearTarget.phys = @Vehicle_Signals::i_PRNDGearTarget;
		}
	}
	else
	{
		// To be completed in simulation
	}

	/* Rolling counter */
	PROJ_Sim_Rollingcounter(MSG_CONFIG_TX_HCU_17, HCU_17);

	/* CheckSum */
	PROJ_Sim_Checksum(MSG_CONFIG_TX_HCU_17, HCU_17);

	/* DLC Check */
	HCU_17.DataLength = @Error_panel_vehicle::i_DLCError[MSG_CONFIG_TX_HCU_17]?1:DBLookup(HCU_17).dlc;

}

PROJ_CalcMsg_HCU_1_G()
{
	/* HCU_PTReady */
	if(!@Vehicle_Signals::i_HCU_PTReady_SIM)
	{
		if(@Vehicle_Signals::i_HCU_PTReady_EN)
		{
			HCU_1_G.HCU_PTReady = @Vehicle_Signals::i_HCU_PTReady_Raw;
		}
		else
		{
			HCU_1_G.HCU_PTReady.phys = @Vehicle_Signals::i_HCU_PTReady;
		}
	}
	else
	{
		// To be completed in simulation
	}

	/* HCU_PowertrainFault */
	if(!@Vehicle_Signals::i_HCU_PowertrainFault_SIM)
	{
		if(@Vehicle_Signals::i_HCU_PowertrainFault_EN)
		{
			HCU_1_G.HCU_PowertrainFault = @Vehicle_Signals::i_HCU_PowertrainFault_Raw;
		}
		else
		{
			HCU_1_G.HCU_PowertrainFault.phys = @Vehicle_Signals::i_HCU_PowertrainFault;
		}
	}
	else
	{
		// To be completed in simulation
	}

	/* Rolling counter */
	PROJ_Sim_Rollingcounter(MSG_CONFIG_TX_HCU_1_G, HCU_1_G);

	/* CheckSum */
	PROJ_Sim_Checksum(MSG_CONFIG_TX_HCU_1_G, HCU_1_G);

	/* DLC Check */
	HCU_1_G.DataLength = @Error_panel_vehicle::i_DLCError[MSG_CONFIG_TX_HCU_1_G]?1:DBLookup(HCU_1_G).dlc;

}

PROJ_CalcMsg_HCU_3_G()
{
	/* HCU_BrakePedalSts */
	if(!@Vehicle_Signals::i_HCU_BrakePedalSts_SIM)
	{
		if(@Vehicle_Signals::i_HCU_BrakePedalSts_EN)
		{
			HCU_3_G.HCU_BrakePedalSts = @Vehicle_Signals::i_HCU_BrakePedalSts_Raw;
		}
		else
		{
			HCU_3_G.HCU_BrakePedalSts.phys = @Vehicle_Signals::i_HCU_BrakePedalSts;
		}
	}
	else
	{
		// To be completed in simulation
	}

	/* HCU_BrakePedalStsValidData */
	if(!@Vehicle_Signals::i_HCU_BrakePedalStsValidData_SIM)
	{
		if(@Vehicle_Signals::i_HCU_BrakePedalStsValidData_EN)
		{
			HCU_3_G.HCU_BrakePedalStsValidData = @Vehicle_Signals::i_HCU_BrakePedalStsValidData_Raw;
		}
		else
		{
			HCU_3_G.HCU_BrakePedalStsValidData.phys = @Vehicle_Signals::i_HCU_BrakePedalStsValidData;
		}
	}
	else
	{
		// To be completed in simulation
	}

	/* HCU_GasPedalPosition */
	if(!@Vehicle_Signals::i_HCU_GasPedalPosition_SIM)
	{
		if(@Vehicle_Signals::i_HCU_GasPedalPosition_EN)
		{
			HCU_3_G.HCU_GasPedalPosition = @Vehicle_Signals::i_HCU_GasPedalPosition_Raw;
		}
		else
		{
			HCU_3_G.HCU_GasPedalPosition.phys = @Vehicle_Signals::i_HCU_GasPedalPosition;
		}
	}
	else
	{
		// To be completed in simulation
	}

	/* HCU_GasPedalPositionInvalidData */
	if(!@Vehicle_Signals::i_HCU_GasPedalPositionInvalidData_SIM)
	{
		if(@Vehicle_Signals::i_HCU_GasPedalPositionInvalidData_EN)
		{
			HCU_3_G.HCU_GasPedalPositionInvalidData = @Vehicle_Signals::i_HCU_GasPedalPositionInvalidData_Raw;
		}
		else
		{
			HCU_3_G.HCU_GasPedalPositionInvalidData.phys = @Vehicle_Signals::i_HCU_GasPedalPositionInvalidData;
		}
	}
	else
	{
		// To be completed in simulation
	}

	/* HCU_PowerLimit */
	if(!@Vehicle_Signals::i_HCU_PowerLimit_SIM)
	{
		if(@Vehicle_Signals::i_HCU_PowerLimit_EN)
		{
			HCU_3_G.HCU_PowerLimit = @Vehicle_Signals::i_HCU_PowerLimit_Raw;
		}
		else
		{
			HCU_3_G.HCU_PowerLimit.phys = @Vehicle_Signals::i_HCU_PowerLimit;
		}
	}
	else
	{
		// To be completed in simulation
	}

	/* Rolling counter */
	PROJ_Sim_Rollingcounter(MSG_CONFIG_TX_HCU_3_G, HCU_3_G);

	/* CheckSum */
	PROJ_Sim_Checksum(MSG_CONFIG_TX_HCU_3_G, HCU_3_G);

	/* DLC Check */
	HCU_3_G.DataLength = @Error_panel_vehicle::i_DLCError[MSG_CONFIG_TX_HCU_3_G]?1:DBLookup(HCU_3_G).dlc;

}

PROJ_CalcMsg_HCU_6()
{
	/* HCU_6_BrakePedalStsForTCU */
	if(!@Vehicle_Signals::i_HCU_6_BrakePedalStsForTCU_SIM)
	{
		if(@Vehicle_Signals::i_HCU_6_BrakePedalStsForTCU_EN)
		{
			HCU_6.HCU_6_BrakePedalStsForTCU = @Vehicle_Signals::i_HCU_6_BrakePedalStsForTCU_Raw;
		}
		else
		{
			HCU_6.HCU_6_BrakePedalStsForTCU.phys = @Vehicle_Signals::i_HCU_6_BrakePedalStsForTCU;
		}
	}
	else
	{
		// To be completed in simulation
	}

	/* HCU_6_ECGPOvrd */
	if(!@Vehicle_Signals::i_HCU_6_ECGPOvrd_SIM)
	{
		if(@Vehicle_Signals::i_HCU_6_ECGPOvrd_EN)
		{
			HCU_6.HCU_6_ECGPOvrd = @Vehicle_Signals::i_HCU_6_ECGPOvrd_Raw;
		}
		else
		{
			HCU_6.HCU_6_ECGPOvrd.phys = @Vehicle_Signals::i_HCU_6_ECGPOvrd;
		}
	}
	else
	{
		// To be completed in simulation
	}

	/* HCU_6_ECGPOvrdInvalidData */
	if(!@Vehicle_Signals::i_HCU_6_ECGPOvrdInvalidData_SIM)
	{
		if(@Vehicle_Signals::i_HCU_6_ECGPOvrdInvalidData_EN)
		{
			HCU_6.HCU_6_ECGPOvrdInvalidData = @Vehicle_Signals::i_HCU_6_ECGPOvrdInvalidData_Raw;
		}
		else
		{
			HCU_6.HCU_6_ECGPOvrdInvalidData.phys = @Vehicle_Signals::i_HCU_6_ECGPOvrdInvalidData;
		}
	}
	else
	{
		// To be completed in simulation
	}

	/* HCU_6_MaxTorqueWheel */
	if(!@Vehicle_Signals::i_HCU_6_MaxTorqueWheel_SIM)
	{
		if(@Vehicle_Signals::i_HCU_6_MaxTorqueWheel_EN)
		{
			HCU_6.HCU_6_MaxTorqueWheel = @Vehicle_Signals::i_HCU_6_MaxTorqueWheel_Raw;
		}
		else
		{
			HCU_6.HCU_6_MaxTorqueWheel.phys = @Vehicle_Signals::i_HCU_6_MaxTorqueWheel;
		}
	}
	else
	{
		// To be completed in simulation
	}

	/* HCU_6_MinTorqueWheel */
	if(!@Vehicle_Signals::i_HCU_6_MinTorqueWheel_SIM)
	{
		if(@Vehicle_Signals::i_HCU_6_MinTorqueWheel_EN)
		{
			HCU_6.HCU_6_MinTorqueWheel = @Vehicle_Signals::i_HCU_6_MinTorqueWheel_Raw;
		}
		else
		{
			HCU_6.HCU_6_MinTorqueWheel.phys = @Vehicle_Signals::i_HCU_6_MinTorqueWheel;
		}
	}
	else
	{
		// To be completed in simulation
	}

	/* HCU_BrakePedalStsValidDataForTCU */
	if(!@Vehicle_Signals::i_HCU_BrakePedalStsValidDataForTCU_SIM)
	{
		if(@Vehicle_Signals::i_HCU_BrakePedalStsValidDataForTCU_EN)
		{
			HCU_6.HCU_BrakePedalStsValidDataForTCU = @Vehicle_Signals::i_HCU_BrakePedalStsValidDataForTCU_Raw;
		}
		else
		{
			HCU_6.HCU_BrakePedalStsValidDataForTCU.phys = @Vehicle_Signals::i_HCU_BrakePedalStsValidDataForTCU;
		}
	}
	else
	{
		// To be completed in simulation
	}

	/* Rolling counter */
	PROJ_Sim_Rollingcounter(MSG_CONFIG_TX_HCU_6, HCU_6);

	/* CheckSum */
	PROJ_Sim_Checksum(MSG_CONFIG_TX_HCU_6, HCU_6);

	/* DLC Check */
	HCU_6.DataLength = @Error_panel_vehicle::i_DLCError[MSG_CONFIG_TX_HCU_6]?1:DBLookup(HCU_6).dlc;

}

PROJ_CalcMsg_ICM_1()
{
	/* DisplayVehicleSpeed */
	if(!@Vehicle_Signals::i_DisplayVehicleSpeed_SIM)
	{
		if(@Vehicle_Signals::i_DisplayVehicleSpeed_EN)
		{
			ICM_1.DisplayVehicleSpeed = @Vehicle_Signals::i_DisplayVehicleSpeed_Raw;
		}
		else
		{
			ICM_1.DisplayVehicleSpeed.phys = @Vehicle_Signals::i_DisplayVehicleSpeed;
		}
	}
	else
	{
		// To be completed in simulation
	}

	/* ECOModeSWSts */
	if(!@Vehicle_Signals::i_ECOModeSWSts_SIM)
	{
		if(@Vehicle_Signals::i_ECOModeSWSts_EN)
		{
			ICM_1.ECOModeSWSts = @Vehicle_Signals::i_ECOModeSWSts_Raw;
		}
		else
		{
			ICM_1.ECOModeSWSts.phys = @Vehicle_Signals::i_ECOModeSWSts;
		}
	}
	else
	{
		// To be completed in simulation
	}

	/* LDWLKA_LaneAssitTypeReq */
	if(!@Vehicle_Signals::i_LDWLKA_LaneAssitTypeReq_SIM)
	{
		if(@Vehicle_Signals::i_LDWLKA_LaneAssitTypeReq_EN)
		{
			ICM_1.LDWLKA_LaneAssitTypeReq = @Vehicle_Signals::i_LDWLKA_LaneAssitTypeReq_Raw;
		}
		else
		{
			ICM_1.LDWLKA_LaneAssitTypeReq.phys = @Vehicle_Signals::i_LDWLKA_LaneAssitTypeReq;
		}
	}
	else
	{
		// To be completed in simulation
	}

	/* TotalOdometer_km */
	if(!@Vehicle_Signals::i_TotalOdometer_km_SIM)
	{
		if(@Vehicle_Signals::i_TotalOdometer_km_EN)
		{
			ICM_1.TotalOdometer_km = @Vehicle_Signals::i_TotalOdometer_km_Raw;
		}
		else
		{
			ICM_1.TotalOdometer_km.phys = @Vehicle_Signals::i_TotalOdometer_km;
		}
	}
	else
	{
		// To be completed in simulation
	}

	/* Rolling counter */
	PROJ_Sim_Rollingcounter(MSG_CONFIG_TX_ICM_1, ICM_1);

	/* CheckSum */
	PROJ_Sim_Checksum(MSG_CONFIG_TX_ICM_1, ICM_1);

	/* DLC Check */
	ICM_1.DataLength = @Error_panel_vehicle::i_DLCError[MSG_CONFIG_TX_ICM_1]?1:DBLookup(ICM_1).dlc;

}

PROJ_CalcMsg_ICM_2()
{
	/* DISFail */
	if(!@Vehicle_Signals::i_DISFail_SIM)
	{
		if(@Vehicle_Signals::i_DISFail_EN)
		{
			ICM_2.DISFail = @Vehicle_Signals::i_DISFail_Raw;
		}
		else
		{
			ICM_2.DISFail.phys = @Vehicle_Signals::i_DISFail;
		}
	}
	else
	{
		// To be completed in simulation
	}

	/* QDashACCFail */
	if(!@Vehicle_Signals::i_QDashACCFail_SIM)
	{
		if(@Vehicle_Signals::i_QDashACCFail_EN)
		{
			ICM_2.QDashACCFail = @Vehicle_Signals::i_QDashACCFail_Raw;
		}
		else
		{
			ICM_2.QDashACCFail.phys = @Vehicle_Signals::i_QDashACCFail;
		}
	}
	else
	{
		// To be completed in simulation
	}

	/* Rolling counter */
	PROJ_Sim_Rollingcounter(MSG_CONFIG_TX_ICM_2, ICM_2);

	/* CheckSum */
	PROJ_Sim_Checksum(MSG_CONFIG_TX_ICM_2, ICM_2);

	/* DLC Check */
	ICM_2.DataLength = @Error_panel_vehicle::i_DLCError[MSG_CONFIG_TX_ICM_2]?1:DBLookup(ICM_2).dlc;

}

PROJ_CalcMsg_ICM_3()
{
	/* CurrentTimeDay */
	if(!@Vehicle_Signals::i_CurrentTimeDay_SIM)
	{
		if(@Vehicle_Signals::i_CurrentTimeDay_EN)
		{
			ICM_3.CurrentTimeDay = @Vehicle_Signals::i_CurrentTimeDay_Raw;
		}
		else
		{
			ICM_3.CurrentTimeDay.phys = @Vehicle_Signals::i_CurrentTimeDay;
		}
	}
	else
	{
		// To be completed in simulation
	}

	/* CurrentTimeHour */
	if(!@Vehicle_Signals::i_CurrentTimeHour_SIM)
	{
		if(@Vehicle_Signals::i_CurrentTimeHour_EN)
		{
			ICM_3.CurrentTimeHour = @Vehicle_Signals::i_CurrentTimeHour_Raw;
		}
		else
		{
			ICM_3.CurrentTimeHour.phys = @Vehicle_Signals::i_CurrentTimeHour;
		}
	}
	else
	{
		// To be completed in simulation
	}

	/* CurrentTimeMinute */
	if(!@Vehicle_Signals::i_CurrentTimeMinute_SIM)
	{
		if(@Vehicle_Signals::i_CurrentTimeMinute_EN)
		{
			ICM_3.CurrentTimeMinute = @Vehicle_Signals::i_CurrentTimeMinute_Raw;
		}
		else
		{
			ICM_3.CurrentTimeMinute.phys = @Vehicle_Signals::i_CurrentTimeMinute;
		}
	}
	else
	{
		// To be completed in simulation
	}

	/* CurrentTimeMonth */
	if(!@Vehicle_Signals::i_CurrentTimeMonth_SIM)
	{
		if(@Vehicle_Signals::i_CurrentTimeMonth_EN)
		{
			ICM_3.CurrentTimeMonth = @Vehicle_Signals::i_CurrentTimeMonth_Raw;
		}
		else
		{
			ICM_3.CurrentTimeMonth.phys = @Vehicle_Signals::i_CurrentTimeMonth;
		}
	}
	else
	{
		// To be completed in simulation
	}

	/* CurrentTimeSecond */
	if(!@Vehicle_Signals::i_CurrentTimeSecond_SIM)
	{
		if(@Vehicle_Signals::i_CurrentTimeSecond_EN)
		{
			ICM_3.CurrentTimeSecond = @Vehicle_Signals::i_CurrentTimeSecond_Raw;
		}
		else
		{
			ICM_3.CurrentTimeSecond.phys = @Vehicle_Signals::i_CurrentTimeSecond;
		}
	}
	else
	{
		// To be completed in simulation
	}

	/* CurrentTimeYear */
	if(!@Vehicle_Signals::i_CurrentTimeYear_SIM)
	{
		if(@Vehicle_Signals::i_CurrentTimeYear_EN)
		{
			ICM_3.CurrentTimeYear = @Vehicle_Signals::i_CurrentTimeYear_Raw;
		}
		else
		{
			ICM_3.CurrentTimeYear.phys = @Vehicle_Signals::i_CurrentTimeYear;
		}
	}
	else
	{
		// To be completed in simulation
	}

	/* Rolling counter */
	PROJ_Sim_Rollingcounter(MSG_CONFIG_TX_ICM_3, ICM_3);

	/* CheckSum */
	PROJ_Sim_Checksum(MSG_CONFIG_TX_ICM_3, ICM_3);

	/* DLC Check */
	ICM_3.DataLength = @Error_panel_vehicle::i_DLCError[MSG_CONFIG_TX_ICM_3]?1:DBLookup(ICM_3).dlc;

}

PROJ_CalcMsg_ICM_5()
{
	/* ACC_Kilometre_Mile */
	if(!@Vehicle_Signals::i_ACC_Kilometre_Mile_SIM)
	{
		if(@Vehicle_Signals::i_ACC_Kilometre_Mile_EN)
		{
			ICM_5.ACC_Kilometre_Mile = @Vehicle_Signals::i_ACC_Kilometre_Mile_Raw;
		}
		else
		{
			ICM_5.ACC_Kilometre_Mile.phys = @Vehicle_Signals::i_ACC_Kilometre_Mile;
		}
	}
	else
	{
		// To be completed in simulation
	}

	/* DriverSeatBeltSwitchQbit */
	if(!@Vehicle_Signals::i_DriverSeatBeltSwitchQbit_SIM)
	{
		if(@Vehicle_Signals::i_DriverSeatBeltSwitchQbit_EN)
		{
			ICM_5.DriverSeatBeltSwitchQbit = @Vehicle_Signals::i_DriverSeatBeltSwitchQbit_Raw;
		}
		else
		{
			ICM_5.DriverSeatBeltSwitchQbit.phys = @Vehicle_Signals::i_DriverSeatBeltSwitchQbit;
		}
	}
	else
	{
		// To be completed in simulation
	}

	/* ICM_5_DriverSeatBeltSwitch */
	if(!@Vehicle_Signals::i_ICM_5_DriverSeatBeltSwitch_SIM)
	{
		if(@Vehicle_Signals::i_ICM_5_DriverSeatBeltSwitch_EN)
		{
			ICM_5.ICM_5_DriverSeatBeltSwitch = @Vehicle_Signals::i_ICM_5_DriverSeatBeltSwitch_Raw;
		}
		else
		{
			ICM_5.ICM_5_DriverSeatBeltSwitch.phys = @Vehicle_Signals::i_ICM_5_DriverSeatBeltSwitch;
		}
	}
	else
	{
		// To be completed in simulation
	}

	/* Rolling counter */
	PROJ_Sim_Rollingcounter(MSG_CONFIG_TX_ICM_5, ICM_5);

	/* CheckSum */
	PROJ_Sim_Checksum(MSG_CONFIG_TX_ICM_5, ICM_5);

	/* DLC Check */
	ICM_5.DataLength = @Error_panel_vehicle::i_DLCError[MSG_CONFIG_TX_ICM_5]?1:DBLookup(ICM_5).dlc;

}

PROJ_CalcMsg_IHU_10()
{
	/* IHU_DriveMode */
	if(!@Vehicle_Signals::i_IHU_DriveMode_SIM)
	{
		if(@Vehicle_Signals::i_IHU_DriveMode_EN)
		{
			IHU_10.IHU_DriveMode = @Vehicle_Signals::i_IHU_DriveMode_Raw;
		}
		else
		{
			IHU_10.IHU_DriveMode.phys = @Vehicle_Signals::i_IHU_DriveMode;
		}
	}
	else
	{
		// To be completed in simulation
	}

	/* NavCurrRoadType */
	if(!@Vehicle_Signals::i_NavCurrRoadType_SIM)
	{
		if(@Vehicle_Signals::i_NavCurrRoadType_EN)
		{
			IHU_10.NavCurrRoadType = @Vehicle_Signals::i_NavCurrRoadType_Raw;
		}
		else
		{
			IHU_10.NavCurrRoadType.phys = @Vehicle_Signals::i_NavCurrRoadType;
		}
	}
	else
	{
		// To be completed in simulation
	}

	/* NavSpeedLimit */
	if(!@Vehicle_Signals::i_NavSpeedLimit_SIM)
	{
		if(@Vehicle_Signals::i_NavSpeedLimit_EN)
		{
			IHU_10.NavSpeedLimit = @Vehicle_Signals::i_NavSpeedLimit_Raw;
		}
		else
		{
			IHU_10.NavSpeedLimit.phys = @Vehicle_Signals::i_NavSpeedLimit;
		}
	}
	else
	{
		// To be completed in simulation
	}

	/* NavSpeedLimitStatus */
	if(!@Vehicle_Signals::i_NavSpeedLimitStatus_SIM)
	{
		if(@Vehicle_Signals::i_NavSpeedLimitStatus_EN)
		{
			IHU_10.NavSpeedLimitStatus = @Vehicle_Signals::i_NavSpeedLimitStatus_Raw;
		}
		else
		{
			IHU_10.NavSpeedLimitStatus.phys = @Vehicle_Signals::i_NavSpeedLimitStatus;
		}
	}
	else
	{
		// To be completed in simulation
	}

	/* NavSpeedLimitUnits */
	if(!@Vehicle_Signals::i_NavSpeedLimitUnits_SIM)
	{
		if(@Vehicle_Signals::i_NavSpeedLimitUnits_EN)
		{
			IHU_10.NavSpeedLimitUnits = @Vehicle_Signals::i_NavSpeedLimitUnits_Raw;
		}
		else
		{
			IHU_10.NavSpeedLimitUnits.phys = @Vehicle_Signals::i_NavSpeedLimitUnits;
		}
	}
	else
	{
		// To be completed in simulation
	}

	/* Reserved_NavCountryCode */
	if(!@Vehicle_Signals::i_Reserved_NavCountryCode_SIM)
	{
		if(@Vehicle_Signals::i_Reserved_NavCountryCode_EN)
		{
			IHU_10.Reserved_NavCountryCode = @Vehicle_Signals::i_Reserved_NavCountryCode_Raw;
		}
		else
		{
			IHU_10.Reserved_NavCountryCode.phys = @Vehicle_Signals::i_Reserved_NavCountryCode;
		}
	}
	else
	{
		// To be completed in simulation
	}

	/* SLASpdLimChgAudSwSet */
	if(!@Vehicle_Signals::i_SLASpdLimChgAudSwSet_SIM)
	{
		if(@Vehicle_Signals::i_SLASpdLimChgAudSwSet_EN)
		{
			IHU_10.SLASpdLimChgAudSwSet = @Vehicle_Signals::i_SLASpdLimChgAudSwSet_Raw;
		}
		else
		{
			IHU_10.SLASpdLimChgAudSwSet.phys = @Vehicle_Signals::i_SLASpdLimChgAudSwSet;
		}
	}
	else
	{
		// To be completed in simulation
	}

	/* Rolling counter */
	PROJ_Sim_Rollingcounter(MSG_CONFIG_TX_IHU_10, IHU_10);

	/* CheckSum */
	PROJ_Sim_Checksum(MSG_CONFIG_TX_IHU_10, IHU_10);

	/* DLC Check */
	IHU_10.DataLength = @Error_panel_vehicle::i_DLCError[MSG_CONFIG_TX_IHU_10]?1:DBLookup(IHU_10).dlc;

}

PROJ_CalcMsg_IHU_11()
{
	/* IHU_11_AEBSwtSet */
	if(!@Vehicle_Signals::i_IHU_11_AEBSwtSet_SIM)
	{
		if(@Vehicle_Signals::i_IHU_11_AEBSwtSet_EN)
		{
			IHU_11.IHU_11_AEBSwtSet = @Vehicle_Signals::i_IHU_11_AEBSwtSet_Raw;
		}
		else
		{
			IHU_11.IHU_11_AEBSwtSet.phys = @Vehicle_Signals::i_IHU_11_AEBSwtSet;
		}
	}
	else
	{
		// To be completed in simulation
	}

	/* IHU_11_DAISwtSet */
	if(!@Vehicle_Signals::i_IHU_11_DAISwtSet_SIM)
	{
		if(@Vehicle_Signals::i_IHU_11_DAISwtSet_EN)
		{
			IHU_11.IHU_11_DAISwtSet = @Vehicle_Signals::i_IHU_11_DAISwtSet_Raw;
		}
		else
		{
			IHU_11.IHU_11_DAISwtSet.phys = @Vehicle_Signals::i_IHU_11_DAISwtSet;
		}
	}
	else
	{
		// To be completed in simulation
	}

	/* IHU_11_ELKSwtSet */
	if(!@Vehicle_Signals::i_IHU_11_ELKSwtSet_SIM)
	{
		if(@Vehicle_Signals::i_IHU_11_ELKSwtSet_EN)
		{
			IHU_11.IHU_11_ELKSwtSet = @Vehicle_Signals::i_IHU_11_ELKSwtSet_Raw;
		}
		else
		{
			IHU_11.IHU_11_ELKSwtSet.phys = @Vehicle_Signals::i_IHU_11_ELKSwtSet;
		}
	}
	else
	{
		// To be completed in simulation
	}

	/* IHU_11_FCWSnvtySet */
	if(!@Vehicle_Signals::i_IHU_11_FCWSnvtySet_SIM)
	{
		if(@Vehicle_Signals::i_IHU_11_FCWSnvtySet_EN)
		{
			IHU_11.IHU_11_FCWSnvtySet = @Vehicle_Signals::i_IHU_11_FCWSnvtySet_Raw;
		}
		else
		{
			IHU_11.IHU_11_FCWSnvtySet.phys = @Vehicle_Signals::i_IHU_11_FCWSnvtySet;
		}
	}
	else
	{
		// To be completed in simulation
	}

	/* IHU_11_FCWSwtSet */
	if(!@Vehicle_Signals::i_IHU_11_FCWSwtSet_SIM)
	{
		if(@Vehicle_Signals::i_IHU_11_FCWSwtSet_EN)
		{
			IHU_11.IHU_11_FCWSwtSet = @Vehicle_Signals::i_IHU_11_FCWSwtSet_Raw;
		}
		else
		{
			IHU_11.IHU_11_FCWSwtSet.phys = @Vehicle_Signals::i_IHU_11_FCWSwtSet;
		}
	}
	else
	{
		// To be completed in simulation
	}

	/* IHU_11_HMASwtSet */
	if(!@Vehicle_Signals::i_IHU_11_HMASwtSet_SIM)
	{
		if(@Vehicle_Signals::i_IHU_11_HMASwtSet_EN)
		{
			IHU_11.IHU_11_HMASwtSet = @Vehicle_Signals::i_IHU_11_HMASwtSet_Raw;
		}
		else
		{
			IHU_11.IHU_11_HMASwtSet.phys = @Vehicle_Signals::i_IHU_11_HMASwtSet;
		}
	}
	else
	{
		// To be completed in simulation
	}

	/* IHU_11_IESSwtSet */
	if(!@Vehicle_Signals::i_IHU_11_IESSwtSet_SIM)
	{
		if(@Vehicle_Signals::i_IHU_11_IESSwtSet_EN)
		{
			IHU_11.IHU_11_IESSwtSet = @Vehicle_Signals::i_IHU_11_IESSwtSet_Raw;
		}
		else
		{
			IHU_11.IHU_11_IESSwtSet.phys = @Vehicle_Signals::i_IHU_11_IESSwtSet;
		}
	}
	else
	{
		// To be completed in simulation
	}

	/* IHU_11_LDPSwtSet */
	if(!@Vehicle_Signals::i_IHU_11_LDPSwtSet_SIM)
	{
		if(@Vehicle_Signals::i_IHU_11_LDPSwtSet_EN)
		{
			IHU_11.IHU_11_LDPSwtSet = @Vehicle_Signals::i_IHU_11_LDPSwtSet_Raw;
		}
		else
		{
			IHU_11.IHU_11_LDPSwtSet.phys = @Vehicle_Signals::i_IHU_11_LDPSwtSet;
		}
	}
	else
	{
		// To be completed in simulation
	}

	/* IHU_11_LDWLDPSnvtySet */
	if(!@Vehicle_Signals::i_IHU_11_LDWLDPSnvtySet_SIM)
	{
		if(@Vehicle_Signals::i_IHU_11_LDWLDPSnvtySet_EN)
		{
			IHU_11.IHU_11_LDWLDPSnvtySet = @Vehicle_Signals::i_IHU_11_LDWLDPSnvtySet_Raw;
		}
		else
		{
			IHU_11.IHU_11_LDWLDPSnvtySet.phys = @Vehicle_Signals::i_IHU_11_LDWLDPSnvtySet;
		}
	}
	else
	{
		// To be completed in simulation
	}

	/* IHU_11_LDWSwtSet */
	if(!@Vehicle_Signals::i_IHU_11_LDWSwtSet_SIM)
	{
		if(@Vehicle_Signals::i_IHU_11_LDWSwtSet_EN)
		{
			IHU_11.IHU_11_LDWSwtSet = @Vehicle_Signals::i_IHU_11_LDWSwtSet_Raw;
		}
		else
		{
			IHU_11.IHU_11_LDWSwtSet.phys = @Vehicle_Signals::i_IHU_11_LDWSwtSet;
		}
	}
	else
	{
		// To be completed in simulation
	}

	/* IHU_11_SCFSwtSet */
	if(!@Vehicle_Signals::i_IHU_11_SCFSwtSet_SIM)
	{
		if(@Vehicle_Signals::i_IHU_11_SCFSwtSet_EN)
		{
			IHU_11.IHU_11_SCFSwtSet = @Vehicle_Signals::i_IHU_11_SCFSwtSet_Raw;
		}
		else
		{
			IHU_11.IHU_11_SCFSwtSet.phys = @Vehicle_Signals::i_IHU_11_SCFSwtSet;
		}
	}
	else
	{
		// To be completed in simulation
	}

	/* IHU_11_SLASwtSet */
	if(!@Vehicle_Signals::i_IHU_11_SLASwtSet_SIM)
	{
		if(@Vehicle_Signals::i_IHU_11_SLASwtSet_EN)
		{
			IHU_11.IHU_11_SLASwtSet = @Vehicle_Signals::i_IHU_11_SLASwtSet_Raw;
		}
		else
		{
			IHU_11.IHU_11_SLASwtSet.phys = @Vehicle_Signals::i_IHU_11_SLASwtSet;
		}
	}
	else
	{
		// To be completed in simulation
	}

	/* IHU_11_TJAICAExitTextInfoSwtSet */
	if(!@Vehicle_Signals::i_IHU_11_TJAICAExitTextInfoSwtSet_SIM)
	{
		if(@Vehicle_Signals::i_IHU_11_TJAICAExitTextInfoSwtSet_EN)
		{
			IHU_11.IHU_11_TJAICAExitTextInfoSwtSet = @Vehicle_Signals::i_IHU_11_TJAICAExitTextInfoSwtSet_Raw;
		}
		else
		{
			IHU_11.IHU_11_TJAICAExitTextInfoSwtSet.phys = @Vehicle_Signals::i_IHU_11_TJAICAExitTextInfoSwtSet;
		}
	}
	else
	{
		// To be completed in simulation
	}

	/* IHU_11_TLISwtSet */
	if(!@Vehicle_Signals::i_IHU_11_TLISwtSet_SIM)
	{
		if(@Vehicle_Signals::i_IHU_11_TLISwtSet_EN)
		{
			IHU_11.IHU_11_TLISwtSet = @Vehicle_Signals::i_IHU_11_TLISwtSet_Raw;
		}
		else
		{
			IHU_11.IHU_11_TLISwtSet.phys = @Vehicle_Signals::i_IHU_11_TLISwtSet;
		}
	}
	else
	{
		// To be completed in simulation
	}

	/* IHU_11_TSISwtSet */
	if(!@Vehicle_Signals::i_IHU_11_TSISwtSet_SIM)
	{
		if(@Vehicle_Signals::i_IHU_11_TSISwtSet_EN)
		{
			IHU_11.IHU_11_TSISwtSet = @Vehicle_Signals::i_IHU_11_TSISwtSet_Raw;
		}
		else
		{
			IHU_11.IHU_11_TSISwtSet.phys = @Vehicle_Signals::i_IHU_11_TSISwtSet;
		}
	}
	else
	{
		// To be completed in simulation
	}

	/* IHU_11_WarnModSwtSet */
	if(!@Vehicle_Signals::i_IHU_11_WarnModSwtSet_SIM)
	{
		if(@Vehicle_Signals::i_IHU_11_WarnModSwtSet_EN)
		{
			IHU_11.IHU_11_WarnModSwtSet = @Vehicle_Signals::i_IHU_11_WarnModSwtSet_Raw;
		}
		else
		{
			IHU_11.IHU_11_WarnModSwtSet.phys = @Vehicle_Signals::i_IHU_11_WarnModSwtSet;
		}
	}
	else
	{
		// To be completed in simulation
	}

	/* Rolling counter */
	PROJ_Sim_Rollingcounter(MSG_CONFIG_TX_IHU_11, IHU_11);

	/* CheckSum */
	PROJ_Sim_Checksum(MSG_CONFIG_TX_IHU_11, IHU_11);

	/* DLC Check */
	IHU_11.DataLength = @Error_panel_vehicle::i_DLCError[MSG_CONFIG_TX_IHU_11]?1:DBLookup(IHU_11).dlc;

}

PROJ_CalcMsg_IHU_29()
{
	/* IHU_29_SLAMode */
	if(!@Vehicle_Signals::i_IHU_29_SLAMode_SIM)
	{
		if(@Vehicle_Signals::i_IHU_29_SLAMode_EN)
		{
			IHU_29.IHU_29_SLAMode = @Vehicle_Signals::i_IHU_29_SLAMode_Raw;
		}
		else
		{
			IHU_29.IHU_29_SLAMode.phys = @Vehicle_Signals::i_IHU_29_SLAMode;
		}
	}
	else
	{
		// To be completed in simulation
	}

	/* IHU_29_SpeedLmtNmberAb */
	if(!@Vehicle_Signals::i_IHU_29_SpeedLmtNmberAb_SIM)
	{
		if(@Vehicle_Signals::i_IHU_29_SpeedLmtNmberAb_EN)
		{
			IHU_29.IHU_29_SpeedLmtNmberAb = @Vehicle_Signals::i_IHU_29_SpeedLmtNmberAb_Raw;
		}
		else
		{
			IHU_29.IHU_29_SpeedLmtNmberAb.phys = @Vehicle_Signals::i_IHU_29_SpeedLmtNmberAb;
		}
	}
	else
	{
		// To be completed in simulation
	}

	/* IHU_29_SpeedLmtNmberE */
	if(!@Vehicle_Signals::i_IHU_29_SpeedLmtNmberE_SIM)
	{
		if(@Vehicle_Signals::i_IHU_29_SpeedLmtNmberE_EN)
		{
			IHU_29.IHU_29_SpeedLmtNmberE = @Vehicle_Signals::i_IHU_29_SpeedLmtNmberE_Raw;
		}
		else
		{
			IHU_29.IHU_29_SpeedLmtNmberE.phys = @Vehicle_Signals::i_IHU_29_SpeedLmtNmberE;
		}
	}
	else
	{
		// To be completed in simulation
	}

	/* SLASpdlimitWarningAudSWSet */
	if(!@Vehicle_Signals::i_SLASpdlimitWarningAudSWSet_SIM)
	{
		if(@Vehicle_Signals::i_SLASpdlimitWarningAudSWSet_EN)
		{
			IHU_29.SLASpdlimitWarningAudSWSet = @Vehicle_Signals::i_SLASpdlimitWarningAudSWSet_Raw;
		}
		else
		{
			IHU_29.SLASpdlimitWarningAudSWSet.phys = @Vehicle_Signals::i_SLASpdlimitWarningAudSWSet;
		}
	}
	else
	{
		// To be completed in simulation
	}

	/* SLWFONOFFSet */
	if(!@Vehicle_Signals::i_SLWFONOFFSet_SIM)
	{
		if(@Vehicle_Signals::i_SLWFONOFFSet_EN)
		{
			IHU_29.SLWFONOFFSet = @Vehicle_Signals::i_SLWFONOFFSet_Raw;
		}
		else
		{
			IHU_29.SLWFONOFFSet.phys = @Vehicle_Signals::i_SLWFONOFFSet;
		}
	}
	else
	{
		// To be completed in simulation
	}

	/* Rolling counter */
	PROJ_Sim_Rollingcounter(MSG_CONFIG_TX_IHU_29, IHU_29);

	/* CheckSum */
	PROJ_Sim_Checksum(MSG_CONFIG_TX_IHU_29, IHU_29);

	/* DLC Check */
	IHU_29.DataLength = @Error_panel_vehicle::i_DLCError[MSG_CONFIG_TX_IHU_29]?1:DBLookup(IHU_29).dlc;

}

PROJ_CalcMsg_IHU_30()
{
	/* IHU_30_Reserved_2 */
	if(!@Vehicle_Signals::i_IHU_30_Reserved_2_SIM)
	{
		if(@Vehicle_Signals::i_IHU_30_Reserved_2_EN)
		{
			IHU_30.IHU_30_Reserved_2 = @Vehicle_Signals::i_IHU_30_Reserved_2_Raw;
		}
		else
		{
			IHU_30.IHU_30_Reserved_2.phys = @Vehicle_Signals::i_IHU_30_Reserved_2;
		}
	}
	else
	{
		// To be completed in simulation
	}

	/* NavCountryCodeInfo */
	if(!@Vehicle_Signals::i_NavCountryCodeInfo_SIM)
	{
		if(@Vehicle_Signals::i_NavCountryCodeInfo_EN)
		{
			IHU_30.NavCountryCodeInfo = @Vehicle_Signals::i_NavCountryCodeInfo_Raw;
		}
		else
		{
			IHU_30.NavCountryCodeInfo.phys = @Vehicle_Signals::i_NavCountryCodeInfo;
		}
	}
	else
	{
		// To be completed in simulation
	}

	/* NavFogSpeedLimit */
	if(!@Vehicle_Signals::i_NavFogSpeedLimit_SIM)
	{
		if(@Vehicle_Signals::i_NavFogSpeedLimit_EN)
		{
			IHU_30.NavFogSpeedLimit = @Vehicle_Signals::i_NavFogSpeedLimit_Raw;
		}
		else
		{
			IHU_30.NavFogSpeedLimit.phys = @Vehicle_Signals::i_NavFogSpeedLimit;
		}
	}
	else
	{
		// To be completed in simulation
	}

	/* NavJunctions */
	if(!@Vehicle_Signals::i_NavJunctions_SIM)
	{
		if(@Vehicle_Signals::i_NavJunctions_EN)
		{
			IHU_30.NavJunctions = @Vehicle_Signals::i_NavJunctions_Raw;
		}
		else
		{
			IHU_30.NavJunctions.phys = @Vehicle_Signals::i_NavJunctions;
		}
	}
	else
	{
		// To be completed in simulation
	}

	/* NavRainSpeedLimit */
	if(!@Vehicle_Signals::i_NavRainSpeedLimit_SIM)
	{
		if(@Vehicle_Signals::i_NavRainSpeedLimit_EN)
		{
			IHU_30.NavRainSpeedLimit = @Vehicle_Signals::i_NavRainSpeedLimit_Raw;
		}
		else
		{
			IHU_30.NavRainSpeedLimit.phys = @Vehicle_Signals::i_NavRainSpeedLimit;
		}
	}
	else
	{
		// To be completed in simulation
	}

	/* NavRampDistance */
	if(!@Vehicle_Signals::i_NavRampDistance_SIM)
	{
		if(@Vehicle_Signals::i_NavRampDistance_EN)
		{
			IHU_30.NavRampDistance = @Vehicle_Signals::i_NavRampDistance_Raw;
		}
		else
		{
			IHU_30.NavRampDistance.phys = @Vehicle_Signals::i_NavRampDistance;
		}
	}
	else
	{
		// To be completed in simulation
	}

	/* NavRampInfo */
	if(!@Vehicle_Signals::i_NavRampInfo_SIM)
	{
		if(@Vehicle_Signals::i_NavRampInfo_EN)
		{
			IHU_30.NavRampInfo = @Vehicle_Signals::i_NavRampInfo_Raw;
		}
		else
		{
			IHU_30.NavRampInfo.phys = @Vehicle_Signals::i_NavRampInfo;
		}
	}
	else
	{
		// To be completed in simulation
	}

	/* NavRoundabouts */
	if(!@Vehicle_Signals::i_NavRoundabouts_SIM)
	{
		if(@Vehicle_Signals::i_NavRoundabouts_EN)
		{
			IHU_30.NavRoundabouts = @Vehicle_Signals::i_NavRoundabouts_Raw;
		}
		else
		{
			IHU_30.NavRoundabouts.phys = @Vehicle_Signals::i_NavRoundabouts;
		}
	}
	else
	{
		// To be completed in simulation
	}

	/* NavSnowSpeedLimit */
	if(!@Vehicle_Signals::i_NavSnowSpeedLimit_SIM)
	{
		if(@Vehicle_Signals::i_NavSnowSpeedLimit_EN)
		{
			IHU_30.NavSnowSpeedLimit = @Vehicle_Signals::i_NavSnowSpeedLimit_Raw;
		}
		else
		{
			IHU_30.NavSnowSpeedLimit.phys = @Vehicle_Signals::i_NavSnowSpeedLimit;
		}
	}
	else
	{
		// To be completed in simulation
	}

	/* NavSpeedLimitType */
	if(!@Vehicle_Signals::i_NavSpeedLimitType_SIM)
	{
		if(@Vehicle_Signals::i_NavSpeedLimitType_EN)
		{
			IHU_30.NavSpeedLimitType = @Vehicle_Signals::i_NavSpeedLimitType_Raw;
		}
		else
		{
			IHU_30.NavSpeedLimitType.phys = @Vehicle_Signals::i_NavSpeedLimitType;
		}
	}
	else
	{
		// To be completed in simulation
	}

	/* NavSpeedLimit_EV */
	if(!@Vehicle_Signals::i_NavSpeedLimit_EV_SIM)
	{
		if(@Vehicle_Signals::i_NavSpeedLimit_EV_EN)
		{
			IHU_30.NavSpeedLimit_EV = @Vehicle_Signals::i_NavSpeedLimit_EV_Raw;
		}
		else
		{
			IHU_30.NavSpeedLimit_EV.phys = @Vehicle_Signals::i_NavSpeedLimit_EV;
		}
	}
	else
	{
		// To be completed in simulation
	}

	/* Rolling counter */
	PROJ_Sim_Rollingcounter(MSG_CONFIG_TX_IHU_30, IHU_30);

	/* CheckSum */
	PROJ_Sim_Checksum(MSG_CONFIG_TX_IHU_30, IHU_30);

	/* DLC Check */
	IHU_30.DataLength = @Error_panel_vehicle::i_DLCError[MSG_CONFIG_TX_IHU_30]?1:DBLookup(IHU_30).dlc;

}

PROJ_CalcMsg_IHU_31()
{
	/* AdasSignDistance */
	if(!@Vehicle_Signals::i_AdasSignDistance_SIM)
	{
		if(@Vehicle_Signals::i_AdasSignDistance_EN)
		{
			IHU_31.AdasSignDistance = @Vehicle_Signals::i_AdasSignDistance_Raw;
		}
		else
		{
			IHU_31.AdasSignDistance.phys = @Vehicle_Signals::i_AdasSignDistance;
		}
	}
	else
	{
		// To be completed in simulation
	}

	/* AdasSignType_reserve */
	if(!@Vehicle_Signals::i_AdasSignType_reserve_SIM)
	{
		if(@Vehicle_Signals::i_AdasSignType_reserve_EN)
		{
			IHU_31.AdasSignType_reserve = @Vehicle_Signals::i_AdasSignType_reserve_Raw;
		}
		else
		{
			IHU_31.AdasSignType_reserve.phys = @Vehicle_Signals::i_AdasSignType_reserve;
		}
	}
	else
	{
		// To be completed in simulation
	}

	/* NavTrafficlights */
	if(!@Vehicle_Signals::i_NavTrafficlights_SIM)
	{
		if(@Vehicle_Signals::i_NavTrafficlights_EN)
		{
			IHU_31.NavTrafficlights = @Vehicle_Signals::i_NavTrafficlights_Raw;
		}
		else
		{
			IHU_31.NavTrafficlights.phys = @Vehicle_Signals::i_NavTrafficlights;
		}
	}
	else
	{
		// To be completed in simulation
	}

	/* NavWinding */
	if(!@Vehicle_Signals::i_NavWinding_SIM)
	{
		if(@Vehicle_Signals::i_NavWinding_EN)
		{
			IHU_31.NavWinding = @Vehicle_Signals::i_NavWinding_Raw;
		}
		else
		{
			IHU_31.NavWinding.phys = @Vehicle_Signals::i_NavWinding;
		}
	}
	else
	{
		// To be completed in simulation
	}

	/* Rolling counter */
	PROJ_Sim_Rollingcounter(MSG_CONFIG_TX_IHU_31, IHU_31);

	/* CheckSum */
	PROJ_Sim_Checksum(MSG_CONFIG_TX_IHU_31, IHU_31);

	/* DLC Check */
	IHU_31.DataLength = @Error_panel_vehicle::i_DLCError[MSG_CONFIG_TX_IHU_31]?1:DBLookup(IHU_31).dlc;

}

PROJ_CalcMsg_IPB_11()
{
	/* IPB_InputRodStroke */
	if(!@Vehicle_Signals::i_IPB_InputRodStroke_SIM)
	{
		if(@Vehicle_Signals::i_IPB_InputRodStroke_EN)
		{
			IPB_11.IPB_InputRodStroke = @Vehicle_Signals::i_IPB_InputRodStroke_Raw;
		}
		else
		{
			IPB_11.IPB_InputRodStroke.phys = @Vehicle_Signals::i_IPB_InputRodStroke;
		}
	}
	else
	{
		// To be completed in simulation
	}

	/* IPB_InputRodStrokeStatus */
	if(!@Vehicle_Signals::i_IPB_InputRodStrokeStatus_SIM)
	{
		if(@Vehicle_Signals::i_IPB_InputRodStrokeStatus_EN)
		{
			IPB_11.IPB_InputRodStrokeStatus = @Vehicle_Signals::i_IPB_InputRodStrokeStatus_Raw;
		}
		else
		{
			IPB_11.IPB_InputRodStrokeStatus.phys = @Vehicle_Signals::i_IPB_InputRodStrokeStatus;
		}
	}
	else
	{
		// To be completed in simulation
	}

	/* Rolling counter */
	PROJ_Sim_Rollingcounter(MSG_CONFIG_TX_IPB_11, IPB_11);

	/* CheckSum */
	PROJ_Sim_Checksum(MSG_CONFIG_TX_IPB_11, IPB_11);

	/* DLC Check */
	IPB_11.DataLength = @Error_panel_vehicle::i_DLCError[MSG_CONFIG_TX_IPB_11]?1:DBLookup(IPB_11).dlc;

}

PROJ_CalcMsg_MFS_2()
{
	/* MFS_Cruise_Control */
	if(!@Vehicle_Signals::i_MFS_Cruise_Control_SIM)
	{
		if(@Vehicle_Signals::i_MFS_Cruise_Control_EN)
		{
			MFS_2.MFS_Cruise_Control = @Vehicle_Signals::i_MFS_Cruise_Control_Raw;
		}
		else
		{
			MFS_2.MFS_Cruise_Control.phys = @Vehicle_Signals::i_MFS_Cruise_Control;
		}
	}
	else
	{
		// To be completed in simulation
	}

	/* MFS_RESPlus */
	if(!@Vehicle_Signals::i_MFS_RESPlus_SIM)
	{
		if(@Vehicle_Signals::i_MFS_RESPlus_EN)
		{
			MFS_2.MFS_RESPlus = @Vehicle_Signals::i_MFS_RESPlus_Raw;
		}
		else
		{
			MFS_2.MFS_RESPlus.phys = @Vehicle_Signals::i_MFS_RESPlus;
		}
	}
	else
	{
		// To be completed in simulation
	}

	/* MFS_SETMinus */
	if(!@Vehicle_Signals::i_MFS_SETMinus_SIM)
	{
		if(@Vehicle_Signals::i_MFS_SETMinus_EN)
		{
			MFS_2.MFS_SETMinus = @Vehicle_Signals::i_MFS_SETMinus_Raw;
		}
		else
		{
			MFS_2.MFS_SETMinus.phys = @Vehicle_Signals::i_MFS_SETMinus;
		}
	}
	else
	{
		// To be completed in simulation
	}

	/* MFS_Speed_limit */
	if(!@Vehicle_Signals::i_MFS_Speed_limit_SIM)
	{
		if(@Vehicle_Signals::i_MFS_Speed_limit_EN)
		{
			MFS_2.MFS_Speed_limit = @Vehicle_Signals::i_MFS_Speed_limit_Raw;
		}
		else
		{
			MFS_2.MFS_Speed_limit.phys = @Vehicle_Signals::i_MFS_Speed_limit;
		}
	}
	else
	{
		// To be completed in simulation
	}

	/* MFS_Time_Gap_Add */
	if(!@Vehicle_Signals::i_MFS_Time_Gap_Add_SIM)
	{
		if(@Vehicle_Signals::i_MFS_Time_Gap_Add_EN)
		{
			MFS_2.MFS_Time_Gap_Add = @Vehicle_Signals::i_MFS_Time_Gap_Add_Raw;
		}
		else
		{
			MFS_2.MFS_Time_Gap_Add.phys = @Vehicle_Signals::i_MFS_Time_Gap_Add;
		}
	}
	else
	{
		// To be completed in simulation
	}

	/* MFS_Time_Gap_Reduce */
	if(!@Vehicle_Signals::i_MFS_Time_Gap_Reduce_SIM)
	{
		if(@Vehicle_Signals::i_MFS_Time_Gap_Reduce_EN)
		{
			MFS_2.MFS_Time_Gap_Reduce = @Vehicle_Signals::i_MFS_Time_Gap_Reduce_Raw;
		}
		else
		{
			MFS_2.MFS_Time_Gap_Reduce.phys = @Vehicle_Signals::i_MFS_Time_Gap_Reduce;
		}
	}
	else
	{
		// To be completed in simulation
	}

	/* Rolling counter */
	PROJ_Sim_Rollingcounter(MSG_CONFIG_TX_MFS_2, MFS_2);

	/* CheckSum */
	PROJ_Sim_Checksum(MSG_CONFIG_TX_MFS_2, MFS_2);

	/* DLC Check */
	MFS_2.DataLength = @Error_panel_vehicle::i_DLCError[MSG_CONFIG_TX_MFS_2]?1:DBLookup(MFS_2).dlc;

}

PROJ_CalcMsg_RLCR_1()
{
	/* RLCR_1_BlkSts */
	if(!@Vehicle_Signals::i_RLCR_1_BlkSts_SIM)
	{
		if(@Vehicle_Signals::i_RLCR_1_BlkSts_EN)
		{
			RLCR_1.RLCR_1_BlkSts = @Vehicle_Signals::i_RLCR_1_BlkSts_Raw;
		}
		else
		{
			RLCR_1.RLCR_1_BlkSts.phys = @Vehicle_Signals::i_RLCR_1_BlkSts;
		}
	}
	else
	{
		// To be completed in simulation
	}

	/* RLCR_1_ELKSts */
	if(!@Vehicle_Signals::i_RLCR_1_ELKSts_SIM)
	{
		if(@Vehicle_Signals::i_RLCR_1_ELKSts_EN)
		{
			RLCR_1.RLCR_1_ELKSts = @Vehicle_Signals::i_RLCR_1_ELKSts_Raw;
		}
		else
		{
			RLCR_1.RLCR_1_ELKSts.phys = @Vehicle_Signals::i_RLCR_1_ELKSts;
		}
	}
	else
	{
		// To be completed in simulation
	}

	/* RLCR_1_SysSt */
	if(!@Vehicle_Signals::i_RLCR_1_SysSt_SIM)
	{
		if(@Vehicle_Signals::i_RLCR_1_SysSt_EN)
		{
			RLCR_1.RLCR_1_SysSt = @Vehicle_Signals::i_RLCR_1_SysSt_Raw;
		}
		else
		{
			RLCR_1.RLCR_1_SysSt.phys = @Vehicle_Signals::i_RLCR_1_SysSt;
		}
	}
	else
	{
		// To be completed in simulation
	}

	/* Rolling counter */
	PROJ_Sim_Rollingcounter(MSG_CONFIG_TX_RLCR_1, RLCR_1);

	/* CheckSum */
	PROJ_Sim_Checksum(MSG_CONFIG_TX_RLCR_1, RLCR_1);

	/* DLC Check */
	RLCR_1.DataLength = @Error_panel_vehicle::i_DLCError[MSG_CONFIG_TX_RLCR_1]?1:DBLookup(RLCR_1).dlc;

}

PROJ_CalcMsg_RLCR_3()
{
	/* RLCR_3_Le1HdTo */
	if(!@Vehicle_Signals::i_RLCR_3_Le1HdTo_SIM)
	{
		if(@Vehicle_Signals::i_RLCR_3_Le1HdTo_EN)
		{
			RLCR_3.RLCR_3_Le1HdTo = @Vehicle_Signals::i_RLCR_3_Le1HdTo_Raw;
		}
		else
		{
			RLCR_3.RLCR_3_Le1HdTo.phys = @Vehicle_Signals::i_RLCR_3_Le1HdTo;
		}
	}
	else
	{
		// To be completed in simulation
	}

	/* RLCR_3_Le1ObjBoxLen */
	if(!@Vehicle_Signals::i_RLCR_3_Le1ObjBoxLen_SIM)
	{
		if(@Vehicle_Signals::i_RLCR_3_Le1ObjBoxLen_EN)
		{
			RLCR_3.RLCR_3_Le1ObjBoxLen = @Vehicle_Signals::i_RLCR_3_Le1ObjBoxLen_Raw;
		}
		else
		{
			RLCR_3.RLCR_3_Le1ObjBoxLen.phys = @Vehicle_Signals::i_RLCR_3_Le1ObjBoxLen;
		}
	}
	else
	{
		// To be completed in simulation
	}

	/* RLCR_3_Le1ObjBoxWidth */
	if(!@Vehicle_Signals::i_RLCR_3_Le1ObjBoxWidth_SIM)
	{
		if(@Vehicle_Signals::i_RLCR_3_Le1ObjBoxWidth_EN)
		{
			RLCR_3.RLCR_3_Le1ObjBoxWidth = @Vehicle_Signals::i_RLCR_3_Le1ObjBoxWidth_Raw;
		}
		else
		{
			RLCR_3.RLCR_3_Le1ObjBoxWidth.phys = @Vehicle_Signals::i_RLCR_3_Le1ObjBoxWidth;
		}
	}
	else
	{
		// To be completed in simulation
	}

	/* RLCR_3_Le1ObjConf */
	if(!@Vehicle_Signals::i_RLCR_3_Le1ObjConf_SIM)
	{
		if(@Vehicle_Signals::i_RLCR_3_Le1ObjConf_EN)
		{
			RLCR_3.RLCR_3_Le1ObjConf = @Vehicle_Signals::i_RLCR_3_Le1ObjConf_Raw;
		}
		else
		{
			RLCR_3.RLCR_3_Le1ObjConf.phys = @Vehicle_Signals::i_RLCR_3_Le1ObjConf;
		}
	}
	else
	{
		// To be completed in simulation
	}

	/* RLCR_3_Le1ObjCoordX */
	if(!@Vehicle_Signals::i_RLCR_3_Le1ObjCoordX_SIM)
	{
		if(@Vehicle_Signals::i_RLCR_3_Le1ObjCoordX_EN)
		{
			RLCR_3.RLCR_3_Le1ObjCoordX = @Vehicle_Signals::i_RLCR_3_Le1ObjCoordX_Raw;
		}
		else
		{
			RLCR_3.RLCR_3_Le1ObjCoordX.phys = @Vehicle_Signals::i_RLCR_3_Le1ObjCoordX;
		}
	}
	else
	{
		// To be completed in simulation
	}

	/* RLCR_3_Le1ObjCoordXDstStdDe */
	if(!@Vehicle_Signals::i_RLCR_3_Le1ObjCoordXDstStdDe_SIM)
	{
		if(@Vehicle_Signals::i_RLCR_3_Le1ObjCoordXDstStdDe_EN)
		{
			RLCR_3.RLCR_3_Le1ObjCoordXDstStdDe = @Vehicle_Signals::i_RLCR_3_Le1ObjCoordXDstStdDe_Raw;
		}
		else
		{
			RLCR_3.RLCR_3_Le1ObjCoordXDstStdDe.phys = @Vehicle_Signals::i_RLCR_3_Le1ObjCoordXDstStdDe;
		}
	}
	else
	{
		// To be completed in simulation
	}

	/* RLCR_3_Le1ObjCoordY */
	if(!@Vehicle_Signals::i_RLCR_3_Le1ObjCoordY_SIM)
	{
		if(@Vehicle_Signals::i_RLCR_3_Le1ObjCoordY_EN)
		{
			RLCR_3.RLCR_3_Le1ObjCoordY = @Vehicle_Signals::i_RLCR_3_Le1ObjCoordY_Raw;
		}
		else
		{
			RLCR_3.RLCR_3_Le1ObjCoordY.phys = @Vehicle_Signals::i_RLCR_3_Le1ObjCoordY;
		}
	}
	else
	{
		// To be completed in simulation
	}

	/* RLCR_3_Le1ObjCoordYDstStdDe */
	if(!@Vehicle_Signals::i_RLCR_3_Le1ObjCoordYDstStdDe_SIM)
	{
		if(@Vehicle_Signals::i_RLCR_3_Le1ObjCoordYDstStdDe_EN)
		{
			RLCR_3.RLCR_3_Le1ObjCoordYDstStdDe = @Vehicle_Signals::i_RLCR_3_Le1ObjCoordYDstStdDe_Raw;
		}
		else
		{
			RLCR_3.RLCR_3_Le1ObjCoordYDstStdDe.phys = @Vehicle_Signals::i_RLCR_3_Le1ObjCoordYDstStdDe;
		}
	}
	else
	{
		// To be completed in simulation
	}

	/* RLCR_3_Le1ObjID */
	if(!@Vehicle_Signals::i_RLCR_3_Le1ObjID_SIM)
	{
		if(@Vehicle_Signals::i_RLCR_3_Le1ObjID_EN)
		{
			RLCR_3.RLCR_3_Le1ObjID = @Vehicle_Signals::i_RLCR_3_Le1ObjID_Raw;
		}
		else
		{
			RLCR_3.RLCR_3_Le1ObjID.phys = @Vehicle_Signals::i_RLCR_3_Le1ObjID;
		}
	}
	else
	{
		// To be completed in simulation
	}

	/* RLCR_3_Le1ObjMtnChartc */
	if(!@Vehicle_Signals::i_RLCR_3_Le1ObjMtnChartc_SIM)
	{
		if(@Vehicle_Signals::i_RLCR_3_Le1ObjMtnChartc_EN)
		{
			RLCR_3.RLCR_3_Le1ObjMtnChartc = @Vehicle_Signals::i_RLCR_3_Le1ObjMtnChartc_Raw;
		}
		else
		{
			RLCR_3.RLCR_3_Le1ObjMtnChartc.phys = @Vehicle_Signals::i_RLCR_3_Le1ObjMtnChartc;
		}
	}
	else
	{
		// To be completed in simulation
	}

	/* RLCR_3_Le1ObjNrOffocst */
	if(!@Vehicle_Signals::i_RLCR_3_Le1ObjNrOffocst_SIM)
	{
		if(@Vehicle_Signals::i_RLCR_3_Le1ObjNrOffocst_EN)
		{
			RLCR_3.RLCR_3_Le1ObjNrOffocst = @Vehicle_Signals::i_RLCR_3_Le1ObjNrOffocst_Raw;
		}
		else
		{
			RLCR_3.RLCR_3_Le1ObjNrOffocst.phys = @Vehicle_Signals::i_RLCR_3_Le1ObjNrOffocst;
		}
	}
	else
	{
		// To be completed in simulation
	}

	/* RLCR_3_Le1ObjTrackSt */
	if(!@Vehicle_Signals::i_RLCR_3_Le1ObjTrackSt_SIM)
	{
		if(@Vehicle_Signals::i_RLCR_3_Le1ObjTrackSt_EN)
		{
			RLCR_3.RLCR_3_Le1ObjTrackSt = @Vehicle_Signals::i_RLCR_3_Le1ObjTrackSt_Raw;
		}
		else
		{
			RLCR_3.RLCR_3_Le1ObjTrackSt.phys = @Vehicle_Signals::i_RLCR_3_Le1ObjTrackSt;
		}
	}
	else
	{
		// To be completed in simulation
	}

	/* RLCR_3_Le1ObjTyp */
	if(!@Vehicle_Signals::i_RLCR_3_Le1ObjTyp_SIM)
	{
		if(@Vehicle_Signals::i_RLCR_3_Le1ObjTyp_EN)
		{
			RLCR_3.RLCR_3_Le1ObjTyp = @Vehicle_Signals::i_RLCR_3_Le1ObjTyp_Raw;
		}
		else
		{
			RLCR_3.RLCR_3_Le1ObjTyp.phys = @Vehicle_Signals::i_RLCR_3_Le1ObjTyp;
		}
	}
	else
	{
		// To be completed in simulation
	}

	/* RLCR_3_Le1ObjXDirAV */
	if(!@Vehicle_Signals::i_RLCR_3_Le1ObjXDirAV_SIM)
	{
		if(@Vehicle_Signals::i_RLCR_3_Le1ObjXDirAV_EN)
		{
			RLCR_3.RLCR_3_Le1ObjXDirAV = @Vehicle_Signals::i_RLCR_3_Le1ObjXDirAV_Raw;
		}
		else
		{
			RLCR_3.RLCR_3_Le1ObjXDirAV.phys = @Vehicle_Signals::i_RLCR_3_Le1ObjXDirAV;
		}
	}
	else
	{
		// To be completed in simulation
	}

	/* RLCR_3_Le1ObjXDirV */
	if(!@Vehicle_Signals::i_RLCR_3_Le1ObjXDirV_SIM)
	{
		if(@Vehicle_Signals::i_RLCR_3_Le1ObjXDirV_EN)
		{
			RLCR_3.RLCR_3_Le1ObjXDirV = @Vehicle_Signals::i_RLCR_3_Le1ObjXDirV_Raw;
		}
		else
		{
			RLCR_3.RLCR_3_Le1ObjXDirV.phys = @Vehicle_Signals::i_RLCR_3_Le1ObjXDirV;
		}
	}
	else
	{
		// To be completed in simulation
	}

	/* RLCR_3_Le1ObjXDirVStdDe */
	if(!@Vehicle_Signals::i_RLCR_3_Le1ObjXDirVStdDe_SIM)
	{
		if(@Vehicle_Signals::i_RLCR_3_Le1ObjXDirVStdDe_EN)
		{
			RLCR_3.RLCR_3_Le1ObjXDirVStdDe = @Vehicle_Signals::i_RLCR_3_Le1ObjXDirVStdDe_Raw;
		}
		else
		{
			RLCR_3.RLCR_3_Le1ObjXDirVStdDe.phys = @Vehicle_Signals::i_RLCR_3_Le1ObjXDirVStdDe;
		}
	}
	else
	{
		// To be completed in simulation
	}

	/* RLCR_3_Le1ObjYDirV */
	if(!@Vehicle_Signals::i_RLCR_3_Le1ObjYDirV_SIM)
	{
		if(@Vehicle_Signals::i_RLCR_3_Le1ObjYDirV_EN)
		{
			RLCR_3.RLCR_3_Le1ObjYDirV = @Vehicle_Signals::i_RLCR_3_Le1ObjYDirV_Raw;
		}
		else
		{
			RLCR_3.RLCR_3_Le1ObjYDirV.phys = @Vehicle_Signals::i_RLCR_3_Le1ObjYDirV;
		}
	}
	else
	{
		// To be completed in simulation
	}

	/* RLCR_3_Le1ObjYDirVStdDe */
	if(!@Vehicle_Signals::i_RLCR_3_Le1ObjYDirVStdDe_SIM)
	{
		if(@Vehicle_Signals::i_RLCR_3_Le1ObjYDirVStdDe_EN)
		{
			RLCR_3.RLCR_3_Le1ObjYDirVStdDe = @Vehicle_Signals::i_RLCR_3_Le1ObjYDirVStdDe_Raw;
		}
		else
		{
			RLCR_3.RLCR_3_Le1ObjYDirVStdDe.phys = @Vehicle_Signals::i_RLCR_3_Le1ObjYDirVStdDe;
		}
	}
	else
	{
		// To be completed in simulation
	}

	/* Rolling counter */
	PROJ_Sim_Rollingcounter(MSG_CONFIG_TX_RLCR_3, RLCR_3);

	/* CheckSum */
	PROJ_Sim_Checksum(MSG_CONFIG_TX_RLCR_3, RLCR_3);

	/* DLC Check */
	RLCR_3.DataLength = @Error_panel_vehicle::i_DLCError[MSG_CONFIG_TX_RLCR_3]?1:DBLookup(RLCR_3).dlc;

}

PROJ_CalcMsg_RLCR_4()
{
	/* RLCR_4_Le2HdTo */
	if(!@Vehicle_Signals::i_RLCR_4_Le2HdTo_SIM)
	{
		if(@Vehicle_Signals::i_RLCR_4_Le2HdTo_EN)
		{
			RLCR_4.RLCR_4_Le2HdTo = @Vehicle_Signals::i_RLCR_4_Le2HdTo_Raw;
		}
		else
		{
			RLCR_4.RLCR_4_Le2HdTo.phys = @Vehicle_Signals::i_RLCR_4_Le2HdTo;
		}
	}
	else
	{
		// To be completed in simulation
	}

	/* RLCR_4_Le2ObjBoxLen */
	if(!@Vehicle_Signals::i_RLCR_4_Le2ObjBoxLen_SIM)
	{
		if(@Vehicle_Signals::i_RLCR_4_Le2ObjBoxLen_EN)
		{
			RLCR_4.RLCR_4_Le2ObjBoxLen = @Vehicle_Signals::i_RLCR_4_Le2ObjBoxLen_Raw;
		}
		else
		{
			RLCR_4.RLCR_4_Le2ObjBoxLen.phys = @Vehicle_Signals::i_RLCR_4_Le2ObjBoxLen;
		}
	}
	else
	{
		// To be completed in simulation
	}

	/* RLCR_4_Le2ObjBoxWidth */
	if(!@Vehicle_Signals::i_RLCR_4_Le2ObjBoxWidth_SIM)
	{
		if(@Vehicle_Signals::i_RLCR_4_Le2ObjBoxWidth_EN)
		{
			RLCR_4.RLCR_4_Le2ObjBoxWidth = @Vehicle_Signals::i_RLCR_4_Le2ObjBoxWidth_Raw;
		}
		else
		{
			RLCR_4.RLCR_4_Le2ObjBoxWidth.phys = @Vehicle_Signals::i_RLCR_4_Le2ObjBoxWidth;
		}
	}
	else
	{
		// To be completed in simulation
	}

	/* RLCR_4_Le2ObjConf */
	if(!@Vehicle_Signals::i_RLCR_4_Le2ObjConf_SIM)
	{
		if(@Vehicle_Signals::i_RLCR_4_Le2ObjConf_EN)
		{
			RLCR_4.RLCR_4_Le2ObjConf = @Vehicle_Signals::i_RLCR_4_Le2ObjConf_Raw;
		}
		else
		{
			RLCR_4.RLCR_4_Le2ObjConf.phys = @Vehicle_Signals::i_RLCR_4_Le2ObjConf;
		}
	}
	else
	{
		// To be completed in simulation
	}

	/* RLCR_4_Le2ObjCoordX */
	if(!@Vehicle_Signals::i_RLCR_4_Le2ObjCoordX_SIM)
	{
		if(@Vehicle_Signals::i_RLCR_4_Le2ObjCoordX_EN)
		{
			RLCR_4.RLCR_4_Le2ObjCoordX = @Vehicle_Signals::i_RLCR_4_Le2ObjCoordX_Raw;
		}
		else
		{
			RLCR_4.RLCR_4_Le2ObjCoordX.phys = @Vehicle_Signals::i_RLCR_4_Le2ObjCoordX;
		}
	}
	else
	{
		// To be completed in simulation
	}

	/* RLCR_4_Le2ObjCoordXDstStdDe */
	if(!@Vehicle_Signals::i_RLCR_4_Le2ObjCoordXDstStdDe_SIM)
	{
		if(@Vehicle_Signals::i_RLCR_4_Le2ObjCoordXDstStdDe_EN)
		{
			RLCR_4.RLCR_4_Le2ObjCoordXDstStdDe = @Vehicle_Signals::i_RLCR_4_Le2ObjCoordXDstStdDe_Raw;
		}
		else
		{
			RLCR_4.RLCR_4_Le2ObjCoordXDstStdDe.phys = @Vehicle_Signals::i_RLCR_4_Le2ObjCoordXDstStdDe;
		}
	}
	else
	{
		// To be completed in simulation
	}

	/* RLCR_4_Le2ObjCoordY */
	if(!@Vehicle_Signals::i_RLCR_4_Le2ObjCoordY_SIM)
	{
		if(@Vehicle_Signals::i_RLCR_4_Le2ObjCoordY_EN)
		{
			RLCR_4.RLCR_4_Le2ObjCoordY = @Vehicle_Signals::i_RLCR_4_Le2ObjCoordY_Raw;
		}
		else
		{
			RLCR_4.RLCR_4_Le2ObjCoordY.phys = @Vehicle_Signals::i_RLCR_4_Le2ObjCoordY;
		}
	}
	else
	{
		// To be completed in simulation
	}

	/* RLCR_4_Le2ObjCoordYDstStdDe */
	if(!@Vehicle_Signals::i_RLCR_4_Le2ObjCoordYDstStdDe_SIM)
	{
		if(@Vehicle_Signals::i_RLCR_4_Le2ObjCoordYDstStdDe_EN)
		{
			RLCR_4.RLCR_4_Le2ObjCoordYDstStdDe = @Vehicle_Signals::i_RLCR_4_Le2ObjCoordYDstStdDe_Raw;
		}
		else
		{
			RLCR_4.RLCR_4_Le2ObjCoordYDstStdDe.phys = @Vehicle_Signals::i_RLCR_4_Le2ObjCoordYDstStdDe;
		}
	}
	else
	{
		// To be completed in simulation
	}

	/* RLCR_4_Le2ObjID */
	if(!@Vehicle_Signals::i_RLCR_4_Le2ObjID_SIM)
	{
		if(@Vehicle_Signals::i_RLCR_4_Le2ObjID_EN)
		{
			RLCR_4.RLCR_4_Le2ObjID = @Vehicle_Signals::i_RLCR_4_Le2ObjID_Raw;
		}
		else
		{
			RLCR_4.RLCR_4_Le2ObjID.phys = @Vehicle_Signals::i_RLCR_4_Le2ObjID;
		}
	}
	else
	{
		// To be completed in simulation
	}

	/* RLCR_4_Le2ObjMtnChartc */
	if(!@Vehicle_Signals::i_RLCR_4_Le2ObjMtnChartc_SIM)
	{
		if(@Vehicle_Signals::i_RLCR_4_Le2ObjMtnChartc_EN)
		{
			RLCR_4.RLCR_4_Le2ObjMtnChartc = @Vehicle_Signals::i_RLCR_4_Le2ObjMtnChartc_Raw;
		}
		else
		{
			RLCR_4.RLCR_4_Le2ObjMtnChartc.phys = @Vehicle_Signals::i_RLCR_4_Le2ObjMtnChartc;
		}
	}
	else
	{
		// To be completed in simulation
	}

	/* RLCR_4_Le2ObjNrOffocst */
	if(!@Vehicle_Signals::i_RLCR_4_Le2ObjNrOffocst_SIM)
	{
		if(@Vehicle_Signals::i_RLCR_4_Le2ObjNrOffocst_EN)
		{
			RLCR_4.RLCR_4_Le2ObjNrOffocst = @Vehicle_Signals::i_RLCR_4_Le2ObjNrOffocst_Raw;
		}
		else
		{
			RLCR_4.RLCR_4_Le2ObjNrOffocst.phys = @Vehicle_Signals::i_RLCR_4_Le2ObjNrOffocst;
		}
	}
	else
	{
		// To be completed in simulation
	}

	/* RLCR_4_Le2ObjTrackSt */
	if(!@Vehicle_Signals::i_RLCR_4_Le2ObjTrackSt_SIM)
	{
		if(@Vehicle_Signals::i_RLCR_4_Le2ObjTrackSt_EN)
		{
			RLCR_4.RLCR_4_Le2ObjTrackSt = @Vehicle_Signals::i_RLCR_4_Le2ObjTrackSt_Raw;
		}
		else
		{
			RLCR_4.RLCR_4_Le2ObjTrackSt.phys = @Vehicle_Signals::i_RLCR_4_Le2ObjTrackSt;
		}
	}
	else
	{
		// To be completed in simulation
	}

	/* RLCR_4_Le2ObjTyp */
	if(!@Vehicle_Signals::i_RLCR_4_Le2ObjTyp_SIM)
	{
		if(@Vehicle_Signals::i_RLCR_4_Le2ObjTyp_EN)
		{
			RLCR_4.RLCR_4_Le2ObjTyp = @Vehicle_Signals::i_RLCR_4_Le2ObjTyp_Raw;
		}
		else
		{
			RLCR_4.RLCR_4_Le2ObjTyp.phys = @Vehicle_Signals::i_RLCR_4_Le2ObjTyp;
		}
	}
	else
	{
		// To be completed in simulation
	}

	/* RLCR_4_Le2ObjXDirAV */
	if(!@Vehicle_Signals::i_RLCR_4_Le2ObjXDirAV_SIM)
	{
		if(@Vehicle_Signals::i_RLCR_4_Le2ObjXDirAV_EN)
		{
			RLCR_4.RLCR_4_Le2ObjXDirAV = @Vehicle_Signals::i_RLCR_4_Le2ObjXDirAV_Raw;
		}
		else
		{
			RLCR_4.RLCR_4_Le2ObjXDirAV.phys = @Vehicle_Signals::i_RLCR_4_Le2ObjXDirAV;
		}
	}
	else
	{
		// To be completed in simulation
	}

	/* RLCR_4_Le2ObjXDirV */
	if(!@Vehicle_Signals::i_RLCR_4_Le2ObjXDirV_SIM)
	{
		if(@Vehicle_Signals::i_RLCR_4_Le2ObjXDirV_EN)
		{
			RLCR_4.RLCR_4_Le2ObjXDirV = @Vehicle_Signals::i_RLCR_4_Le2ObjXDirV_Raw;
		}
		else
		{
			RLCR_4.RLCR_4_Le2ObjXDirV.phys = @Vehicle_Signals::i_RLCR_4_Le2ObjXDirV;
		}
	}
	else
	{
		// To be completed in simulation
	}

	/* RLCR_4_Le2ObjXDirVStdDe */
	if(!@Vehicle_Signals::i_RLCR_4_Le2ObjXDirVStdDe_SIM)
	{
		if(@Vehicle_Signals::i_RLCR_4_Le2ObjXDirVStdDe_EN)
		{
			RLCR_4.RLCR_4_Le2ObjXDirVStdDe = @Vehicle_Signals::i_RLCR_4_Le2ObjXDirVStdDe_Raw;
		}
		else
		{
			RLCR_4.RLCR_4_Le2ObjXDirVStdDe.phys = @Vehicle_Signals::i_RLCR_4_Le2ObjXDirVStdDe;
		}
	}
	else
	{
		// To be completed in simulation
	}

	/* RLCR_4_Le2ObjYDirV */
	if(!@Vehicle_Signals::i_RLCR_4_Le2ObjYDirV_SIM)
	{
		if(@Vehicle_Signals::i_RLCR_4_Le2ObjYDirV_EN)
		{
			RLCR_4.RLCR_4_Le2ObjYDirV = @Vehicle_Signals::i_RLCR_4_Le2ObjYDirV_Raw;
		}
		else
		{
			RLCR_4.RLCR_4_Le2ObjYDirV.phys = @Vehicle_Signals::i_RLCR_4_Le2ObjYDirV;
		}
	}
	else
	{
		// To be completed in simulation
	}

	/* RLCR_4_Le2ObjYDirVStdDe */
	if(!@Vehicle_Signals::i_RLCR_4_Le2ObjYDirVStdDe_SIM)
	{
		if(@Vehicle_Signals::i_RLCR_4_Le2ObjYDirVStdDe_EN)
		{
			RLCR_4.RLCR_4_Le2ObjYDirVStdDe = @Vehicle_Signals::i_RLCR_4_Le2ObjYDirVStdDe_Raw;
		}
		else
		{
			RLCR_4.RLCR_4_Le2ObjYDirVStdDe.phys = @Vehicle_Signals::i_RLCR_4_Le2ObjYDirVStdDe;
		}
	}
	else
	{
		// To be completed in simulation
	}

	/* Rolling counter */
	PROJ_Sim_Rollingcounter(MSG_CONFIG_TX_RLCR_4, RLCR_4);

	/* CheckSum */
	PROJ_Sim_Checksum(MSG_CONFIG_TX_RLCR_4, RLCR_4);

	/* DLC Check */
	RLCR_4.DataLength = @Error_panel_vehicle::i_DLCError[MSG_CONFIG_TX_RLCR_4]?1:DBLookup(RLCR_4).dlc;

}

PROJ_CalcMsg_RLCR_5()
{
	/* RLCR_5_Le3HdTo */
	if(!@Vehicle_Signals::i_RLCR_5_Le3HdTo_SIM)
	{
		if(@Vehicle_Signals::i_RLCR_5_Le3HdTo_EN)
		{
			RLCR_5.RLCR_5_Le3HdTo = @Vehicle_Signals::i_RLCR_5_Le3HdTo_Raw;
		}
		else
		{
			RLCR_5.RLCR_5_Le3HdTo.phys = @Vehicle_Signals::i_RLCR_5_Le3HdTo;
		}
	}
	else
	{
		// To be completed in simulation
	}

	/* RLCR_5_Le3ObjBoxLen */
	if(!@Vehicle_Signals::i_RLCR_5_Le3ObjBoxLen_SIM)
	{
		if(@Vehicle_Signals::i_RLCR_5_Le3ObjBoxLen_EN)
		{
			RLCR_5.RLCR_5_Le3ObjBoxLen = @Vehicle_Signals::i_RLCR_5_Le3ObjBoxLen_Raw;
		}
		else
		{
			RLCR_5.RLCR_5_Le3ObjBoxLen.phys = @Vehicle_Signals::i_RLCR_5_Le3ObjBoxLen;
		}
	}
	else
	{
		// To be completed in simulation
	}

	/* RLCR_5_Le3ObjBoxWidth */
	if(!@Vehicle_Signals::i_RLCR_5_Le3ObjBoxWidth_SIM)
	{
		if(@Vehicle_Signals::i_RLCR_5_Le3ObjBoxWidth_EN)
		{
			RLCR_5.RLCR_5_Le3ObjBoxWidth = @Vehicle_Signals::i_RLCR_5_Le3ObjBoxWidth_Raw;
		}
		else
		{
			RLCR_5.RLCR_5_Le3ObjBoxWidth.phys = @Vehicle_Signals::i_RLCR_5_Le3ObjBoxWidth;
		}
	}
	else
	{
		// To be completed in simulation
	}

	/* RLCR_5_Le3ObjConf */
	if(!@Vehicle_Signals::i_RLCR_5_Le3ObjConf_SIM)
	{
		if(@Vehicle_Signals::i_RLCR_5_Le3ObjConf_EN)
		{
			RLCR_5.RLCR_5_Le3ObjConf = @Vehicle_Signals::i_RLCR_5_Le3ObjConf_Raw;
		}
		else
		{
			RLCR_5.RLCR_5_Le3ObjConf.phys = @Vehicle_Signals::i_RLCR_5_Le3ObjConf;
		}
	}
	else
	{
		// To be completed in simulation
	}

	/* RLCR_5_Le3ObjCoordX */
	if(!@Vehicle_Signals::i_RLCR_5_Le3ObjCoordX_SIM)
	{
		if(@Vehicle_Signals::i_RLCR_5_Le3ObjCoordX_EN)
		{
			RLCR_5.RLCR_5_Le3ObjCoordX = @Vehicle_Signals::i_RLCR_5_Le3ObjCoordX_Raw;
		}
		else
		{
			RLCR_5.RLCR_5_Le3ObjCoordX.phys = @Vehicle_Signals::i_RLCR_5_Le3ObjCoordX;
		}
	}
	else
	{
		// To be completed in simulation
	}

	/* RLCR_5_Le3ObjCoordXDstStdDe */
	if(!@Vehicle_Signals::i_RLCR_5_Le3ObjCoordXDstStdDe_SIM)
	{
		if(@Vehicle_Signals::i_RLCR_5_Le3ObjCoordXDstStdDe_EN)
		{
			RLCR_5.RLCR_5_Le3ObjCoordXDstStdDe = @Vehicle_Signals::i_RLCR_5_Le3ObjCoordXDstStdDe_Raw;
		}
		else
		{
			RLCR_5.RLCR_5_Le3ObjCoordXDstStdDe.phys = @Vehicle_Signals::i_RLCR_5_Le3ObjCoordXDstStdDe;
		}
	}
	else
	{
		// To be completed in simulation
	}

	/* RLCR_5_Le3ObjCoordY */
	if(!@Vehicle_Signals::i_RLCR_5_Le3ObjCoordY_SIM)
	{
		if(@Vehicle_Signals::i_RLCR_5_Le3ObjCoordY_EN)
		{
			RLCR_5.RLCR_5_Le3ObjCoordY = @Vehicle_Signals::i_RLCR_5_Le3ObjCoordY_Raw;
		}
		else
		{
			RLCR_5.RLCR_5_Le3ObjCoordY.phys = @Vehicle_Signals::i_RLCR_5_Le3ObjCoordY;
		}
	}
	else
	{
		// To be completed in simulation
	}

	/* RLCR_5_Le3ObjCoordYDstStdDe */
	if(!@Vehicle_Signals::i_RLCR_5_Le3ObjCoordYDstStdDe_SIM)
	{
		if(@Vehicle_Signals::i_RLCR_5_Le3ObjCoordYDstStdDe_EN)
		{
			RLCR_5.RLCR_5_Le3ObjCoordYDstStdDe = @Vehicle_Signals::i_RLCR_5_Le3ObjCoordYDstStdDe_Raw;
		}
		else
		{
			RLCR_5.RLCR_5_Le3ObjCoordYDstStdDe.phys = @Vehicle_Signals::i_RLCR_5_Le3ObjCoordYDstStdDe;
		}
	}
	else
	{
		// To be completed in simulation
	}

	/* RLCR_5_Le3ObjID */
	if(!@Vehicle_Signals::i_RLCR_5_Le3ObjID_SIM)
	{
		if(@Vehicle_Signals::i_RLCR_5_Le3ObjID_EN)
		{
			RLCR_5.RLCR_5_Le3ObjID = @Vehicle_Signals::i_RLCR_5_Le3ObjID_Raw;
		}
		else
		{
			RLCR_5.RLCR_5_Le3ObjID.phys = @Vehicle_Signals::i_RLCR_5_Le3ObjID;
		}
	}
	else
	{
		// To be completed in simulation
	}

	/* RLCR_5_Le3ObjMtnChartc */
	if(!@Vehicle_Signals::i_RLCR_5_Le3ObjMtnChartc_SIM)
	{
		if(@Vehicle_Signals::i_RLCR_5_Le3ObjMtnChartc_EN)
		{
			RLCR_5.RLCR_5_Le3ObjMtnChartc = @Vehicle_Signals::i_RLCR_5_Le3ObjMtnChartc_Raw;
		}
		else
		{
			RLCR_5.RLCR_5_Le3ObjMtnChartc.phys = @Vehicle_Signals::i_RLCR_5_Le3ObjMtnChartc;
		}
	}
	else
	{
		// To be completed in simulation
	}

	/* RLCR_5_Le3ObjNrOffocst */
	if(!@Vehicle_Signals::i_RLCR_5_Le3ObjNrOffocst_SIM)
	{
		if(@Vehicle_Signals::i_RLCR_5_Le3ObjNrOffocst_EN)
		{
			RLCR_5.RLCR_5_Le3ObjNrOffocst = @Vehicle_Signals::i_RLCR_5_Le3ObjNrOffocst_Raw;
		}
		else
		{
			RLCR_5.RLCR_5_Le3ObjNrOffocst.phys = @Vehicle_Signals::i_RLCR_5_Le3ObjNrOffocst;
		}
	}
	else
	{
		// To be completed in simulation
	}

	/* RLCR_5_Le3ObjTrackSt */
	if(!@Vehicle_Signals::i_RLCR_5_Le3ObjTrackSt_SIM)
	{
		if(@Vehicle_Signals::i_RLCR_5_Le3ObjTrackSt_EN)
		{
			RLCR_5.RLCR_5_Le3ObjTrackSt = @Vehicle_Signals::i_RLCR_5_Le3ObjTrackSt_Raw;
		}
		else
		{
			RLCR_5.RLCR_5_Le3ObjTrackSt.phys = @Vehicle_Signals::i_RLCR_5_Le3ObjTrackSt;
		}
	}
	else
	{
		// To be completed in simulation
	}

	/* RLCR_5_Le3ObjTyp */
	if(!@Vehicle_Signals::i_RLCR_5_Le3ObjTyp_SIM)
	{
		if(@Vehicle_Signals::i_RLCR_5_Le3ObjTyp_EN)
		{
			RLCR_5.RLCR_5_Le3ObjTyp = @Vehicle_Signals::i_RLCR_5_Le3ObjTyp_Raw;
		}
		else
		{
			RLCR_5.RLCR_5_Le3ObjTyp.phys = @Vehicle_Signals::i_RLCR_5_Le3ObjTyp;
		}
	}
	else
	{
		// To be completed in simulation
	}

	/* RLCR_5_Le3ObjXDirAV */
	if(!@Vehicle_Signals::i_RLCR_5_Le3ObjXDirAV_SIM)
	{
		if(@Vehicle_Signals::i_RLCR_5_Le3ObjXDirAV_EN)
		{
			RLCR_5.RLCR_5_Le3ObjXDirAV = @Vehicle_Signals::i_RLCR_5_Le3ObjXDirAV_Raw;
		}
		else
		{
			RLCR_5.RLCR_5_Le3ObjXDirAV.phys = @Vehicle_Signals::i_RLCR_5_Le3ObjXDirAV;
		}
	}
	else
	{
		// To be completed in simulation
	}

	/* RLCR_5_Le3ObjXDirV */
	if(!@Vehicle_Signals::i_RLCR_5_Le3ObjXDirV_SIM)
	{
		if(@Vehicle_Signals::i_RLCR_5_Le3ObjXDirV_EN)
		{
			RLCR_5.RLCR_5_Le3ObjXDirV = @Vehicle_Signals::i_RLCR_5_Le3ObjXDirV_Raw;
		}
		else
		{
			RLCR_5.RLCR_5_Le3ObjXDirV.phys = @Vehicle_Signals::i_RLCR_5_Le3ObjXDirV;
		}
	}
	else
	{
		// To be completed in simulation
	}

	/* RLCR_5_Le3ObjXDirVStdDe */
	if(!@Vehicle_Signals::i_RLCR_5_Le3ObjXDirVStdDe_SIM)
	{
		if(@Vehicle_Signals::i_RLCR_5_Le3ObjXDirVStdDe_EN)
		{
			RLCR_5.RLCR_5_Le3ObjXDirVStdDe = @Vehicle_Signals::i_RLCR_5_Le3ObjXDirVStdDe_Raw;
		}
		else
		{
			RLCR_5.RLCR_5_Le3ObjXDirVStdDe.phys = @Vehicle_Signals::i_RLCR_5_Le3ObjXDirVStdDe;
		}
	}
	else
	{
		// To be completed in simulation
	}

	/* RLCR_5_Le3ObjYDirV */
	if(!@Vehicle_Signals::i_RLCR_5_Le3ObjYDirV_SIM)
	{
		if(@Vehicle_Signals::i_RLCR_5_Le3ObjYDirV_EN)
		{
			RLCR_5.RLCR_5_Le3ObjYDirV = @Vehicle_Signals::i_RLCR_5_Le3ObjYDirV_Raw;
		}
		else
		{
			RLCR_5.RLCR_5_Le3ObjYDirV.phys = @Vehicle_Signals::i_RLCR_5_Le3ObjYDirV;
		}
	}
	else
	{
		// To be completed in simulation
	}

	/* RLCR_5_Le3ObjYDirVStdDe */
	if(!@Vehicle_Signals::i_RLCR_5_Le3ObjYDirVStdDe_SIM)
	{
		if(@Vehicle_Signals::i_RLCR_5_Le3ObjYDirVStdDe_EN)
		{
			RLCR_5.RLCR_5_Le3ObjYDirVStdDe = @Vehicle_Signals::i_RLCR_5_Le3ObjYDirVStdDe_Raw;
		}
		else
		{
			RLCR_5.RLCR_5_Le3ObjYDirVStdDe.phys = @Vehicle_Signals::i_RLCR_5_Le3ObjYDirVStdDe;
		}
	}
	else
	{
		// To be completed in simulation
	}

	/* Rolling counter */
	PROJ_Sim_Rollingcounter(MSG_CONFIG_TX_RLCR_5, RLCR_5);

	/* CheckSum */
	PROJ_Sim_Checksum(MSG_CONFIG_TX_RLCR_5, RLCR_5);

	/* DLC Check */
	RLCR_5.DataLength = @Error_panel_vehicle::i_DLCError[MSG_CONFIG_TX_RLCR_5]?1:DBLookup(RLCR_5).dlc;

}

PROJ_CalcMsg_RLCR_6()
{
	/* RLCR_6_Le4HdTo */
	if(!@Vehicle_Signals::i_RLCR_6_Le4HdTo_SIM)
	{
		if(@Vehicle_Signals::i_RLCR_6_Le4HdTo_EN)
		{
			RLCR_6.RLCR_6_Le4HdTo = @Vehicle_Signals::i_RLCR_6_Le4HdTo_Raw;
		}
		else
		{
			RLCR_6.RLCR_6_Le4HdTo.phys = @Vehicle_Signals::i_RLCR_6_Le4HdTo;
		}
	}
	else
	{
		// To be completed in simulation
	}

	/* RLCR_6_Le4ObjBoxLen */
	if(!@Vehicle_Signals::i_RLCR_6_Le4ObjBoxLen_SIM)
	{
		if(@Vehicle_Signals::i_RLCR_6_Le4ObjBoxLen_EN)
		{
			RLCR_6.RLCR_6_Le4ObjBoxLen = @Vehicle_Signals::i_RLCR_6_Le4ObjBoxLen_Raw;
		}
		else
		{
			RLCR_6.RLCR_6_Le4ObjBoxLen.phys = @Vehicle_Signals::i_RLCR_6_Le4ObjBoxLen;
		}
	}
	else
	{
		// To be completed in simulation
	}

	/* RLCR_6_Le4ObjBoxWidth */
	if(!@Vehicle_Signals::i_RLCR_6_Le4ObjBoxWidth_SIM)
	{
		if(@Vehicle_Signals::i_RLCR_6_Le4ObjBoxWidth_EN)
		{
			RLCR_6.RLCR_6_Le4ObjBoxWidth = @Vehicle_Signals::i_RLCR_6_Le4ObjBoxWidth_Raw;
		}
		else
		{
			RLCR_6.RLCR_6_Le4ObjBoxWidth.phys = @Vehicle_Signals::i_RLCR_6_Le4ObjBoxWidth;
		}
	}
	else
	{
		// To be completed in simulation
	}

	/* RLCR_6_Le4ObjConf */
	if(!@Vehicle_Signals::i_RLCR_6_Le4ObjConf_SIM)
	{
		if(@Vehicle_Signals::i_RLCR_6_Le4ObjConf_EN)
		{
			RLCR_6.RLCR_6_Le4ObjConf = @Vehicle_Signals::i_RLCR_6_Le4ObjConf_Raw;
		}
		else
		{
			RLCR_6.RLCR_6_Le4ObjConf.phys = @Vehicle_Signals::i_RLCR_6_Le4ObjConf;
		}
	}
	else
	{
		// To be completed in simulation
	}

	/* RLCR_6_Le4ObjCoordX */
	if(!@Vehicle_Signals::i_RLCR_6_Le4ObjCoordX_SIM)
	{
		if(@Vehicle_Signals::i_RLCR_6_Le4ObjCoordX_EN)
		{
			RLCR_6.RLCR_6_Le4ObjCoordX = @Vehicle_Signals::i_RLCR_6_Le4ObjCoordX_Raw;
		}
		else
		{
			RLCR_6.RLCR_6_Le4ObjCoordX.phys = @Vehicle_Signals::i_RLCR_6_Le4ObjCoordX;
		}
	}
	else
	{
		// To be completed in simulation
	}

	/* RLCR_6_Le4ObjCoordXDstStdDe */
	if(!@Vehicle_Signals::i_RLCR_6_Le4ObjCoordXDstStdDe_SIM)
	{
		if(@Vehicle_Signals::i_RLCR_6_Le4ObjCoordXDstStdDe_EN)
		{
			RLCR_6.RLCR_6_Le4ObjCoordXDstStdDe = @Vehicle_Signals::i_RLCR_6_Le4ObjCoordXDstStdDe_Raw;
		}
		else
		{
			RLCR_6.RLCR_6_Le4ObjCoordXDstStdDe.phys = @Vehicle_Signals::i_RLCR_6_Le4ObjCoordXDstStdDe;
		}
	}
	else
	{
		// To be completed in simulation
	}

	/* RLCR_6_Le4ObjCoordY */
	if(!@Vehicle_Signals::i_RLCR_6_Le4ObjCoordY_SIM)
	{
		if(@Vehicle_Signals::i_RLCR_6_Le4ObjCoordY_EN)
		{
			RLCR_6.RLCR_6_Le4ObjCoordY = @Vehicle_Signals::i_RLCR_6_Le4ObjCoordY_Raw;
		}
		else
		{
			RLCR_6.RLCR_6_Le4ObjCoordY.phys = @Vehicle_Signals::i_RLCR_6_Le4ObjCoordY;
		}
	}
	else
	{
		// To be completed in simulation
	}

	/* RLCR_6_Le4ObjCoordYDstStdDe */
	if(!@Vehicle_Signals::i_RLCR_6_Le4ObjCoordYDstStdDe_SIM)
	{
		if(@Vehicle_Signals::i_RLCR_6_Le4ObjCoordYDstStdDe_EN)
		{
			RLCR_6.RLCR_6_Le4ObjCoordYDstStdDe = @Vehicle_Signals::i_RLCR_6_Le4ObjCoordYDstStdDe_Raw;
		}
		else
		{
			RLCR_6.RLCR_6_Le4ObjCoordYDstStdDe.phys = @Vehicle_Signals::i_RLCR_6_Le4ObjCoordYDstStdDe;
		}
	}
	else
	{
		// To be completed in simulation
	}

	/* RLCR_6_Le4ObjID */
	if(!@Vehicle_Signals::i_RLCR_6_Le4ObjID_SIM)
	{
		if(@Vehicle_Signals::i_RLCR_6_Le4ObjID_EN)
		{
			RLCR_6.RLCR_6_Le4ObjID = @Vehicle_Signals::i_RLCR_6_Le4ObjID_Raw;
		}
		else
		{
			RLCR_6.RLCR_6_Le4ObjID.phys = @Vehicle_Signals::i_RLCR_6_Le4ObjID;
		}
	}
	else
	{
		// To be completed in simulation
	}

	/* RLCR_6_Le4ObjMtnChartc */
	if(!@Vehicle_Signals::i_RLCR_6_Le4ObjMtnChartc_SIM)
	{
		if(@Vehicle_Signals::i_RLCR_6_Le4ObjMtnChartc_EN)
		{
			RLCR_6.RLCR_6_Le4ObjMtnChartc = @Vehicle_Signals::i_RLCR_6_Le4ObjMtnChartc_Raw;
		}
		else
		{
			RLCR_6.RLCR_6_Le4ObjMtnChartc.phys = @Vehicle_Signals::i_RLCR_6_Le4ObjMtnChartc;
		}
	}
	else
	{
		// To be completed in simulation
	}

	/* RLCR_6_Le4ObjNrOffocst */
	if(!@Vehicle_Signals::i_RLCR_6_Le4ObjNrOffocst_SIM)
	{
		if(@Vehicle_Signals::i_RLCR_6_Le4ObjNrOffocst_EN)
		{
			RLCR_6.RLCR_6_Le4ObjNrOffocst = @Vehicle_Signals::i_RLCR_6_Le4ObjNrOffocst_Raw;
		}
		else
		{
			RLCR_6.RLCR_6_Le4ObjNrOffocst.phys = @Vehicle_Signals::i_RLCR_6_Le4ObjNrOffocst;
		}
	}
	else
	{
		// To be completed in simulation
	}

	/* RLCR_6_Le4ObjTrackSt */
	if(!@Vehicle_Signals::i_RLCR_6_Le4ObjTrackSt_SIM)
	{
		if(@Vehicle_Signals::i_RLCR_6_Le4ObjTrackSt_EN)
		{
			RLCR_6.RLCR_6_Le4ObjTrackSt = @Vehicle_Signals::i_RLCR_6_Le4ObjTrackSt_Raw;
		}
		else
		{
			RLCR_6.RLCR_6_Le4ObjTrackSt.phys = @Vehicle_Signals::i_RLCR_6_Le4ObjTrackSt;
		}
	}
	else
	{
		// To be completed in simulation
	}

	/* RLCR_6_Le4ObjTyp */
	if(!@Vehicle_Signals::i_RLCR_6_Le4ObjTyp_SIM)
	{
		if(@Vehicle_Signals::i_RLCR_6_Le4ObjTyp_EN)
		{
			RLCR_6.RLCR_6_Le4ObjTyp = @Vehicle_Signals::i_RLCR_6_Le4ObjTyp_Raw;
		}
		else
		{
			RLCR_6.RLCR_6_Le4ObjTyp.phys = @Vehicle_Signals::i_RLCR_6_Le4ObjTyp;
		}
	}
	else
	{
		// To be completed in simulation
	}

	/* RLCR_6_Le4ObjXDirAV */
	if(!@Vehicle_Signals::i_RLCR_6_Le4ObjXDirAV_SIM)
	{
		if(@Vehicle_Signals::i_RLCR_6_Le4ObjXDirAV_EN)
		{
			RLCR_6.RLCR_6_Le4ObjXDirAV = @Vehicle_Signals::i_RLCR_6_Le4ObjXDirAV_Raw;
		}
		else
		{
			RLCR_6.RLCR_6_Le4ObjXDirAV.phys = @Vehicle_Signals::i_RLCR_6_Le4ObjXDirAV;
		}
	}
	else
	{
		// To be completed in simulation
	}

	/* RLCR_6_Le4ObjXDirV */
	if(!@Vehicle_Signals::i_RLCR_6_Le4ObjXDirV_SIM)
	{
		if(@Vehicle_Signals::i_RLCR_6_Le4ObjXDirV_EN)
		{
			RLCR_6.RLCR_6_Le4ObjXDirV = @Vehicle_Signals::i_RLCR_6_Le4ObjXDirV_Raw;
		}
		else
		{
			RLCR_6.RLCR_6_Le4ObjXDirV.phys = @Vehicle_Signals::i_RLCR_6_Le4ObjXDirV;
		}
	}
	else
	{
		// To be completed in simulation
	}

	/* RLCR_6_Le4ObjXDirVStdDe */
	if(!@Vehicle_Signals::i_RLCR_6_Le4ObjXDirVStdDe_SIM)
	{
		if(@Vehicle_Signals::i_RLCR_6_Le4ObjXDirVStdDe_EN)
		{
			RLCR_6.RLCR_6_Le4ObjXDirVStdDe = @Vehicle_Signals::i_RLCR_6_Le4ObjXDirVStdDe_Raw;
		}
		else
		{
			RLCR_6.RLCR_6_Le4ObjXDirVStdDe.phys = @Vehicle_Signals::i_RLCR_6_Le4ObjXDirVStdDe;
		}
	}
	else
	{
		// To be completed in simulation
	}

	/* RLCR_6_Le4ObjYDirV */
	if(!@Vehicle_Signals::i_RLCR_6_Le4ObjYDirV_SIM)
	{
		if(@Vehicle_Signals::i_RLCR_6_Le4ObjYDirV_EN)
		{
			RLCR_6.RLCR_6_Le4ObjYDirV = @Vehicle_Signals::i_RLCR_6_Le4ObjYDirV_Raw;
		}
		else
		{
			RLCR_6.RLCR_6_Le4ObjYDirV.phys = @Vehicle_Signals::i_RLCR_6_Le4ObjYDirV;
		}
	}
	else
	{
		// To be completed in simulation
	}

	/* RLCR_6_Le4ObjYDirVStdDe */
	if(!@Vehicle_Signals::i_RLCR_6_Le4ObjYDirVStdDe_SIM)
	{
		if(@Vehicle_Signals::i_RLCR_6_Le4ObjYDirVStdDe_EN)
		{
			RLCR_6.RLCR_6_Le4ObjYDirVStdDe = @Vehicle_Signals::i_RLCR_6_Le4ObjYDirVStdDe_Raw;
		}
		else
		{
			RLCR_6.RLCR_6_Le4ObjYDirVStdDe.phys = @Vehicle_Signals::i_RLCR_6_Le4ObjYDirVStdDe;
		}
	}
	else
	{
		// To be completed in simulation
	}

	/* Rolling counter */
	PROJ_Sim_Rollingcounter(MSG_CONFIG_TX_RLCR_6, RLCR_6);

	/* CheckSum */
	PROJ_Sim_Checksum(MSG_CONFIG_TX_RLCR_6, RLCR_6);

	/* DLC Check */
	RLCR_6.DataLength = @Error_panel_vehicle::i_DLCError[MSG_CONFIG_TX_RLCR_6]?1:DBLookup(RLCR_6).dlc;

}

PROJ_CalcMsg_RLCR_7()
{
	/* RLCR_7_Le5HdTo */
	if(!@Vehicle_Signals::i_RLCR_7_Le5HdTo_SIM)
	{
		if(@Vehicle_Signals::i_RLCR_7_Le5HdTo_EN)
		{
			RLCR_7.RLCR_7_Le5HdTo = @Vehicle_Signals::i_RLCR_7_Le5HdTo_Raw;
		}
		else
		{
			RLCR_7.RLCR_7_Le5HdTo.phys = @Vehicle_Signals::i_RLCR_7_Le5HdTo;
		}
	}
	else
	{
		// To be completed in simulation
	}

	/* RLCR_7_Le5ObjBoxLen */
	if(!@Vehicle_Signals::i_RLCR_7_Le5ObjBoxLen_SIM)
	{
		if(@Vehicle_Signals::i_RLCR_7_Le5ObjBoxLen_EN)
		{
			RLCR_7.RLCR_7_Le5ObjBoxLen = @Vehicle_Signals::i_RLCR_7_Le5ObjBoxLen_Raw;
		}
		else
		{
			RLCR_7.RLCR_7_Le5ObjBoxLen.phys = @Vehicle_Signals::i_RLCR_7_Le5ObjBoxLen;
		}
	}
	else
	{
		// To be completed in simulation
	}

	/* RLCR_7_Le5ObjBoxWidth */
	if(!@Vehicle_Signals::i_RLCR_7_Le5ObjBoxWidth_SIM)
	{
		if(@Vehicle_Signals::i_RLCR_7_Le5ObjBoxWidth_EN)
		{
			RLCR_7.RLCR_7_Le5ObjBoxWidth = @Vehicle_Signals::i_RLCR_7_Le5ObjBoxWidth_Raw;
		}
		else
		{
			RLCR_7.RLCR_7_Le5ObjBoxWidth.phys = @Vehicle_Signals::i_RLCR_7_Le5ObjBoxWidth;
		}
	}
	else
	{
		// To be completed in simulation
	}

	/* RLCR_7_Le5ObjConf */
	if(!@Vehicle_Signals::i_RLCR_7_Le5ObjConf_SIM)
	{
		if(@Vehicle_Signals::i_RLCR_7_Le5ObjConf_EN)
		{
			RLCR_7.RLCR_7_Le5ObjConf = @Vehicle_Signals::i_RLCR_7_Le5ObjConf_Raw;
		}
		else
		{
			RLCR_7.RLCR_7_Le5ObjConf.phys = @Vehicle_Signals::i_RLCR_7_Le5ObjConf;
		}
	}
	else
	{
		// To be completed in simulation
	}

	/* RLCR_7_Le5ObjCoordX */
	if(!@Vehicle_Signals::i_RLCR_7_Le5ObjCoordX_SIM)
	{
		if(@Vehicle_Signals::i_RLCR_7_Le5ObjCoordX_EN)
		{
			RLCR_7.RLCR_7_Le5ObjCoordX = @Vehicle_Signals::i_RLCR_7_Le5ObjCoordX_Raw;
		}
		else
		{
			RLCR_7.RLCR_7_Le5ObjCoordX.phys = @Vehicle_Signals::i_RLCR_7_Le5ObjCoordX;
		}
	}
	else
	{
		// To be completed in simulation
	}

	/* RLCR_7_Le5ObjCoordXDstStdDe */
	if(!@Vehicle_Signals::i_RLCR_7_Le5ObjCoordXDstStdDe_SIM)
	{
		if(@Vehicle_Signals::i_RLCR_7_Le5ObjCoordXDstStdDe_EN)
		{
			RLCR_7.RLCR_7_Le5ObjCoordXDstStdDe = @Vehicle_Signals::i_RLCR_7_Le5ObjCoordXDstStdDe_Raw;
		}
		else
		{
			RLCR_7.RLCR_7_Le5ObjCoordXDstStdDe.phys = @Vehicle_Signals::i_RLCR_7_Le5ObjCoordXDstStdDe;
		}
	}
	else
	{
		// To be completed in simulation
	}

	/* RLCR_7_Le5ObjCoordY */
	if(!@Vehicle_Signals::i_RLCR_7_Le5ObjCoordY_SIM)
	{
		if(@Vehicle_Signals::i_RLCR_7_Le5ObjCoordY_EN)
		{
			RLCR_7.RLCR_7_Le5ObjCoordY = @Vehicle_Signals::i_RLCR_7_Le5ObjCoordY_Raw;
		}
		else
		{
			RLCR_7.RLCR_7_Le5ObjCoordY.phys = @Vehicle_Signals::i_RLCR_7_Le5ObjCoordY;
		}
	}
	else
	{
		// To be completed in simulation
	}

	/* RLCR_7_Le5ObjCoordYDstStdDe */
	if(!@Vehicle_Signals::i_RLCR_7_Le5ObjCoordYDstStdDe_SIM)
	{
		if(@Vehicle_Signals::i_RLCR_7_Le5ObjCoordYDstStdDe_EN)
		{
			RLCR_7.RLCR_7_Le5ObjCoordYDstStdDe = @Vehicle_Signals::i_RLCR_7_Le5ObjCoordYDstStdDe_Raw;
		}
		else
		{
			RLCR_7.RLCR_7_Le5ObjCoordYDstStdDe.phys = @Vehicle_Signals::i_RLCR_7_Le5ObjCoordYDstStdDe;
		}
	}
	else
	{
		// To be completed in simulation
	}

	/* RLCR_7_Le5ObjID */
	if(!@Vehicle_Signals::i_RLCR_7_Le5ObjID_SIM)
	{
		if(@Vehicle_Signals::i_RLCR_7_Le5ObjID_EN)
		{
			RLCR_7.RLCR_7_Le5ObjID = @Vehicle_Signals::i_RLCR_7_Le5ObjID_Raw;
		}
		else
		{
			RLCR_7.RLCR_7_Le5ObjID.phys = @Vehicle_Signals::i_RLCR_7_Le5ObjID;
		}
	}
	else
	{
		// To be completed in simulation
	}

	/* RLCR_7_Le5ObjMtnChartc */
	if(!@Vehicle_Signals::i_RLCR_7_Le5ObjMtnChartc_SIM)
	{
		if(@Vehicle_Signals::i_RLCR_7_Le5ObjMtnChartc_EN)
		{
			RLCR_7.RLCR_7_Le5ObjMtnChartc = @Vehicle_Signals::i_RLCR_7_Le5ObjMtnChartc_Raw;
		}
		else
		{
			RLCR_7.RLCR_7_Le5ObjMtnChartc.phys = @Vehicle_Signals::i_RLCR_7_Le5ObjMtnChartc;
		}
	}
	else
	{
		// To be completed in simulation
	}

	/* RLCR_7_Le5ObjNrOffocst */
	if(!@Vehicle_Signals::i_RLCR_7_Le5ObjNrOffocst_SIM)
	{
		if(@Vehicle_Signals::i_RLCR_7_Le5ObjNrOffocst_EN)
		{
			RLCR_7.RLCR_7_Le5ObjNrOffocst = @Vehicle_Signals::i_RLCR_7_Le5ObjNrOffocst_Raw;
		}
		else
		{
			RLCR_7.RLCR_7_Le5ObjNrOffocst.phys = @Vehicle_Signals::i_RLCR_7_Le5ObjNrOffocst;
		}
	}
	else
	{
		// To be completed in simulation
	}

	/* RLCR_7_Le5ObjTrackSt */
	if(!@Vehicle_Signals::i_RLCR_7_Le5ObjTrackSt_SIM)
	{
		if(@Vehicle_Signals::i_RLCR_7_Le5ObjTrackSt_EN)
		{
			RLCR_7.RLCR_7_Le5ObjTrackSt = @Vehicle_Signals::i_RLCR_7_Le5ObjTrackSt_Raw;
		}
		else
		{
			RLCR_7.RLCR_7_Le5ObjTrackSt.phys = @Vehicle_Signals::i_RLCR_7_Le5ObjTrackSt;
		}
	}
	else
	{
		// To be completed in simulation
	}

	/* RLCR_7_Le5ObjTyp */
	if(!@Vehicle_Signals::i_RLCR_7_Le5ObjTyp_SIM)
	{
		if(@Vehicle_Signals::i_RLCR_7_Le5ObjTyp_EN)
		{
			RLCR_7.RLCR_7_Le5ObjTyp = @Vehicle_Signals::i_RLCR_7_Le5ObjTyp_Raw;
		}
		else
		{
			RLCR_7.RLCR_7_Le5ObjTyp.phys = @Vehicle_Signals::i_RLCR_7_Le5ObjTyp;
		}
	}
	else
	{
		// To be completed in simulation
	}

	/* RLCR_7_Le5ObjXDirAV */
	if(!@Vehicle_Signals::i_RLCR_7_Le5ObjXDirAV_SIM)
	{
		if(@Vehicle_Signals::i_RLCR_7_Le5ObjXDirAV_EN)
		{
			RLCR_7.RLCR_7_Le5ObjXDirAV = @Vehicle_Signals::i_RLCR_7_Le5ObjXDirAV_Raw;
		}
		else
		{
			RLCR_7.RLCR_7_Le5ObjXDirAV.phys = @Vehicle_Signals::i_RLCR_7_Le5ObjXDirAV;
		}
	}
	else
	{
		// To be completed in simulation
	}

	/* RLCR_7_Le5ObjXDirV */
	if(!@Vehicle_Signals::i_RLCR_7_Le5ObjXDirV_SIM)
	{
		if(@Vehicle_Signals::i_RLCR_7_Le5ObjXDirV_EN)
		{
			RLCR_7.RLCR_7_Le5ObjXDirV = @Vehicle_Signals::i_RLCR_7_Le5ObjXDirV_Raw;
		}
		else
		{
			RLCR_7.RLCR_7_Le5ObjXDirV.phys = @Vehicle_Signals::i_RLCR_7_Le5ObjXDirV;
		}
	}
	else
	{
		// To be completed in simulation
	}

	/* RLCR_7_Le5ObjXDirVStdDe */
	if(!@Vehicle_Signals::i_RLCR_7_Le5ObjXDirVStdDe_SIM)
	{
		if(@Vehicle_Signals::i_RLCR_7_Le5ObjXDirVStdDe_EN)
		{
			RLCR_7.RLCR_7_Le5ObjXDirVStdDe = @Vehicle_Signals::i_RLCR_7_Le5ObjXDirVStdDe_Raw;
		}
		else
		{
			RLCR_7.RLCR_7_Le5ObjXDirVStdDe.phys = @Vehicle_Signals::i_RLCR_7_Le5ObjXDirVStdDe;
		}
	}
	else
	{
		// To be completed in simulation
	}

	/* RLCR_7_Le5ObjYDirV */
	if(!@Vehicle_Signals::i_RLCR_7_Le5ObjYDirV_SIM)
	{
		if(@Vehicle_Signals::i_RLCR_7_Le5ObjYDirV_EN)
		{
			RLCR_7.RLCR_7_Le5ObjYDirV = @Vehicle_Signals::i_RLCR_7_Le5ObjYDirV_Raw;
		}
		else
		{
			RLCR_7.RLCR_7_Le5ObjYDirV.phys = @Vehicle_Signals::i_RLCR_7_Le5ObjYDirV;
		}
	}
	else
	{
		// To be completed in simulation
	}

	/* RLCR_7_Le5ObjYDirVStdDe */
	if(!@Vehicle_Signals::i_RLCR_7_Le5ObjYDirVStdDe_SIM)
	{
		if(@Vehicle_Signals::i_RLCR_7_Le5ObjYDirVStdDe_EN)
		{
			RLCR_7.RLCR_7_Le5ObjYDirVStdDe = @Vehicle_Signals::i_RLCR_7_Le5ObjYDirVStdDe_Raw;
		}
		else
		{
			RLCR_7.RLCR_7_Le5ObjYDirVStdDe.phys = @Vehicle_Signals::i_RLCR_7_Le5ObjYDirVStdDe;
		}
	}
	else
	{
		// To be completed in simulation
	}

	/* Rolling counter */
	PROJ_Sim_Rollingcounter(MSG_CONFIG_TX_RLCR_7, RLCR_7);

	/* CheckSum */
	PROJ_Sim_Checksum(MSG_CONFIG_TX_RLCR_7, RLCR_7);

	/* DLC Check */
	RLCR_7.DataLength = @Error_panel_vehicle::i_DLCError[MSG_CONFIG_TX_RLCR_7]?1:DBLookup(RLCR_7).dlc;

}

PROJ_CalcMsg_RLCR_8()
{
	/* RLCR_8_TiStampLaten */
	if(!@Vehicle_Signals::i_RLCR_8_TiStampLaten_SIM)
	{
		if(@Vehicle_Signals::i_RLCR_8_TiStampLaten_EN)
		{
			RLCR_8.RLCR_8_TiStampLaten = @Vehicle_Signals::i_RLCR_8_TiStampLaten_Raw;
		}
		else
		{
			RLCR_8.RLCR_8_TiStampLaten.phys = @Vehicle_Signals::i_RLCR_8_TiStampLaten;
		}
	}
	else
	{
		// To be completed in simulation
	}

	/* Rolling counter */
	PROJ_Sim_Rollingcounter(MSG_CONFIG_TX_RLCR_8, RLCR_8);

	/* CheckSum */
	PROJ_Sim_Checksum(MSG_CONFIG_TX_RLCR_8, RLCR_8);

	/* DLC Check */
	RLCR_8.DataLength = @Error_panel_vehicle::i_DLCError[MSG_CONFIG_TX_RLCR_8]?1:DBLookup(RLCR_8).dlc;

}

PROJ_CalcMsg_RLCR_9()
{
	/* RLCR_9_LgtDst */
	if(!@Vehicle_Signals::i_RLCR_9_LgtDst_SIM)
	{
		if(@Vehicle_Signals::i_RLCR_9_LgtDst_EN)
		{
			RLCR_9.RLCR_9_LgtDst = @Vehicle_Signals::i_RLCR_9_LgtDst_Raw;
		}
		else
		{
			RLCR_9.RLCR_9_LgtDst.phys = @Vehicle_Signals::i_RLCR_9_LgtDst;
		}
	}
	else
	{
		// To be completed in simulation
	}

	/* RLCR_9_LgtRelV */
	if(!@Vehicle_Signals::i_RLCR_9_LgtRelV_SIM)
	{
		if(@Vehicle_Signals::i_RLCR_9_LgtRelV_EN)
		{
			RLCR_9.RLCR_9_LgtRelV = @Vehicle_Signals::i_RLCR_9_LgtRelV_Raw;
		}
		else
		{
			RLCR_9.RLCR_9_LgtRelV.phys = @Vehicle_Signals::i_RLCR_9_LgtRelV;
		}
	}
	else
	{
		// To be completed in simulation
	}

	/* RLCR_9_ObjVldFlg */
	if(!@Vehicle_Signals::i_RLCR_9_ObjVldFlg_SIM)
	{
		if(@Vehicle_Signals::i_RLCR_9_ObjVldFlg_EN)
		{
			RLCR_9.RLCR_9_ObjVldFlg = @Vehicle_Signals::i_RLCR_9_ObjVldFlg_Raw;
		}
		else
		{
			RLCR_9.RLCR_9_ObjVldFlg.phys = @Vehicle_Signals::i_RLCR_9_ObjVldFlg;
		}
	}
	else
	{
		// To be completed in simulation
	}

	/* Rolling counter */
	PROJ_Sim_Rollingcounter(MSG_CONFIG_TX_RLCR_9, RLCR_9);

	/* CheckSum */
	PROJ_Sim_Checksum(MSG_CONFIG_TX_RLCR_9, RLCR_9);

	/* DLC Check */
	RLCR_9.DataLength = @Error_panel_vehicle::i_DLCError[MSG_CONFIG_TX_RLCR_9]?1:DBLookup(RLCR_9).dlc;

}

PROJ_CalcMsg_RRCR_1()
{
	/* RRCR_1_BlkSts */
	if(!@Vehicle_Signals::i_RRCR_1_BlkSts_SIM)
	{
		if(@Vehicle_Signals::i_RRCR_1_BlkSts_EN)
		{
			RRCR_1.RRCR_1_BlkSts = @Vehicle_Signals::i_RRCR_1_BlkSts_Raw;
		}
		else
		{
			RRCR_1.RRCR_1_BlkSts.phys = @Vehicle_Signals::i_RRCR_1_BlkSts;
		}
	}
	else
	{
		// To be completed in simulation
	}

	/* RRCR_1_SysSt */
	if(!@Vehicle_Signals::i_RRCR_1_SysSt_SIM)
	{
		if(@Vehicle_Signals::i_RRCR_1_SysSt_EN)
		{
			RRCR_1.RRCR_1_SysSt = @Vehicle_Signals::i_RRCR_1_SysSt_Raw;
		}
		else
		{
			RRCR_1.RRCR_1_SysSt.phys = @Vehicle_Signals::i_RRCR_1_SysSt;
		}
	}
	else
	{
		// To be completed in simulation
	}

	/* Rolling counter */
	PROJ_Sim_Rollingcounter(MSG_CONFIG_TX_RRCR_1, RRCR_1);

	/* CheckSum */
	PROJ_Sim_Checksum(MSG_CONFIG_TX_RRCR_1, RRCR_1);

	/* DLC Check */
	RRCR_1.DataLength = @Error_panel_vehicle::i_DLCError[MSG_CONFIG_TX_RRCR_1]?1:DBLookup(RRCR_1).dlc;

}

PROJ_CalcMsg_RRCR_2()
{
	/* RRCR_2_Ri1HdTo */
	if(!@Vehicle_Signals::i_RRCR_2_Ri1HdTo_SIM)
	{
		if(@Vehicle_Signals::i_RRCR_2_Ri1HdTo_EN)
		{
			RRCR_2.RRCR_2_Ri1HdTo = @Vehicle_Signals::i_RRCR_2_Ri1HdTo_Raw;
		}
		else
		{
			RRCR_2.RRCR_2_Ri1HdTo.phys = @Vehicle_Signals::i_RRCR_2_Ri1HdTo;
		}
	}
	else
	{
		// To be completed in simulation
	}

	/* RRCR_2_Ri1ObjBoxLen */
	if(!@Vehicle_Signals::i_RRCR_2_Ri1ObjBoxLen_SIM)
	{
		if(@Vehicle_Signals::i_RRCR_2_Ri1ObjBoxLen_EN)
		{
			RRCR_2.RRCR_2_Ri1ObjBoxLen = @Vehicle_Signals::i_RRCR_2_Ri1ObjBoxLen_Raw;
		}
		else
		{
			RRCR_2.RRCR_2_Ri1ObjBoxLen.phys = @Vehicle_Signals::i_RRCR_2_Ri1ObjBoxLen;
		}
	}
	else
	{
		// To be completed in simulation
	}

	/* RRCR_2_Ri1ObjBoxWidth */
	if(!@Vehicle_Signals::i_RRCR_2_Ri1ObjBoxWidth_SIM)
	{
		if(@Vehicle_Signals::i_RRCR_2_Ri1ObjBoxWidth_EN)
		{
			RRCR_2.RRCR_2_Ri1ObjBoxWidth = @Vehicle_Signals::i_RRCR_2_Ri1ObjBoxWidth_Raw;
		}
		else
		{
			RRCR_2.RRCR_2_Ri1ObjBoxWidth.phys = @Vehicle_Signals::i_RRCR_2_Ri1ObjBoxWidth;
		}
	}
	else
	{
		// To be completed in simulation
	}

	/* RRCR_2_Ri1ObjConf */
	if(!@Vehicle_Signals::i_RRCR_2_Ri1ObjConf_SIM)
	{
		if(@Vehicle_Signals::i_RRCR_2_Ri1ObjConf_EN)
		{
			RRCR_2.RRCR_2_Ri1ObjConf = @Vehicle_Signals::i_RRCR_2_Ri1ObjConf_Raw;
		}
		else
		{
			RRCR_2.RRCR_2_Ri1ObjConf.phys = @Vehicle_Signals::i_RRCR_2_Ri1ObjConf;
		}
	}
	else
	{
		// To be completed in simulation
	}

	/* RRCR_2_Ri1ObjCoordX */
	if(!@Vehicle_Signals::i_RRCR_2_Ri1ObjCoordX_SIM)
	{
		if(@Vehicle_Signals::i_RRCR_2_Ri1ObjCoordX_EN)
		{
			RRCR_2.RRCR_2_Ri1ObjCoordX = @Vehicle_Signals::i_RRCR_2_Ri1ObjCoordX_Raw;
		}
		else
		{
			RRCR_2.RRCR_2_Ri1ObjCoordX.phys = @Vehicle_Signals::i_RRCR_2_Ri1ObjCoordX;
		}
	}
	else
	{
		// To be completed in simulation
	}

	/* RRCR_2_Ri1ObjCoordXDstStdDe */
	if(!@Vehicle_Signals::i_RRCR_2_Ri1ObjCoordXDstStdDe_SIM)
	{
		if(@Vehicle_Signals::i_RRCR_2_Ri1ObjCoordXDstStdDe_EN)
		{
			RRCR_2.RRCR_2_Ri1ObjCoordXDstStdDe = @Vehicle_Signals::i_RRCR_2_Ri1ObjCoordXDstStdDe_Raw;
		}
		else
		{
			RRCR_2.RRCR_2_Ri1ObjCoordXDstStdDe.phys = @Vehicle_Signals::i_RRCR_2_Ri1ObjCoordXDstStdDe;
		}
	}
	else
	{
		// To be completed in simulation
	}

	/* RRCR_2_Ri1ObjCoordY */
	if(!@Vehicle_Signals::i_RRCR_2_Ri1ObjCoordY_SIM)
	{
		if(@Vehicle_Signals::i_RRCR_2_Ri1ObjCoordY_EN)
		{
			RRCR_2.RRCR_2_Ri1ObjCoordY = @Vehicle_Signals::i_RRCR_2_Ri1ObjCoordY_Raw;
		}
		else
		{
			RRCR_2.RRCR_2_Ri1ObjCoordY.phys = @Vehicle_Signals::i_RRCR_2_Ri1ObjCoordY;
		}
	}
	else
	{
		// To be completed in simulation
	}

	/* RRCR_2_Ri1ObjCoordYDstStdDe */
	if(!@Vehicle_Signals::i_RRCR_2_Ri1ObjCoordYDstStdDe_SIM)
	{
		if(@Vehicle_Signals::i_RRCR_2_Ri1ObjCoordYDstStdDe_EN)
		{
			RRCR_2.RRCR_2_Ri1ObjCoordYDstStdDe = @Vehicle_Signals::i_RRCR_2_Ri1ObjCoordYDstStdDe_Raw;
		}
		else
		{
			RRCR_2.RRCR_2_Ri1ObjCoordYDstStdDe.phys = @Vehicle_Signals::i_RRCR_2_Ri1ObjCoordYDstStdDe;
		}
	}
	else
	{
		// To be completed in simulation
	}

	/* RRCR_2_Ri1ObjID */
	if(!@Vehicle_Signals::i_RRCR_2_Ri1ObjID_SIM)
	{
		if(@Vehicle_Signals::i_RRCR_2_Ri1ObjID_EN)
		{
			RRCR_2.RRCR_2_Ri1ObjID = @Vehicle_Signals::i_RRCR_2_Ri1ObjID_Raw;
		}
		else
		{
			RRCR_2.RRCR_2_Ri1ObjID.phys = @Vehicle_Signals::i_RRCR_2_Ri1ObjID;
		}
	}
	else
	{
		// To be completed in simulation
	}

	/* RRCR_2_Ri1ObjMtnChartc */
	if(!@Vehicle_Signals::i_RRCR_2_Ri1ObjMtnChartc_SIM)
	{
		if(@Vehicle_Signals::i_RRCR_2_Ri1ObjMtnChartc_EN)
		{
			RRCR_2.RRCR_2_Ri1ObjMtnChartc = @Vehicle_Signals::i_RRCR_2_Ri1ObjMtnChartc_Raw;
		}
		else
		{
			RRCR_2.RRCR_2_Ri1ObjMtnChartc.phys = @Vehicle_Signals::i_RRCR_2_Ri1ObjMtnChartc;
		}
	}
	else
	{
		// To be completed in simulation
	}

	/* RRCR_2_Ri1ObjNrOffocst */
	if(!@Vehicle_Signals::i_RRCR_2_Ri1ObjNrOffocst_SIM)
	{
		if(@Vehicle_Signals::i_RRCR_2_Ri1ObjNrOffocst_EN)
		{
			RRCR_2.RRCR_2_Ri1ObjNrOffocst = @Vehicle_Signals::i_RRCR_2_Ri1ObjNrOffocst_Raw;
		}
		else
		{
			RRCR_2.RRCR_2_Ri1ObjNrOffocst.phys = @Vehicle_Signals::i_RRCR_2_Ri1ObjNrOffocst;
		}
	}
	else
	{
		// To be completed in simulation
	}

	/* RRCR_2_Ri1ObjTrackSt */
	if(!@Vehicle_Signals::i_RRCR_2_Ri1ObjTrackSt_SIM)
	{
		if(@Vehicle_Signals::i_RRCR_2_Ri1ObjTrackSt_EN)
		{
			RRCR_2.RRCR_2_Ri1ObjTrackSt = @Vehicle_Signals::i_RRCR_2_Ri1ObjTrackSt_Raw;
		}
		else
		{
			RRCR_2.RRCR_2_Ri1ObjTrackSt.phys = @Vehicle_Signals::i_RRCR_2_Ri1ObjTrackSt;
		}
	}
	else
	{
		// To be completed in simulation
	}

	/* RRCR_2_Ri1ObjTyp */
	if(!@Vehicle_Signals::i_RRCR_2_Ri1ObjTyp_SIM)
	{
		if(@Vehicle_Signals::i_RRCR_2_Ri1ObjTyp_EN)
		{
			RRCR_2.RRCR_2_Ri1ObjTyp = @Vehicle_Signals::i_RRCR_2_Ri1ObjTyp_Raw;
		}
		else
		{
			RRCR_2.RRCR_2_Ri1ObjTyp.phys = @Vehicle_Signals::i_RRCR_2_Ri1ObjTyp;
		}
	}
	else
	{
		// To be completed in simulation
	}

	/* RRCR_2_Ri1ObjXDirAV */
	if(!@Vehicle_Signals::i_RRCR_2_Ri1ObjXDirAV_SIM)
	{
		if(@Vehicle_Signals::i_RRCR_2_Ri1ObjXDirAV_EN)
		{
			RRCR_2.RRCR_2_Ri1ObjXDirAV = @Vehicle_Signals::i_RRCR_2_Ri1ObjXDirAV_Raw;
		}
		else
		{
			RRCR_2.RRCR_2_Ri1ObjXDirAV.phys = @Vehicle_Signals::i_RRCR_2_Ri1ObjXDirAV;
		}
	}
	else
	{
		// To be completed in simulation
	}

	/* RRCR_2_Ri1ObjXDirV */
	if(!@Vehicle_Signals::i_RRCR_2_Ri1ObjXDirV_SIM)
	{
		if(@Vehicle_Signals::i_RRCR_2_Ri1ObjXDirV_EN)
		{
			RRCR_2.RRCR_2_Ri1ObjXDirV = @Vehicle_Signals::i_RRCR_2_Ri1ObjXDirV_Raw;
		}
		else
		{
			RRCR_2.RRCR_2_Ri1ObjXDirV.phys = @Vehicle_Signals::i_RRCR_2_Ri1ObjXDirV;
		}
	}
	else
	{
		// To be completed in simulation
	}

	/* RRCR_2_Ri1ObjXDirVStdDe */
	if(!@Vehicle_Signals::i_RRCR_2_Ri1ObjXDirVStdDe_SIM)
	{
		if(@Vehicle_Signals::i_RRCR_2_Ri1ObjXDirVStdDe_EN)
		{
			RRCR_2.RRCR_2_Ri1ObjXDirVStdDe = @Vehicle_Signals::i_RRCR_2_Ri1ObjXDirVStdDe_Raw;
		}
		else
		{
			RRCR_2.RRCR_2_Ri1ObjXDirVStdDe.phys = @Vehicle_Signals::i_RRCR_2_Ri1ObjXDirVStdDe;
		}
	}
	else
	{
		// To be completed in simulation
	}

	/* RRCR_2_Ri1ObjYDirV */
	if(!@Vehicle_Signals::i_RRCR_2_Ri1ObjYDirV_SIM)
	{
		if(@Vehicle_Signals::i_RRCR_2_Ri1ObjYDirV_EN)
		{
			RRCR_2.RRCR_2_Ri1ObjYDirV = @Vehicle_Signals::i_RRCR_2_Ri1ObjYDirV_Raw;
		}
		else
		{
			RRCR_2.RRCR_2_Ri1ObjYDirV.phys = @Vehicle_Signals::i_RRCR_2_Ri1ObjYDirV;
		}
	}
	else
	{
		// To be completed in simulation
	}

	/* RRCR_2_Ri1ObjYDirVStdDe */
	if(!@Vehicle_Signals::i_RRCR_2_Ri1ObjYDirVStdDe_SIM)
	{
		if(@Vehicle_Signals::i_RRCR_2_Ri1ObjYDirVStdDe_EN)
		{
			RRCR_2.RRCR_2_Ri1ObjYDirVStdDe = @Vehicle_Signals::i_RRCR_2_Ri1ObjYDirVStdDe_Raw;
		}
		else
		{
			RRCR_2.RRCR_2_Ri1ObjYDirVStdDe.phys = @Vehicle_Signals::i_RRCR_2_Ri1ObjYDirVStdDe;
		}
	}
	else
	{
		// To be completed in simulation
	}

	/* Rolling counter */
	PROJ_Sim_Rollingcounter(MSG_CONFIG_TX_RRCR_2, RRCR_2);

	/* CheckSum */
	PROJ_Sim_Checksum(MSG_CONFIG_TX_RRCR_2, RRCR_2);

	/* DLC Check */
	RRCR_2.DataLength = @Error_panel_vehicle::i_DLCError[MSG_CONFIG_TX_RRCR_2]?1:DBLookup(RRCR_2).dlc;

}

PROJ_CalcMsg_RRCR_3()
{
	/* RRCR_3_Ri2HdTo */
	if(!@Vehicle_Signals::i_RRCR_3_Ri2HdTo_SIM)
	{
		if(@Vehicle_Signals::i_RRCR_3_Ri2HdTo_EN)
		{
			RRCR_3.RRCR_3_Ri2HdTo = @Vehicle_Signals::i_RRCR_3_Ri2HdTo_Raw;
		}
		else
		{
			RRCR_3.RRCR_3_Ri2HdTo.phys = @Vehicle_Signals::i_RRCR_3_Ri2HdTo;
		}
	}
	else
	{
		// To be completed in simulation
	}

	/* RRCR_3_Ri2ObjBoxLen */
	if(!@Vehicle_Signals::i_RRCR_3_Ri2ObjBoxLen_SIM)
	{
		if(@Vehicle_Signals::i_RRCR_3_Ri2ObjBoxLen_EN)
		{
			RRCR_3.RRCR_3_Ri2ObjBoxLen = @Vehicle_Signals::i_RRCR_3_Ri2ObjBoxLen_Raw;
		}
		else
		{
			RRCR_3.RRCR_3_Ri2ObjBoxLen.phys = @Vehicle_Signals::i_RRCR_3_Ri2ObjBoxLen;
		}
	}
	else
	{
		// To be completed in simulation
	}

	/* RRCR_3_Ri2ObjBoxWidth */
	if(!@Vehicle_Signals::i_RRCR_3_Ri2ObjBoxWidth_SIM)
	{
		if(@Vehicle_Signals::i_RRCR_3_Ri2ObjBoxWidth_EN)
		{
			RRCR_3.RRCR_3_Ri2ObjBoxWidth = @Vehicle_Signals::i_RRCR_3_Ri2ObjBoxWidth_Raw;
		}
		else
		{
			RRCR_3.RRCR_3_Ri2ObjBoxWidth.phys = @Vehicle_Signals::i_RRCR_3_Ri2ObjBoxWidth;
		}
	}
	else
	{
		// To be completed in simulation
	}

	/* RRCR_3_Ri2ObjConf */
	if(!@Vehicle_Signals::i_RRCR_3_Ri2ObjConf_SIM)
	{
		if(@Vehicle_Signals::i_RRCR_3_Ri2ObjConf_EN)
		{
			RRCR_3.RRCR_3_Ri2ObjConf = @Vehicle_Signals::i_RRCR_3_Ri2ObjConf_Raw;
		}
		else
		{
			RRCR_3.RRCR_3_Ri2ObjConf.phys = @Vehicle_Signals::i_RRCR_3_Ri2ObjConf;
		}
	}
	else
	{
		// To be completed in simulation
	}

	/* RRCR_3_Ri2ObjCoordX */
	if(!@Vehicle_Signals::i_RRCR_3_Ri2ObjCoordX_SIM)
	{
		if(@Vehicle_Signals::i_RRCR_3_Ri2ObjCoordX_EN)
		{
			RRCR_3.RRCR_3_Ri2ObjCoordX = @Vehicle_Signals::i_RRCR_3_Ri2ObjCoordX_Raw;
		}
		else
		{
			RRCR_3.RRCR_3_Ri2ObjCoordX.phys = @Vehicle_Signals::i_RRCR_3_Ri2ObjCoordX;
		}
	}
	else
	{
		// To be completed in simulation
	}

	/* RRCR_3_Ri2ObjCoordXDstStdDe */
	if(!@Vehicle_Signals::i_RRCR_3_Ri2ObjCoordXDstStdDe_SIM)
	{
		if(@Vehicle_Signals::i_RRCR_3_Ri2ObjCoordXDstStdDe_EN)
		{
			RRCR_3.RRCR_3_Ri2ObjCoordXDstStdDe = @Vehicle_Signals::i_RRCR_3_Ri2ObjCoordXDstStdDe_Raw;
		}
		else
		{
			RRCR_3.RRCR_3_Ri2ObjCoordXDstStdDe.phys = @Vehicle_Signals::i_RRCR_3_Ri2ObjCoordXDstStdDe;
		}
	}
	else
	{
		// To be completed in simulation
	}

	/* RRCR_3_Ri2ObjCoordY */
	if(!@Vehicle_Signals::i_RRCR_3_Ri2ObjCoordY_SIM)
	{
		if(@Vehicle_Signals::i_RRCR_3_Ri2ObjCoordY_EN)
		{
			RRCR_3.RRCR_3_Ri2ObjCoordY = @Vehicle_Signals::i_RRCR_3_Ri2ObjCoordY_Raw;
		}
		else
		{
			RRCR_3.RRCR_3_Ri2ObjCoordY.phys = @Vehicle_Signals::i_RRCR_3_Ri2ObjCoordY;
		}
	}
	else
	{
		// To be completed in simulation
	}

	/* RRCR_3_Ri2ObjCoordYDstStdDe */
	if(!@Vehicle_Signals::i_RRCR_3_Ri2ObjCoordYDstStdDe_SIM)
	{
		if(@Vehicle_Signals::i_RRCR_3_Ri2ObjCoordYDstStdDe_EN)
		{
			RRCR_3.RRCR_3_Ri2ObjCoordYDstStdDe = @Vehicle_Signals::i_RRCR_3_Ri2ObjCoordYDstStdDe_Raw;
		}
		else
		{
			RRCR_3.RRCR_3_Ri2ObjCoordYDstStdDe.phys = @Vehicle_Signals::i_RRCR_3_Ri2ObjCoordYDstStdDe;
		}
	}
	else
	{
		// To be completed in simulation
	}

	/* RRCR_3_Ri2ObjID */
	if(!@Vehicle_Signals::i_RRCR_3_Ri2ObjID_SIM)
	{
		if(@Vehicle_Signals::i_RRCR_3_Ri2ObjID_EN)
		{
			RRCR_3.RRCR_3_Ri2ObjID = @Vehicle_Signals::i_RRCR_3_Ri2ObjID_Raw;
		}
		else
		{
			RRCR_3.RRCR_3_Ri2ObjID.phys = @Vehicle_Signals::i_RRCR_3_Ri2ObjID;
		}
	}
	else
	{
		// To be completed in simulation
	}

	/* RRCR_3_Ri2ObjMtnChartc */
	if(!@Vehicle_Signals::i_RRCR_3_Ri2ObjMtnChartc_SIM)
	{
		if(@Vehicle_Signals::i_RRCR_3_Ri2ObjMtnChartc_EN)
		{
			RRCR_3.RRCR_3_Ri2ObjMtnChartc = @Vehicle_Signals::i_RRCR_3_Ri2ObjMtnChartc_Raw;
		}
		else
		{
			RRCR_3.RRCR_3_Ri2ObjMtnChartc.phys = @Vehicle_Signals::i_RRCR_3_Ri2ObjMtnChartc;
		}
	}
	else
	{
		// To be completed in simulation
	}

	/* RRCR_3_Ri2ObjNrOffocst */
	if(!@Vehicle_Signals::i_RRCR_3_Ri2ObjNrOffocst_SIM)
	{
		if(@Vehicle_Signals::i_RRCR_3_Ri2ObjNrOffocst_EN)
		{
			RRCR_3.RRCR_3_Ri2ObjNrOffocst = @Vehicle_Signals::i_RRCR_3_Ri2ObjNrOffocst_Raw;
		}
		else
		{
			RRCR_3.RRCR_3_Ri2ObjNrOffocst.phys = @Vehicle_Signals::i_RRCR_3_Ri2ObjNrOffocst;
		}
	}
	else
	{
		// To be completed in simulation
	}

	/* RRCR_3_Ri2ObjTrackSt */
	if(!@Vehicle_Signals::i_RRCR_3_Ri2ObjTrackSt_SIM)
	{
		if(@Vehicle_Signals::i_RRCR_3_Ri2ObjTrackSt_EN)
		{
			RRCR_3.RRCR_3_Ri2ObjTrackSt = @Vehicle_Signals::i_RRCR_3_Ri2ObjTrackSt_Raw;
		}
		else
		{
			RRCR_3.RRCR_3_Ri2ObjTrackSt.phys = @Vehicle_Signals::i_RRCR_3_Ri2ObjTrackSt;
		}
	}
	else
	{
		// To be completed in simulation
	}

	/* RRCR_3_Ri2ObjTyp */
	if(!@Vehicle_Signals::i_RRCR_3_Ri2ObjTyp_SIM)
	{
		if(@Vehicle_Signals::i_RRCR_3_Ri2ObjTyp_EN)
		{
			RRCR_3.RRCR_3_Ri2ObjTyp = @Vehicle_Signals::i_RRCR_3_Ri2ObjTyp_Raw;
		}
		else
		{
			RRCR_3.RRCR_3_Ri2ObjTyp.phys = @Vehicle_Signals::i_RRCR_3_Ri2ObjTyp;
		}
	}
	else
	{
		// To be completed in simulation
	}

	/* RRCR_3_Ri2ObjXDirAV */
	if(!@Vehicle_Signals::i_RRCR_3_Ri2ObjXDirAV_SIM)
	{
		if(@Vehicle_Signals::i_RRCR_3_Ri2ObjXDirAV_EN)
		{
			RRCR_3.RRCR_3_Ri2ObjXDirAV = @Vehicle_Signals::i_RRCR_3_Ri2ObjXDirAV_Raw;
		}
		else
		{
			RRCR_3.RRCR_3_Ri2ObjXDirAV.phys = @Vehicle_Signals::i_RRCR_3_Ri2ObjXDirAV;
		}
	}
	else
	{
		// To be completed in simulation
	}

	/* RRCR_3_Ri2ObjXDirV */
	if(!@Vehicle_Signals::i_RRCR_3_Ri2ObjXDirV_SIM)
	{
		if(@Vehicle_Signals::i_RRCR_3_Ri2ObjXDirV_EN)
		{
			RRCR_3.RRCR_3_Ri2ObjXDirV = @Vehicle_Signals::i_RRCR_3_Ri2ObjXDirV_Raw;
		}
		else
		{
			RRCR_3.RRCR_3_Ri2ObjXDirV.phys = @Vehicle_Signals::i_RRCR_3_Ri2ObjXDirV;
		}
	}
	else
	{
		// To be completed in simulation
	}

	/* RRCR_3_Ri2ObjXDirVStdDe */
	if(!@Vehicle_Signals::i_RRCR_3_Ri2ObjXDirVStdDe_SIM)
	{
		if(@Vehicle_Signals::i_RRCR_3_Ri2ObjXDirVStdDe_EN)
		{
			RRCR_3.RRCR_3_Ri2ObjXDirVStdDe = @Vehicle_Signals::i_RRCR_3_Ri2ObjXDirVStdDe_Raw;
		}
		else
		{
			RRCR_3.RRCR_3_Ri2ObjXDirVStdDe.phys = @Vehicle_Signals::i_RRCR_3_Ri2ObjXDirVStdDe;
		}
	}
	else
	{
		// To be completed in simulation
	}

	/* RRCR_3_Ri2ObjYDirV */
	if(!@Vehicle_Signals::i_RRCR_3_Ri2ObjYDirV_SIM)
	{
		if(@Vehicle_Signals::i_RRCR_3_Ri2ObjYDirV_EN)
		{
			RRCR_3.RRCR_3_Ri2ObjYDirV = @Vehicle_Signals::i_RRCR_3_Ri2ObjYDirV_Raw;
		}
		else
		{
			RRCR_3.RRCR_3_Ri2ObjYDirV.phys = @Vehicle_Signals::i_RRCR_3_Ri2ObjYDirV;
		}
	}
	else
	{
		// To be completed in simulation
	}

	/* RRCR_3_Ri2ObjYDirVStdDe */
	if(!@Vehicle_Signals::i_RRCR_3_Ri2ObjYDirVStdDe_SIM)
	{
		if(@Vehicle_Signals::i_RRCR_3_Ri2ObjYDirVStdDe_EN)
		{
			RRCR_3.RRCR_3_Ri2ObjYDirVStdDe = @Vehicle_Signals::i_RRCR_3_Ri2ObjYDirVStdDe_Raw;
		}
		else
		{
			RRCR_3.RRCR_3_Ri2ObjYDirVStdDe.phys = @Vehicle_Signals::i_RRCR_3_Ri2ObjYDirVStdDe;
		}
	}
	else
	{
		// To be completed in simulation
	}

	/* Rolling counter */
	PROJ_Sim_Rollingcounter(MSG_CONFIG_TX_RRCR_3, RRCR_3);

	/* CheckSum */
	PROJ_Sim_Checksum(MSG_CONFIG_TX_RRCR_3, RRCR_3);

	/* DLC Check */
	RRCR_3.DataLength = @Error_panel_vehicle::i_DLCError[MSG_CONFIG_TX_RRCR_3]?1:DBLookup(RRCR_3).dlc;

}

PROJ_CalcMsg_RRCR_4()
{
	/* RRCR_4_Ri3HdTo */
	if(!@Vehicle_Signals::i_RRCR_4_Ri3HdTo_SIM)
	{
		if(@Vehicle_Signals::i_RRCR_4_Ri3HdTo_EN)
		{
			RRCR_4.RRCR_4_Ri3HdTo = @Vehicle_Signals::i_RRCR_4_Ri3HdTo_Raw;
		}
		else
		{
			RRCR_4.RRCR_4_Ri3HdTo.phys = @Vehicle_Signals::i_RRCR_4_Ri3HdTo;
		}
	}
	else
	{
		// To be completed in simulation
	}

	/* RRCR_4_Ri3ObjBoxLen */
	if(!@Vehicle_Signals::i_RRCR_4_Ri3ObjBoxLen_SIM)
	{
		if(@Vehicle_Signals::i_RRCR_4_Ri3ObjBoxLen_EN)
		{
			RRCR_4.RRCR_4_Ri3ObjBoxLen = @Vehicle_Signals::i_RRCR_4_Ri3ObjBoxLen_Raw;
		}
		else
		{
			RRCR_4.RRCR_4_Ri3ObjBoxLen.phys = @Vehicle_Signals::i_RRCR_4_Ri3ObjBoxLen;
		}
	}
	else
	{
		// To be completed in simulation
	}

	/* RRCR_4_Ri3ObjBoxWidth */
	if(!@Vehicle_Signals::i_RRCR_4_Ri3ObjBoxWidth_SIM)
	{
		if(@Vehicle_Signals::i_RRCR_4_Ri3ObjBoxWidth_EN)
		{
			RRCR_4.RRCR_4_Ri3ObjBoxWidth = @Vehicle_Signals::i_RRCR_4_Ri3ObjBoxWidth_Raw;
		}
		else
		{
			RRCR_4.RRCR_4_Ri3ObjBoxWidth.phys = @Vehicle_Signals::i_RRCR_4_Ri3ObjBoxWidth;
		}
	}
	else
	{
		// To be completed in simulation
	}

	/* RRCR_4_Ri3ObjConf */
	if(!@Vehicle_Signals::i_RRCR_4_Ri3ObjConf_SIM)
	{
		if(@Vehicle_Signals::i_RRCR_4_Ri3ObjConf_EN)
		{
			RRCR_4.RRCR_4_Ri3ObjConf = @Vehicle_Signals::i_RRCR_4_Ri3ObjConf_Raw;
		}
		else
		{
			RRCR_4.RRCR_4_Ri3ObjConf.phys = @Vehicle_Signals::i_RRCR_4_Ri3ObjConf;
		}
	}
	else
	{
		// To be completed in simulation
	}

	/* RRCR_4_Ri3ObjCoordX */
	if(!@Vehicle_Signals::i_RRCR_4_Ri3ObjCoordX_SIM)
	{
		if(@Vehicle_Signals::i_RRCR_4_Ri3ObjCoordX_EN)
		{
			RRCR_4.RRCR_4_Ri3ObjCoordX = @Vehicle_Signals::i_RRCR_4_Ri3ObjCoordX_Raw;
		}
		else
		{
			RRCR_4.RRCR_4_Ri3ObjCoordX.phys = @Vehicle_Signals::i_RRCR_4_Ri3ObjCoordX;
		}
	}
	else
	{
		// To be completed in simulation
	}

	/* RRCR_4_Ri3ObjCoordXDstStdDe */
	if(!@Vehicle_Signals::i_RRCR_4_Ri3ObjCoordXDstStdDe_SIM)
	{
		if(@Vehicle_Signals::i_RRCR_4_Ri3ObjCoordXDstStdDe_EN)
		{
			RRCR_4.RRCR_4_Ri3ObjCoordXDstStdDe = @Vehicle_Signals::i_RRCR_4_Ri3ObjCoordXDstStdDe_Raw;
		}
		else
		{
			RRCR_4.RRCR_4_Ri3ObjCoordXDstStdDe.phys = @Vehicle_Signals::i_RRCR_4_Ri3ObjCoordXDstStdDe;
		}
	}
	else
	{
		// To be completed in simulation
	}

	/* RRCR_4_Ri3ObjCoordY */
	if(!@Vehicle_Signals::i_RRCR_4_Ri3ObjCoordY_SIM)
	{
		if(@Vehicle_Signals::i_RRCR_4_Ri3ObjCoordY_EN)
		{
			RRCR_4.RRCR_4_Ri3ObjCoordY = @Vehicle_Signals::i_RRCR_4_Ri3ObjCoordY_Raw;
		}
		else
		{
			RRCR_4.RRCR_4_Ri3ObjCoordY.phys = @Vehicle_Signals::i_RRCR_4_Ri3ObjCoordY;
		}
	}
	else
	{
		// To be completed in simulation
	}

	/* RRCR_4_Ri3ObjCoordYDstStdDe */
	if(!@Vehicle_Signals::i_RRCR_4_Ri3ObjCoordYDstStdDe_SIM)
	{
		if(@Vehicle_Signals::i_RRCR_4_Ri3ObjCoordYDstStdDe_EN)
		{
			RRCR_4.RRCR_4_Ri3ObjCoordYDstStdDe = @Vehicle_Signals::i_RRCR_4_Ri3ObjCoordYDstStdDe_Raw;
		}
		else
		{
			RRCR_4.RRCR_4_Ri3ObjCoordYDstStdDe.phys = @Vehicle_Signals::i_RRCR_4_Ri3ObjCoordYDstStdDe;
		}
	}
	else
	{
		// To be completed in simulation
	}

	/* RRCR_4_Ri3ObjID */
	if(!@Vehicle_Signals::i_RRCR_4_Ri3ObjID_SIM)
	{
		if(@Vehicle_Signals::i_RRCR_4_Ri3ObjID_EN)
		{
			RRCR_4.RRCR_4_Ri3ObjID = @Vehicle_Signals::i_RRCR_4_Ri3ObjID_Raw;
		}
		else
		{
			RRCR_4.RRCR_4_Ri3ObjID.phys = @Vehicle_Signals::i_RRCR_4_Ri3ObjID;
		}
	}
	else
	{
		// To be completed in simulation
	}

	/* RRCR_4_Ri3ObjMtnChartc */
	if(!@Vehicle_Signals::i_RRCR_4_Ri3ObjMtnChartc_SIM)
	{
		if(@Vehicle_Signals::i_RRCR_4_Ri3ObjMtnChartc_EN)
		{
			RRCR_4.RRCR_4_Ri3ObjMtnChartc = @Vehicle_Signals::i_RRCR_4_Ri3ObjMtnChartc_Raw;
		}
		else
		{
			RRCR_4.RRCR_4_Ri3ObjMtnChartc.phys = @Vehicle_Signals::i_RRCR_4_Ri3ObjMtnChartc;
		}
	}
	else
	{
		// To be completed in simulation
	}

	/* RRCR_4_Ri3ObjNrOffocst */
	if(!@Vehicle_Signals::i_RRCR_4_Ri3ObjNrOffocst_SIM)
	{
		if(@Vehicle_Signals::i_RRCR_4_Ri3ObjNrOffocst_EN)
		{
			RRCR_4.RRCR_4_Ri3ObjNrOffocst = @Vehicle_Signals::i_RRCR_4_Ri3ObjNrOffocst_Raw;
		}
		else
		{
			RRCR_4.RRCR_4_Ri3ObjNrOffocst.phys = @Vehicle_Signals::i_RRCR_4_Ri3ObjNrOffocst;
		}
	}
	else
	{
		// To be completed in simulation
	}

	/* RRCR_4_Ri3ObjTrackSt */
	if(!@Vehicle_Signals::i_RRCR_4_Ri3ObjTrackSt_SIM)
	{
		if(@Vehicle_Signals::i_RRCR_4_Ri3ObjTrackSt_EN)
		{
			RRCR_4.RRCR_4_Ri3ObjTrackSt = @Vehicle_Signals::i_RRCR_4_Ri3ObjTrackSt_Raw;
		}
		else
		{
			RRCR_4.RRCR_4_Ri3ObjTrackSt.phys = @Vehicle_Signals::i_RRCR_4_Ri3ObjTrackSt;
		}
	}
	else
	{
		// To be completed in simulation
	}

	/* RRCR_4_Ri3ObjTyp */
	if(!@Vehicle_Signals::i_RRCR_4_Ri3ObjTyp_SIM)
	{
		if(@Vehicle_Signals::i_RRCR_4_Ri3ObjTyp_EN)
		{
			RRCR_4.RRCR_4_Ri3ObjTyp = @Vehicle_Signals::i_RRCR_4_Ri3ObjTyp_Raw;
		}
		else
		{
			RRCR_4.RRCR_4_Ri3ObjTyp.phys = @Vehicle_Signals::i_RRCR_4_Ri3ObjTyp;
		}
	}
	else
	{
		// To be completed in simulation
	}

	/* RRCR_4_Ri3ObjXDirAV */
	if(!@Vehicle_Signals::i_RRCR_4_Ri3ObjXDirAV_SIM)
	{
		if(@Vehicle_Signals::i_RRCR_4_Ri3ObjXDirAV_EN)
		{
			RRCR_4.RRCR_4_Ri3ObjXDirAV = @Vehicle_Signals::i_RRCR_4_Ri3ObjXDirAV_Raw;
		}
		else
		{
			RRCR_4.RRCR_4_Ri3ObjXDirAV.phys = @Vehicle_Signals::i_RRCR_4_Ri3ObjXDirAV;
		}
	}
	else
	{
		// To be completed in simulation
	}

	/* RRCR_4_Ri3ObjXDirV */
	if(!@Vehicle_Signals::i_RRCR_4_Ri3ObjXDirV_SIM)
	{
		if(@Vehicle_Signals::i_RRCR_4_Ri3ObjXDirV_EN)
		{
			RRCR_4.RRCR_4_Ri3ObjXDirV = @Vehicle_Signals::i_RRCR_4_Ri3ObjXDirV_Raw;
		}
		else
		{
			RRCR_4.RRCR_4_Ri3ObjXDirV.phys = @Vehicle_Signals::i_RRCR_4_Ri3ObjXDirV;
		}
	}
	else
	{
		// To be completed in simulation
	}

	/* RRCR_4_Ri3ObjXDirVStdDe */
	if(!@Vehicle_Signals::i_RRCR_4_Ri3ObjXDirVStdDe_SIM)
	{
		if(@Vehicle_Signals::i_RRCR_4_Ri3ObjXDirVStdDe_EN)
		{
			RRCR_4.RRCR_4_Ri3ObjXDirVStdDe = @Vehicle_Signals::i_RRCR_4_Ri3ObjXDirVStdDe_Raw;
		}
		else
		{
			RRCR_4.RRCR_4_Ri3ObjXDirVStdDe.phys = @Vehicle_Signals::i_RRCR_4_Ri3ObjXDirVStdDe;
		}
	}
	else
	{
		// To be completed in simulation
	}

	/* RRCR_4_Ri3ObjYDirV */
	if(!@Vehicle_Signals::i_RRCR_4_Ri3ObjYDirV_SIM)
	{
		if(@Vehicle_Signals::i_RRCR_4_Ri3ObjYDirV_EN)
		{
			RRCR_4.RRCR_4_Ri3ObjYDirV = @Vehicle_Signals::i_RRCR_4_Ri3ObjYDirV_Raw;
		}
		else
		{
			RRCR_4.RRCR_4_Ri3ObjYDirV.phys = @Vehicle_Signals::i_RRCR_4_Ri3ObjYDirV;
		}
	}
	else
	{
		// To be completed in simulation
	}

	/* RRCR_4_Ri3ObjYDirVStdDe */
	if(!@Vehicle_Signals::i_RRCR_4_Ri3ObjYDirVStdDe_SIM)
	{
		if(@Vehicle_Signals::i_RRCR_4_Ri3ObjYDirVStdDe_EN)
		{
			RRCR_4.RRCR_4_Ri3ObjYDirVStdDe = @Vehicle_Signals::i_RRCR_4_Ri3ObjYDirVStdDe_Raw;
		}
		else
		{
			RRCR_4.RRCR_4_Ri3ObjYDirVStdDe.phys = @Vehicle_Signals::i_RRCR_4_Ri3ObjYDirVStdDe;
		}
	}
	else
	{
		// To be completed in simulation
	}

	/* Rolling counter */
	PROJ_Sim_Rollingcounter(MSG_CONFIG_TX_RRCR_4, RRCR_4);

	/* CheckSum */
	PROJ_Sim_Checksum(MSG_CONFIG_TX_RRCR_4, RRCR_4);

	/* DLC Check */
	RRCR_4.DataLength = @Error_panel_vehicle::i_DLCError[MSG_CONFIG_TX_RRCR_4]?1:DBLookup(RRCR_4).dlc;

}

PROJ_CalcMsg_RRCR_5()
{
	/* RRCR_5_Ri4HdTo */
	if(!@Vehicle_Signals::i_RRCR_5_Ri4HdTo_SIM)
	{
		if(@Vehicle_Signals::i_RRCR_5_Ri4HdTo_EN)
		{
			RRCR_5.RRCR_5_Ri4HdTo = @Vehicle_Signals::i_RRCR_5_Ri4HdTo_Raw;
		}
		else
		{
			RRCR_5.RRCR_5_Ri4HdTo.phys = @Vehicle_Signals::i_RRCR_5_Ri4HdTo;
		}
	}
	else
	{
		// To be completed in simulation
	}

	/* RRCR_5_Ri4ObjBoxLen */
	if(!@Vehicle_Signals::i_RRCR_5_Ri4ObjBoxLen_SIM)
	{
		if(@Vehicle_Signals::i_RRCR_5_Ri4ObjBoxLen_EN)
		{
			RRCR_5.RRCR_5_Ri4ObjBoxLen = @Vehicle_Signals::i_RRCR_5_Ri4ObjBoxLen_Raw;
		}
		else
		{
			RRCR_5.RRCR_5_Ri4ObjBoxLen.phys = @Vehicle_Signals::i_RRCR_5_Ri4ObjBoxLen;
		}
	}
	else
	{
		// To be completed in simulation
	}

	/* RRCR_5_Ri4ObjBoxWidth */
	if(!@Vehicle_Signals::i_RRCR_5_Ri4ObjBoxWidth_SIM)
	{
		if(@Vehicle_Signals::i_RRCR_5_Ri4ObjBoxWidth_EN)
		{
			RRCR_5.RRCR_5_Ri4ObjBoxWidth = @Vehicle_Signals::i_RRCR_5_Ri4ObjBoxWidth_Raw;
		}
		else
		{
			RRCR_5.RRCR_5_Ri4ObjBoxWidth.phys = @Vehicle_Signals::i_RRCR_5_Ri4ObjBoxWidth;
		}
	}
	else
	{
		// To be completed in simulation
	}

	/* RRCR_5_Ri4ObjConf */
	if(!@Vehicle_Signals::i_RRCR_5_Ri4ObjConf_SIM)
	{
		if(@Vehicle_Signals::i_RRCR_5_Ri4ObjConf_EN)
		{
			RRCR_5.RRCR_5_Ri4ObjConf = @Vehicle_Signals::i_RRCR_5_Ri4ObjConf_Raw;
		}
		else
		{
			RRCR_5.RRCR_5_Ri4ObjConf.phys = @Vehicle_Signals::i_RRCR_5_Ri4ObjConf;
		}
	}
	else
	{
		// To be completed in simulation
	}

	/* RRCR_5_Ri4ObjCoordX */
	if(!@Vehicle_Signals::i_RRCR_5_Ri4ObjCoordX_SIM)
	{
		if(@Vehicle_Signals::i_RRCR_5_Ri4ObjCoordX_EN)
		{
			RRCR_5.RRCR_5_Ri4ObjCoordX = @Vehicle_Signals::i_RRCR_5_Ri4ObjCoordX_Raw;
		}
		else
		{
			RRCR_5.RRCR_5_Ri4ObjCoordX.phys = @Vehicle_Signals::i_RRCR_5_Ri4ObjCoordX;
		}
	}
	else
	{
		// To be completed in simulation
	}

	/* RRCR_5_Ri4ObjCoordXDstStdDe */
	if(!@Vehicle_Signals::i_RRCR_5_Ri4ObjCoordXDstStdDe_SIM)
	{
		if(@Vehicle_Signals::i_RRCR_5_Ri4ObjCoordXDstStdDe_EN)
		{
			RRCR_5.RRCR_5_Ri4ObjCoordXDstStdDe = @Vehicle_Signals::i_RRCR_5_Ri4ObjCoordXDstStdDe_Raw;
		}
		else
		{
			RRCR_5.RRCR_5_Ri4ObjCoordXDstStdDe.phys = @Vehicle_Signals::i_RRCR_5_Ri4ObjCoordXDstStdDe;
		}
	}
	else
	{
		// To be completed in simulation
	}

	/* RRCR_5_Ri4ObjCoordY */
	if(!@Vehicle_Signals::i_RRCR_5_Ri4ObjCoordY_SIM)
	{
		if(@Vehicle_Signals::i_RRCR_5_Ri4ObjCoordY_EN)
		{
			RRCR_5.RRCR_5_Ri4ObjCoordY = @Vehicle_Signals::i_RRCR_5_Ri4ObjCoordY_Raw;
		}
		else
		{
			RRCR_5.RRCR_5_Ri4ObjCoordY.phys = @Vehicle_Signals::i_RRCR_5_Ri4ObjCoordY;
		}
	}
	else
	{
		// To be completed in simulation
	}

	/* RRCR_5_Ri4ObjCoordYDstStdDe */
	if(!@Vehicle_Signals::i_RRCR_5_Ri4ObjCoordYDstStdDe_SIM)
	{
		if(@Vehicle_Signals::i_RRCR_5_Ri4ObjCoordYDstStdDe_EN)
		{
			RRCR_5.RRCR_5_Ri4ObjCoordYDstStdDe = @Vehicle_Signals::i_RRCR_5_Ri4ObjCoordYDstStdDe_Raw;
		}
		else
		{
			RRCR_5.RRCR_5_Ri4ObjCoordYDstStdDe.phys = @Vehicle_Signals::i_RRCR_5_Ri4ObjCoordYDstStdDe;
		}
	}
	else
	{
		// To be completed in simulation
	}

	/* RRCR_5_Ri4ObjID */
	if(!@Vehicle_Signals::i_RRCR_5_Ri4ObjID_SIM)
	{
		if(@Vehicle_Signals::i_RRCR_5_Ri4ObjID_EN)
		{
			RRCR_5.RRCR_5_Ri4ObjID = @Vehicle_Signals::i_RRCR_5_Ri4ObjID_Raw;
		}
		else
		{
			RRCR_5.RRCR_5_Ri4ObjID.phys = @Vehicle_Signals::i_RRCR_5_Ri4ObjID;
		}
	}
	else
	{
		// To be completed in simulation
	}

	/* RRCR_5_Ri4ObjMtnChartc */
	if(!@Vehicle_Signals::i_RRCR_5_Ri4ObjMtnChartc_SIM)
	{
		if(@Vehicle_Signals::i_RRCR_5_Ri4ObjMtnChartc_EN)
		{
			RRCR_5.RRCR_5_Ri4ObjMtnChartc = @Vehicle_Signals::i_RRCR_5_Ri4ObjMtnChartc_Raw;
		}
		else
		{
			RRCR_5.RRCR_5_Ri4ObjMtnChartc.phys = @Vehicle_Signals::i_RRCR_5_Ri4ObjMtnChartc;
		}
	}
	else
	{
		// To be completed in simulation
	}

	/* RRCR_5_Ri4ObjNrOffocst */
	if(!@Vehicle_Signals::i_RRCR_5_Ri4ObjNrOffocst_SIM)
	{
		if(@Vehicle_Signals::i_RRCR_5_Ri4ObjNrOffocst_EN)
		{
			RRCR_5.RRCR_5_Ri4ObjNrOffocst = @Vehicle_Signals::i_RRCR_5_Ri4ObjNrOffocst_Raw;
		}
		else
		{
			RRCR_5.RRCR_5_Ri4ObjNrOffocst.phys = @Vehicle_Signals::i_RRCR_5_Ri4ObjNrOffocst;
		}
	}
	else
	{
		// To be completed in simulation
	}

	/* RRCR_5_Ri4ObjTrackSt */
	if(!@Vehicle_Signals::i_RRCR_5_Ri4ObjTrackSt_SIM)
	{
		if(@Vehicle_Signals::i_RRCR_5_Ri4ObjTrackSt_EN)
		{
			RRCR_5.RRCR_5_Ri4ObjTrackSt = @Vehicle_Signals::i_RRCR_5_Ri4ObjTrackSt_Raw;
		}
		else
		{
			RRCR_5.RRCR_5_Ri4ObjTrackSt.phys = @Vehicle_Signals::i_RRCR_5_Ri4ObjTrackSt;
		}
	}
	else
	{
		// To be completed in simulation
	}

	/* RRCR_5_Ri4ObjTyp */
	if(!@Vehicle_Signals::i_RRCR_5_Ri4ObjTyp_SIM)
	{
		if(@Vehicle_Signals::i_RRCR_5_Ri4ObjTyp_EN)
		{
			RRCR_5.RRCR_5_Ri4ObjTyp = @Vehicle_Signals::i_RRCR_5_Ri4ObjTyp_Raw;
		}
		else
		{
			RRCR_5.RRCR_5_Ri4ObjTyp.phys = @Vehicle_Signals::i_RRCR_5_Ri4ObjTyp;
		}
	}
	else
	{
		// To be completed in simulation
	}

	/* RRCR_5_Ri4ObjXDirAV */
	if(!@Vehicle_Signals::i_RRCR_5_Ri4ObjXDirAV_SIM)
	{
		if(@Vehicle_Signals::i_RRCR_5_Ri4ObjXDirAV_EN)
		{
			RRCR_5.RRCR_5_Ri4ObjXDirAV = @Vehicle_Signals::i_RRCR_5_Ri4ObjXDirAV_Raw;
		}
		else
		{
			RRCR_5.RRCR_5_Ri4ObjXDirAV.phys = @Vehicle_Signals::i_RRCR_5_Ri4ObjXDirAV;
		}
	}
	else
	{
		// To be completed in simulation
	}

	/* RRCR_5_Ri4ObjXDirV */
	if(!@Vehicle_Signals::i_RRCR_5_Ri4ObjXDirV_SIM)
	{
		if(@Vehicle_Signals::i_RRCR_5_Ri4ObjXDirV_EN)
		{
			RRCR_5.RRCR_5_Ri4ObjXDirV = @Vehicle_Signals::i_RRCR_5_Ri4ObjXDirV_Raw;
		}
		else
		{
			RRCR_5.RRCR_5_Ri4ObjXDirV.phys = @Vehicle_Signals::i_RRCR_5_Ri4ObjXDirV;
		}
	}
	else
	{
		// To be completed in simulation
	}

	/* RRCR_5_Ri4ObjXDirVStdDe */
	if(!@Vehicle_Signals::i_RRCR_5_Ri4ObjXDirVStdDe_SIM)
	{
		if(@Vehicle_Signals::i_RRCR_5_Ri4ObjXDirVStdDe_EN)
		{
			RRCR_5.RRCR_5_Ri4ObjXDirVStdDe = @Vehicle_Signals::i_RRCR_5_Ri4ObjXDirVStdDe_Raw;
		}
		else
		{
			RRCR_5.RRCR_5_Ri4ObjXDirVStdDe.phys = @Vehicle_Signals::i_RRCR_5_Ri4ObjXDirVStdDe;
		}
	}
	else
	{
		// To be completed in simulation
	}

	/* RRCR_5_Ri4ObjYDirV */
	if(!@Vehicle_Signals::i_RRCR_5_Ri4ObjYDirV_SIM)
	{
		if(@Vehicle_Signals::i_RRCR_5_Ri4ObjYDirV_EN)
		{
			RRCR_5.RRCR_5_Ri4ObjYDirV = @Vehicle_Signals::i_RRCR_5_Ri4ObjYDirV_Raw;
		}
		else
		{
			RRCR_5.RRCR_5_Ri4ObjYDirV.phys = @Vehicle_Signals::i_RRCR_5_Ri4ObjYDirV;
		}
	}
	else
	{
		// To be completed in simulation
	}

	/* RRCR_5_Ri4ObjYDirVStdDe */
	if(!@Vehicle_Signals::i_RRCR_5_Ri4ObjYDirVStdDe_SIM)
	{
		if(@Vehicle_Signals::i_RRCR_5_Ri4ObjYDirVStdDe_EN)
		{
			RRCR_5.RRCR_5_Ri4ObjYDirVStdDe = @Vehicle_Signals::i_RRCR_5_Ri4ObjYDirVStdDe_Raw;
		}
		else
		{
			RRCR_5.RRCR_5_Ri4ObjYDirVStdDe.phys = @Vehicle_Signals::i_RRCR_5_Ri4ObjYDirVStdDe;
		}
	}
	else
	{
		// To be completed in simulation
	}

	/* Rolling counter */
	PROJ_Sim_Rollingcounter(MSG_CONFIG_TX_RRCR_5, RRCR_5);

	/* CheckSum */
	PROJ_Sim_Checksum(MSG_CONFIG_TX_RRCR_5, RRCR_5);

	/* DLC Check */
	RRCR_5.DataLength = @Error_panel_vehicle::i_DLCError[MSG_CONFIG_TX_RRCR_5]?1:DBLookup(RRCR_5).dlc;

}

PROJ_CalcMsg_RRCR_6()
{
	/* RRCR_6_Ri5HdTo */
	if(!@Vehicle_Signals::i_RRCR_6_Ri5HdTo_SIM)
	{
		if(@Vehicle_Signals::i_RRCR_6_Ri5HdTo_EN)
		{
			RRCR_6.RRCR_6_Ri5HdTo = @Vehicle_Signals::i_RRCR_6_Ri5HdTo_Raw;
		}
		else
		{
			RRCR_6.RRCR_6_Ri5HdTo.phys = @Vehicle_Signals::i_RRCR_6_Ri5HdTo;
		}
	}
	else
	{
		// To be completed in simulation
	}

	/* RRCR_6_Ri5ObjBoxLen */
	if(!@Vehicle_Signals::i_RRCR_6_Ri5ObjBoxLen_SIM)
	{
		if(@Vehicle_Signals::i_RRCR_6_Ri5ObjBoxLen_EN)
		{
			RRCR_6.RRCR_6_Ri5ObjBoxLen = @Vehicle_Signals::i_RRCR_6_Ri5ObjBoxLen_Raw;
		}
		else
		{
			RRCR_6.RRCR_6_Ri5ObjBoxLen.phys = @Vehicle_Signals::i_RRCR_6_Ri5ObjBoxLen;
		}
	}
	else
	{
		// To be completed in simulation
	}

	/* RRCR_6_Ri5ObjBoxWidth */
	if(!@Vehicle_Signals::i_RRCR_6_Ri5ObjBoxWidth_SIM)
	{
		if(@Vehicle_Signals::i_RRCR_6_Ri5ObjBoxWidth_EN)
		{
			RRCR_6.RRCR_6_Ri5ObjBoxWidth = @Vehicle_Signals::i_RRCR_6_Ri5ObjBoxWidth_Raw;
		}
		else
		{
			RRCR_6.RRCR_6_Ri5ObjBoxWidth.phys = @Vehicle_Signals::i_RRCR_6_Ri5ObjBoxWidth;
		}
	}
	else
	{
		// To be completed in simulation
	}

	/* RRCR_6_Ri5ObjConf */
	if(!@Vehicle_Signals::i_RRCR_6_Ri5ObjConf_SIM)
	{
		if(@Vehicle_Signals::i_RRCR_6_Ri5ObjConf_EN)
		{
			RRCR_6.RRCR_6_Ri5ObjConf = @Vehicle_Signals::i_RRCR_6_Ri5ObjConf_Raw;
		}
		else
		{
			RRCR_6.RRCR_6_Ri5ObjConf.phys = @Vehicle_Signals::i_RRCR_6_Ri5ObjConf;
		}
	}
	else
	{
		// To be completed in simulation
	}

	/* RRCR_6_Ri5ObjCoordX */
	if(!@Vehicle_Signals::i_RRCR_6_Ri5ObjCoordX_SIM)
	{
		if(@Vehicle_Signals::i_RRCR_6_Ri5ObjCoordX_EN)
		{
			RRCR_6.RRCR_6_Ri5ObjCoordX = @Vehicle_Signals::i_RRCR_6_Ri5ObjCoordX_Raw;
		}
		else
		{
			RRCR_6.RRCR_6_Ri5ObjCoordX.phys = @Vehicle_Signals::i_RRCR_6_Ri5ObjCoordX;
		}
	}
	else
	{
		// To be completed in simulation
	}

	/* RRCR_6_Ri5ObjCoordXDstStdDe */
	if(!@Vehicle_Signals::i_RRCR_6_Ri5ObjCoordXDstStdDe_SIM)
	{
		if(@Vehicle_Signals::i_RRCR_6_Ri5ObjCoordXDstStdDe_EN)
		{
			RRCR_6.RRCR_6_Ri5ObjCoordXDstStdDe = @Vehicle_Signals::i_RRCR_6_Ri5ObjCoordXDstStdDe_Raw;
		}
		else
		{
			RRCR_6.RRCR_6_Ri5ObjCoordXDstStdDe.phys = @Vehicle_Signals::i_RRCR_6_Ri5ObjCoordXDstStdDe;
		}
	}
	else
	{
		// To be completed in simulation
	}

	/* RRCR_6_Ri5ObjCoordY */
	if(!@Vehicle_Signals::i_RRCR_6_Ri5ObjCoordY_SIM)
	{
		if(@Vehicle_Signals::i_RRCR_6_Ri5ObjCoordY_EN)
		{
			RRCR_6.RRCR_6_Ri5ObjCoordY = @Vehicle_Signals::i_RRCR_6_Ri5ObjCoordY_Raw;
		}
		else
		{
			RRCR_6.RRCR_6_Ri5ObjCoordY.phys = @Vehicle_Signals::i_RRCR_6_Ri5ObjCoordY;
		}
	}
	else
	{
		// To be completed in simulation
	}

	/* RRCR_6_Ri5ObjCoordYDstStdDe */
	if(!@Vehicle_Signals::i_RRCR_6_Ri5ObjCoordYDstStdDe_SIM)
	{
		if(@Vehicle_Signals::i_RRCR_6_Ri5ObjCoordYDstStdDe_EN)
		{
			RRCR_6.RRCR_6_Ri5ObjCoordYDstStdDe = @Vehicle_Signals::i_RRCR_6_Ri5ObjCoordYDstStdDe_Raw;
		}
		else
		{
			RRCR_6.RRCR_6_Ri5ObjCoordYDstStdDe.phys = @Vehicle_Signals::i_RRCR_6_Ri5ObjCoordYDstStdDe;
		}
	}
	else
	{
		// To be completed in simulation
	}

	/* RRCR_6_Ri5ObjID */
	if(!@Vehicle_Signals::i_RRCR_6_Ri5ObjID_SIM)
	{
		if(@Vehicle_Signals::i_RRCR_6_Ri5ObjID_EN)
		{
			RRCR_6.RRCR_6_Ri5ObjID = @Vehicle_Signals::i_RRCR_6_Ri5ObjID_Raw;
		}
		else
		{
			RRCR_6.RRCR_6_Ri5ObjID.phys = @Vehicle_Signals::i_RRCR_6_Ri5ObjID;
		}
	}
	else
	{
		// To be completed in simulation
	}

	/* RRCR_6_Ri5ObjMtnChartc */
	if(!@Vehicle_Signals::i_RRCR_6_Ri5ObjMtnChartc_SIM)
	{
		if(@Vehicle_Signals::i_RRCR_6_Ri5ObjMtnChartc_EN)
		{
			RRCR_6.RRCR_6_Ri5ObjMtnChartc = @Vehicle_Signals::i_RRCR_6_Ri5ObjMtnChartc_Raw;
		}
		else
		{
			RRCR_6.RRCR_6_Ri5ObjMtnChartc.phys = @Vehicle_Signals::i_RRCR_6_Ri5ObjMtnChartc;
		}
	}
	else
	{
		// To be completed in simulation
	}

	/* RRCR_6_Ri5ObjNrOffocst */
	if(!@Vehicle_Signals::i_RRCR_6_Ri5ObjNrOffocst_SIM)
	{
		if(@Vehicle_Signals::i_RRCR_6_Ri5ObjNrOffocst_EN)
		{
			RRCR_6.RRCR_6_Ri5ObjNrOffocst = @Vehicle_Signals::i_RRCR_6_Ri5ObjNrOffocst_Raw;
		}
		else
		{
			RRCR_6.RRCR_6_Ri5ObjNrOffocst.phys = @Vehicle_Signals::i_RRCR_6_Ri5ObjNrOffocst;
		}
	}
	else
	{
		// To be completed in simulation
	}

	/* RRCR_6_Ri5ObjTrackSt */
	if(!@Vehicle_Signals::i_RRCR_6_Ri5ObjTrackSt_SIM)
	{
		if(@Vehicle_Signals::i_RRCR_6_Ri5ObjTrackSt_EN)
		{
			RRCR_6.RRCR_6_Ri5ObjTrackSt = @Vehicle_Signals::i_RRCR_6_Ri5ObjTrackSt_Raw;
		}
		else
		{
			RRCR_6.RRCR_6_Ri5ObjTrackSt.phys = @Vehicle_Signals::i_RRCR_6_Ri5ObjTrackSt;
		}
	}
	else
	{
		// To be completed in simulation
	}

	/* RRCR_6_Ri5ObjTyp */
	if(!@Vehicle_Signals::i_RRCR_6_Ri5ObjTyp_SIM)
	{
		if(@Vehicle_Signals::i_RRCR_6_Ri5ObjTyp_EN)
		{
			RRCR_6.RRCR_6_Ri5ObjTyp = @Vehicle_Signals::i_RRCR_6_Ri5ObjTyp_Raw;
		}
		else
		{
			RRCR_6.RRCR_6_Ri5ObjTyp.phys = @Vehicle_Signals::i_RRCR_6_Ri5ObjTyp;
		}
	}
	else
	{
		// To be completed in simulation
	}

	/* RRCR_6_Ri5ObjXDirAV */
	if(!@Vehicle_Signals::i_RRCR_6_Ri5ObjXDirAV_SIM)
	{
		if(@Vehicle_Signals::i_RRCR_6_Ri5ObjXDirAV_EN)
		{
			RRCR_6.RRCR_6_Ri5ObjXDirAV = @Vehicle_Signals::i_RRCR_6_Ri5ObjXDirAV_Raw;
		}
		else
		{
			RRCR_6.RRCR_6_Ri5ObjXDirAV.phys = @Vehicle_Signals::i_RRCR_6_Ri5ObjXDirAV;
		}
	}
	else
	{
		// To be completed in simulation
	}

	/* RRCR_6_Ri5ObjXDirV */
	if(!@Vehicle_Signals::i_RRCR_6_Ri5ObjXDirV_SIM)
	{
		if(@Vehicle_Signals::i_RRCR_6_Ri5ObjXDirV_EN)
		{
			RRCR_6.RRCR_6_Ri5ObjXDirV = @Vehicle_Signals::i_RRCR_6_Ri5ObjXDirV_Raw;
		}
		else
		{
			RRCR_6.RRCR_6_Ri5ObjXDirV.phys = @Vehicle_Signals::i_RRCR_6_Ri5ObjXDirV;
		}
	}
	else
	{
		// To be completed in simulation
	}

	/* RRCR_6_Ri5ObjXDirVStdDe */
	if(!@Vehicle_Signals::i_RRCR_6_Ri5ObjXDirVStdDe_SIM)
	{
		if(@Vehicle_Signals::i_RRCR_6_Ri5ObjXDirVStdDe_EN)
		{
			RRCR_6.RRCR_6_Ri5ObjXDirVStdDe = @Vehicle_Signals::i_RRCR_6_Ri5ObjXDirVStdDe_Raw;
		}
		else
		{
			RRCR_6.RRCR_6_Ri5ObjXDirVStdDe.phys = @Vehicle_Signals::i_RRCR_6_Ri5ObjXDirVStdDe;
		}
	}
	else
	{
		// To be completed in simulation
	}

	/* RRCR_6_Ri5ObjYDirV */
	if(!@Vehicle_Signals::i_RRCR_6_Ri5ObjYDirV_SIM)
	{
		if(@Vehicle_Signals::i_RRCR_6_Ri5ObjYDirV_EN)
		{
			RRCR_6.RRCR_6_Ri5ObjYDirV = @Vehicle_Signals::i_RRCR_6_Ri5ObjYDirV_Raw;
		}
		else
		{
			RRCR_6.RRCR_6_Ri5ObjYDirV.phys = @Vehicle_Signals::i_RRCR_6_Ri5ObjYDirV;
		}
	}
	else
	{
		// To be completed in simulation
	}

	/* RRCR_6_Ri5ObjYDirVStdDe */
	if(!@Vehicle_Signals::i_RRCR_6_Ri5ObjYDirVStdDe_SIM)
	{
		if(@Vehicle_Signals::i_RRCR_6_Ri5ObjYDirVStdDe_EN)
		{
			RRCR_6.RRCR_6_Ri5ObjYDirVStdDe = @Vehicle_Signals::i_RRCR_6_Ri5ObjYDirVStdDe_Raw;
		}
		else
		{
			RRCR_6.RRCR_6_Ri5ObjYDirVStdDe.phys = @Vehicle_Signals::i_RRCR_6_Ri5ObjYDirVStdDe;
		}
	}
	else
	{
		// To be completed in simulation
	}

	/* Rolling counter */
	PROJ_Sim_Rollingcounter(MSG_CONFIG_TX_RRCR_6, RRCR_6);

	/* CheckSum */
	PROJ_Sim_Checksum(MSG_CONFIG_TX_RRCR_6, RRCR_6);

	/* DLC Check */
	RRCR_6.DataLength = @Error_panel_vehicle::i_DLCError[MSG_CONFIG_TX_RRCR_6]?1:DBLookup(RRCR_6).dlc;

}

PROJ_CalcMsg_RRCR_7()
{
	/* RRCR_7_TiStampLaten */
	if(!@Vehicle_Signals::i_RRCR_7_TiStampLaten_SIM)
	{
		if(@Vehicle_Signals::i_RRCR_7_TiStampLaten_EN)
		{
			RRCR_7.RRCR_7_TiStampLaten = @Vehicle_Signals::i_RRCR_7_TiStampLaten_Raw;
		}
		else
		{
			RRCR_7.RRCR_7_TiStampLaten.phys = @Vehicle_Signals::i_RRCR_7_TiStampLaten;
		}
	}
	else
	{
		// To be completed in simulation
	}

	/* Rolling counter */
	PROJ_Sim_Rollingcounter(MSG_CONFIG_TX_RRCR_7, RRCR_7);

	/* CheckSum */
	PROJ_Sim_Checksum(MSG_CONFIG_TX_RRCR_7, RRCR_7);

	/* DLC Check */
	RRCR_7.DataLength = @Error_panel_vehicle::i_DLCError[MSG_CONFIG_TX_RRCR_7]?1:DBLookup(RRCR_7).dlc;

}

PROJ_CalcMsg_RRCR_8()
{
	/* RRCR_8_LgtDst */
	if(!@Vehicle_Signals::i_RRCR_8_LgtDst_SIM)
	{
		if(@Vehicle_Signals::i_RRCR_8_LgtDst_EN)
		{
			RRCR_8.RRCR_8_LgtDst = @Vehicle_Signals::i_RRCR_8_LgtDst_Raw;
		}
		else
		{
			RRCR_8.RRCR_8_LgtDst.phys = @Vehicle_Signals::i_RRCR_8_LgtDst;
		}
	}
	else
	{
		// To be completed in simulation
	}

	/* RRCR_8_LgtRelV */
	if(!@Vehicle_Signals::i_RRCR_8_LgtRelV_SIM)
	{
		if(@Vehicle_Signals::i_RRCR_8_LgtRelV_EN)
		{
			RRCR_8.RRCR_8_LgtRelV = @Vehicle_Signals::i_RRCR_8_LgtRelV_Raw;
		}
		else
		{
			RRCR_8.RRCR_8_LgtRelV.phys = @Vehicle_Signals::i_RRCR_8_LgtRelV;
		}
	}
	else
	{
		// To be completed in simulation
	}

	/* RRCR_8_ObjVldFlg */
	if(!@Vehicle_Signals::i_RRCR_8_ObjVldFlg_SIM)
	{
		if(@Vehicle_Signals::i_RRCR_8_ObjVldFlg_EN)
		{
			RRCR_8.RRCR_8_ObjVldFlg = @Vehicle_Signals::i_RRCR_8_ObjVldFlg_Raw;
		}
		else
		{
			RRCR_8.RRCR_8_ObjVldFlg.phys = @Vehicle_Signals::i_RRCR_8_ObjVldFlg;
		}
	}
	else
	{
		// To be completed in simulation
	}

	/* Rolling counter */
	PROJ_Sim_Rollingcounter(MSG_CONFIG_TX_RRCR_8, RRCR_8);

	/* CheckSum */
	PROJ_Sim_Checksum(MSG_CONFIG_TX_RRCR_8, RRCR_8);

	/* DLC Check */
	RRCR_8.DataLength = @Error_panel_vehicle::i_DLCError[MSG_CONFIG_TX_RRCR_8]?1:DBLookup(RRCR_8).dlc;

}

PROJ_CalcMsg_SAM_1_G()
{
	/* AngleFailure */
	if(!@Vehicle_Signals::i_AngleFailure_SIM)
	{
		if(@Vehicle_Signals::i_AngleFailure_EN)
		{
			SAM_1_G.AngleFailure = @Vehicle_Signals::i_AngleFailure_Raw;
		}
		else
		{
			SAM_1_G.AngleFailure.phys = @Vehicle_Signals::i_AngleFailure;
		}
	}
	else
	{
		// To be completed in simulation
	}

	/* SteeringAngle */
	if(!@Vehicle_Signals::i_SteeringAngle_SIM)
	{
		if(@Vehicle_Signals::i_SteeringAngle_EN)
		{
			SAM_1_G.SteeringAngle = @Vehicle_Signals::i_SteeringAngle_Raw;
		}
		else
		{
			SAM_1_G.SteeringAngle.phys = @Vehicle_Signals::i_SteeringAngle;
		}
	}
	else
	{
		// To be completed in simulation
	}

	/* SteeringAngleSpeed */
	if(!@Vehicle_Signals::i_SteeringAngleSpeed_SIM)
	{
		if(@Vehicle_Signals::i_SteeringAngleSpeed_EN)
		{
			SAM_1_G.SteeringAngleSpeed = @Vehicle_Signals::i_SteeringAngleSpeed_Raw;
		}
		else
		{
			SAM_1_G.SteeringAngleSpeed.phys = @Vehicle_Signals::i_SteeringAngleSpeed;
		}
	}
	else
	{
		// To be completed in simulation
	}

	/* SteeringAngleSpeedValidData */
	if(!@Vehicle_Signals::i_SteeringAngleSpeedValidData_SIM)
	{
		if(@Vehicle_Signals::i_SteeringAngleSpeedValidData_EN)
		{
			SAM_1_G.SteeringAngleSpeedValidData = @Vehicle_Signals::i_SteeringAngleSpeedValidData_Raw;
		}
		else
		{
			SAM_1_G.SteeringAngleSpeedValidData.phys = @Vehicle_Signals::i_SteeringAngleSpeedValidData;
		}
	}
	else
	{
		// To be completed in simulation
	}

	/* SteeringAngleValidData */
	if(!@Vehicle_Signals::i_SteeringAngleValidData_SIM)
	{
		if(@Vehicle_Signals::i_SteeringAngleValidData_EN)
		{
			SAM_1_G.SteeringAngleValidData = @Vehicle_Signals::i_SteeringAngleValidData_Raw;
		}
		else
		{
			SAM_1_G.SteeringAngleValidData.phys = @Vehicle_Signals::i_SteeringAngleValidData;
		}
	}
	else
	{
		// To be completed in simulation
	}

	/* Rolling counter */
	PROJ_Sim_Rollingcounter(MSG_CONFIG_TX_SAM_1_G, SAM_1_G);

	/* CheckSum */
	PROJ_Sim_Checksum(MSG_CONFIG_TX_SAM_1_G, SAM_1_G);

	/* DLC Check */
	SAM_1_G.DataLength = @Error_panel_vehicle::i_DLCError[MSG_CONFIG_TX_SAM_1_G]?1:DBLookup(SAM_1_G).dlc;

}

PROJ_CalcMsg_TCU_2()
{
	/* DriverMode */
	if(!@Vehicle_Signals::i_DriverMode_SIM)
	{
		if(@Vehicle_Signals::i_DriverMode_EN)
		{
			TCU_2.DriverMode = @Vehicle_Signals::i_DriverMode_Raw;
		}
		else
		{
			TCU_2.DriverMode.phys = @Vehicle_Signals::i_DriverMode;
		}
	}
	else
	{
		// To be completed in simulation
	}

	/* GBPositoionDisplayForPEPS */
	if(!@Vehicle_Signals::i_GBPositoionDisplayForPEPS_SIM)
	{
		if(@Vehicle_Signals::i_GBPositoionDisplayForPEPS_EN)
		{
			TCU_2.GBPositoionDisplayForPEPS = @Vehicle_Signals::i_GBPositoionDisplayForPEPS_Raw;
		}
		else
		{
			TCU_2.GBPositoionDisplayForPEPS.phys = @Vehicle_Signals::i_GBPositoionDisplayForPEPS;
		}
	}
	else
	{
		// To be completed in simulation
	}

	/* ShiftInProgress */
	if(!@Vehicle_Signals::i_ShiftInProgress_SIM)
	{
		if(@Vehicle_Signals::i_ShiftInProgress_EN)
		{
			TCU_2.ShiftInProgress = @Vehicle_Signals::i_ShiftInProgress_Raw;
		}
		else
		{
			TCU_2.ShiftInProgress.phys = @Vehicle_Signals::i_ShiftInProgress;
		}
	}
	else
	{
		// To be completed in simulation
	}

	/* TargetGear */
	if(!@Vehicle_Signals::i_TargetGear_SIM)
	{
		if(@Vehicle_Signals::i_TargetGear_EN)
		{
			TCU_2.TargetGear = @Vehicle_Signals::i_TargetGear_Raw;
		}
		else
		{
			TCU_2.TargetGear.phys = @Vehicle_Signals::i_TargetGear;
		}
	}
	else
	{
		// To be completed in simulation
	}

	/* TargetGearValidData */
	if(!@Vehicle_Signals::i_TargetGearValidData_SIM)
	{
		if(@Vehicle_Signals::i_TargetGearValidData_EN)
		{
			TCU_2.TargetGearValidData = @Vehicle_Signals::i_TargetGearValidData_Raw;
		}
		else
		{
			TCU_2.TargetGearValidData.phys = @Vehicle_Signals::i_TargetGearValidData;
		}
	}
	else
	{
		// To be completed in simulation
	}

	/* Rolling counter */
	PROJ_Sim_Rollingcounter(MSG_CONFIG_TX_TCU_2, TCU_2);

	/* CheckSum */
	PROJ_Sim_Checksum(MSG_CONFIG_TX_TCU_2, TCU_2);

	/* DLC Check */
	TCU_2.DataLength = @Error_panel_vehicle::i_DLCError[MSG_CONFIG_TX_TCU_2]?1:DBLookup(TCU_2).dlc;

}

PROJ_CalcMsg_TCU_4()
{
	/* STAT_LimpHomeMode */
	if(!@Vehicle_Signals::i_STAT_LimpHomeMode_SIM)
	{
		if(@Vehicle_Signals::i_STAT_LimpHomeMode_EN)
		{
			TCU_4.STAT_LimpHomeMode = @Vehicle_Signals::i_STAT_LimpHomeMode_Raw;
		}
		else
		{
			TCU_4.STAT_LimpHomeMode.phys = @Vehicle_Signals::i_STAT_LimpHomeMode;
		}
	}
	else
	{
		// To be completed in simulation
	}

	/* Rolling counter */
	PROJ_Sim_Rollingcounter(MSG_CONFIG_TX_TCU_4, TCU_4);

	/* CheckSum */
	PROJ_Sim_Checksum(MSG_CONFIG_TX_TCU_4, TCU_4);

	/* DLC Check */
	TCU_4.DataLength = @Error_panel_vehicle::i_DLCError[MSG_CONFIG_TX_TCU_4]?1:DBLookup(TCU_4).dlc;

}

PROJ_CalcMsg_VCU_2()
{
	/* VCU_2_Resd1 */
	if(!@Vehicle_Signals::i_VCU_2_Resd1_SIM)
	{
		if(@Vehicle_Signals::i_VCU_2_Resd1_EN)
		{
			VCU_2.VCU_2_Resd1 = @Vehicle_Signals::i_VCU_2_Resd1_Raw;
		}
		else
		{
			VCU_2.VCU_2_Resd1.phys = @Vehicle_Signals::i_VCU_2_Resd1;
		}
	}
	else
	{
		// To be completed in simulation
	}

	/* VCU_2_Resd2 */
	if(!@Vehicle_Signals::i_VCU_2_Resd2_SIM)
	{
		if(@Vehicle_Signals::i_VCU_2_Resd2_EN)
		{
			VCU_2.VCU_2_Resd2 = @Vehicle_Signals::i_VCU_2_Resd2_Raw;
		}
		else
		{
			VCU_2.VCU_2_Resd2.phys = @Vehicle_Signals::i_VCU_2_Resd2;
		}
	}
	else
	{
		// To be completed in simulation
	}

	/* VCU_2_Resd3 */
	if(!@Vehicle_Signals::i_VCU_2_Resd3_SIM)
	{
		if(@Vehicle_Signals::i_VCU_2_Resd3_EN)
		{
			VCU_2.VCU_2_Resd3 = @Vehicle_Signals::i_VCU_2_Resd3_Raw;
		}
		else
		{
			VCU_2.VCU_2_Resd3.phys = @Vehicle_Signals::i_VCU_2_Resd3;
		}
	}
	else
	{
		// To be completed in simulation
	}

	/* VCU_2_Resd5 */
	if(!@Vehicle_Signals::i_VCU_2_Resd5_SIM)
	{
		if(@Vehicle_Signals::i_VCU_2_Resd5_EN)
		{
			VCU_2.VCU_2_Resd5 = @Vehicle_Signals::i_VCU_2_Resd5_Raw;
		}
		else
		{
			VCU_2.VCU_2_Resd5.phys = @Vehicle_Signals::i_VCU_2_Resd5;
		}
	}
	else
	{
		// To be completed in simulation
	}

	/* VCU_ActualGear */
	if(!@Vehicle_Signals::i_VCU_ActualGear_SIM)
	{
		if(@Vehicle_Signals::i_VCU_ActualGear_EN)
		{
			VCU_2.VCU_ActualGear = @Vehicle_Signals::i_VCU_ActualGear_Raw;
		}
		else
		{
			VCU_2.VCU_ActualGear.phys = @Vehicle_Signals::i_VCU_ActualGear;
		}
	}
	else
	{
		// To be completed in simulation
	}

	/* VCU_ActualGearValidData */
	if(!@Vehicle_Signals::i_VCU_ActualGearValidData_SIM)
	{
		if(@Vehicle_Signals::i_VCU_ActualGearValidData_EN)
		{
			VCU_2.VCU_ActualGearValidData = @Vehicle_Signals::i_VCU_ActualGearValidData_Raw;
		}
		else
		{
			VCU_2.VCU_ActualGearValidData.phys = @Vehicle_Signals::i_VCU_ActualGearValidData;
		}
	}
	else
	{
		// To be completed in simulation
	}

	/* VCU_BrakePedalSts */
	if(!@Vehicle_Signals::i_VCU_BrakePedalSts_SIM)
	{
		if(@Vehicle_Signals::i_VCU_BrakePedalSts_EN)
		{
			VCU_2.VCU_BrakePedalSts = @Vehicle_Signals::i_VCU_BrakePedalSts_Raw;
		}
		else
		{
			VCU_2.VCU_BrakePedalSts.phys = @Vehicle_Signals::i_VCU_BrakePedalSts;
		}
	}
	else
	{
		// To be completed in simulation
	}

	/* VCU_BrakePedalStsValidData */
	if(!@Vehicle_Signals::i_VCU_BrakePedalStsValidData_SIM)
	{
		if(@Vehicle_Signals::i_VCU_BrakePedalStsValidData_EN)
		{
			VCU_2.VCU_BrakePedalStsValidData = @Vehicle_Signals::i_VCU_BrakePedalStsValidData_Raw;
		}
		else
		{
			VCU_2.VCU_BrakePedalStsValidData.phys = @Vehicle_Signals::i_VCU_BrakePedalStsValidData;
		}
	}
	else
	{
		// To be completed in simulation
	}

	/* VCU_DrivePedalOverride */
	if(!@Vehicle_Signals::i_VCU_DrivePedalOverride_SIM)
	{
		if(@Vehicle_Signals::i_VCU_DrivePedalOverride_EN)
		{
			VCU_2.VCU_DrivePedalOverride = @Vehicle_Signals::i_VCU_DrivePedalOverride_Raw;
		}
		else
		{
			VCU_2.VCU_DrivePedalOverride.phys = @Vehicle_Signals::i_VCU_DrivePedalOverride;
		}
	}
	else
	{
		// To be completed in simulation
	}

	/* VCU_DrivePedalOverride_Valid */
	if(!@Vehicle_Signals::i_VCU_DrivePedalOverride_Valid_SIM)
	{
		if(@Vehicle_Signals::i_VCU_DrivePedalOverride_Valid_EN)
		{
			VCU_2.VCU_DrivePedalOverride_Valid = @Vehicle_Signals::i_VCU_DrivePedalOverride_Valid_Raw;
		}
		else
		{
			VCU_2.VCU_DrivePedalOverride_Valid.phys = @Vehicle_Signals::i_VCU_DrivePedalOverride_Valid;
		}
	}
	else
	{
		// To be completed in simulation
	}

	/* VCU_GasPedalPosition */
	if(!@Vehicle_Signals::i_VCU_GasPedalPosition_SIM)
	{
		if(@Vehicle_Signals::i_VCU_GasPedalPosition_EN)
		{
			VCU_2.VCU_GasPedalPosition = @Vehicle_Signals::i_VCU_GasPedalPosition_Raw;
		}
		else
		{
			VCU_2.VCU_GasPedalPosition.phys = @Vehicle_Signals::i_VCU_GasPedalPosition;
		}
	}
	else
	{
		// To be completed in simulation
	}

	/* VCU_GasPedalPositionInvalidData */
	if(!@Vehicle_Signals::i_VCU_GasPedalPositionInvalidData_SIM)
	{
		if(@Vehicle_Signals::i_VCU_GasPedalPositionInvalidData_EN)
		{
			VCU_2.VCU_GasPedalPositionInvalidData = @Vehicle_Signals::i_VCU_GasPedalPositionInvalidData_Raw;
		}
		else
		{
			VCU_2.VCU_GasPedalPositionInvalidData.phys = @Vehicle_Signals::i_VCU_GasPedalPositionInvalidData;
		}
	}
	else
	{
		// To be completed in simulation
	}

	/* VCU_LimitSpeedSts */
	if(!@Vehicle_Signals::i_VCU_LimitSpeedSts_SIM)
	{
		if(@Vehicle_Signals::i_VCU_LimitSpeedSts_EN)
		{
			VCU_2.VCU_LimitSpeedSts = @Vehicle_Signals::i_VCU_LimitSpeedSts_Raw;
		}
		else
		{
			VCU_2.VCU_LimitSpeedSts.phys = @Vehicle_Signals::i_VCU_LimitSpeedSts;
		}
	}
	else
	{
		// To be completed in simulation
	}

	/* VCU_MaxActualWheelTorque */
	if(!@Vehicle_Signals::i_VCU_MaxActualWheelTorque_SIM)
	{
		if(@Vehicle_Signals::i_VCU_MaxActualWheelTorque_EN)
		{
			VCU_2.VCU_MaxActualWheelTorque = @Vehicle_Signals::i_VCU_MaxActualWheelTorque_Raw;
		}
		else
		{
			VCU_2.VCU_MaxActualWheelTorque.phys = @Vehicle_Signals::i_VCU_MaxActualWheelTorque;
		}
	}
	else
	{
		// To be completed in simulation
	}

	/* VCU_MinActualWheelTorque */
	if(!@Vehicle_Signals::i_VCU_MinActualWheelTorque_SIM)
	{
		if(@Vehicle_Signals::i_VCU_MinActualWheelTorque_EN)
		{
			VCU_2.VCU_MinActualWheelTorque = @Vehicle_Signals::i_VCU_MinActualWheelTorque_Raw;
		}
		else
		{
			VCU_2.VCU_MinActualWheelTorque.phys = @Vehicle_Signals::i_VCU_MinActualWheelTorque;
		}
	}
	else
	{
		// To be completed in simulation
	}

	/* VCU_PTReady */
	if(!@Vehicle_Signals::i_VCU_PTReady_SIM)
	{
		if(@Vehicle_Signals::i_VCU_PTReady_EN)
		{
			VCU_2.VCU_PTReady = @Vehicle_Signals::i_VCU_PTReady_Raw;
		}
		else
		{
			VCU_2.VCU_PTReady.phys = @Vehicle_Signals::i_VCU_PTReady;
		}
	}
	else
	{
		// To be completed in simulation
	}

	/* VCU_TargetGear */
	if(!@Vehicle_Signals::i_VCU_TargetGear_SIM)
	{
		if(@Vehicle_Signals::i_VCU_TargetGear_EN)
		{
			VCU_2.VCU_TargetGear = @Vehicle_Signals::i_VCU_TargetGear_Raw;
		}
		else
		{
			VCU_2.VCU_TargetGear.phys = @Vehicle_Signals::i_VCU_TargetGear;
		}
	}
	else
	{
		// To be completed in simulation
	}

	/* VCU_TargetGearValidData */
	if(!@Vehicle_Signals::i_VCU_TargetGearValidData_SIM)
	{
		if(@Vehicle_Signals::i_VCU_TargetGearValidData_EN)
		{
			VCU_2.VCU_TargetGearValidData = @Vehicle_Signals::i_VCU_TargetGearValidData_Raw;
		}
		else
		{
			VCU_2.VCU_TargetGearValidData.phys = @Vehicle_Signals::i_VCU_TargetGearValidData;
		}
	}
	else
	{
		// To be completed in simulation
	}

	/* Rolling counter */
	PROJ_Sim_Rollingcounter(MSG_CONFIG_TX_VCU_2, VCU_2);

	/* CheckSum */
	PROJ_Sim_Checksum(MSG_CONFIG_TX_VCU_2, VCU_2);

	/* DLC Check */
	VCU_2.DataLength = @Error_panel_vehicle::i_DLCError[MSG_CONFIG_TX_VCU_2]?1:DBLookup(VCU_2).dlc;

}

PROJ_CalcMsg_VCU_6()
{
	/* VCU_LowSOCCLMLimitSts */
	if(!@Vehicle_Signals::i_VCU_LowSOCCLMLimitSts_SIM)
	{
		if(@Vehicle_Signals::i_VCU_LowSOCCLMLimitSts_EN)
		{
			VCU_6.VCU_LowSOCCLMLimitSts = @Vehicle_Signals::i_VCU_LowSOCCLMLimitSts_Raw;
		}
		else
		{
			VCU_6.VCU_LowSOCCLMLimitSts.phys = @Vehicle_Signals::i_VCU_LowSOCCLMLimitSts;
		}
	}
	else
	{
		// To be completed in simulation
	}

	/* VCU_VehicleSystemFailure */
	if(!@Vehicle_Signals::i_VCU_VehicleSystemFailure_SIM)
	{
		if(@Vehicle_Signals::i_VCU_VehicleSystemFailure_EN)
		{
			VCU_6.VCU_VehicleSystemFailure = @Vehicle_Signals::i_VCU_VehicleSystemFailure_Raw;
		}
		else
		{
			VCU_6.VCU_VehicleSystemFailure.phys = @Vehicle_Signals::i_VCU_VehicleSystemFailure;
		}
	}
	else
	{
		// To be completed in simulation
	}

	/* Rolling counter */
	PROJ_Sim_Rollingcounter(MSG_CONFIG_TX_VCU_6, VCU_6);

	/* CheckSum */
	PROJ_Sim_Checksum(MSG_CONFIG_TX_VCU_6, VCU_6);

	/* DLC Check */
	VCU_6.DataLength = @Error_panel_vehicle::i_DLCError[MSG_CONFIG_TX_VCU_6]?1:DBLookup(VCU_6).dlc;

}

PROJ_CalcMsg_YAS_1()
{
	/* LateralAcceleration */
	if(!@Vehicle_Signals::i_LateralAcceleration_SIM)
	{
		if(@Vehicle_Signals::i_LateralAcceleration_EN)
		{
			YAS_1.LateralAcceleration = @Vehicle_Signals::i_LateralAcceleration_Raw;
		}
		else
		{
			YAS_1.LateralAcceleration.phys = @Vehicle_Signals::i_LateralAcceleration;
		}
	}
	else
	{
		// To be completed in simulation
	}

	/* LateralAccelerationSigValidData */
	if(!@Vehicle_Signals::i_LateralAccelerationSigValidData_SIM)
	{
		if(@Vehicle_Signals::i_LateralAccelerationSigValidData_EN)
		{
			YAS_1.LateralAccelerationSigValidData = @Vehicle_Signals::i_LateralAccelerationSigValidData_Raw;
		}
		else
		{
			YAS_1.LateralAccelerationSigValidData.phys = @Vehicle_Signals::i_LateralAccelerationSigValidData;
		}
	}
	else
	{
		// To be completed in simulation
	}

	/* YAS_CalibrationSts */
	if(!@Vehicle_Signals::i_YAS_CalibrationSts_SIM)
	{
		if(@Vehicle_Signals::i_YAS_CalibrationSts_EN)
		{
			YAS_1.YAS_CalibrationSts = @Vehicle_Signals::i_YAS_CalibrationSts_Raw;
		}
		else
		{
			YAS_1.YAS_CalibrationSts.phys = @Vehicle_Signals::i_YAS_CalibrationSts;
		}
	}
	else
	{
		// To be completed in simulation
	}

	/* YawRate */
	if(!@Vehicle_Signals::i_YawRate_SIM)
	{
		if(@Vehicle_Signals::i_YawRate_EN)
		{
			YAS_1.YawRate = @Vehicle_Signals::i_YawRate_Raw;
		}
		else
		{
			YAS_1.YawRate.phys = @Vehicle_Signals::i_YawRate;
		}
	}
	else
	{
		// To be completed in simulation
	}

	/* YawrateSigValidData */
	if(!@Vehicle_Signals::i_YawrateSigValidData_SIM)
	{
		if(@Vehicle_Signals::i_YawrateSigValidData_EN)
		{
			YAS_1.YawrateSigValidData = @Vehicle_Signals::i_YawrateSigValidData_Raw;
		}
		else
		{
			YAS_1.YawrateSigValidData.phys = @Vehicle_Signals::i_YawrateSigValidData;
		}
	}
	else
	{
		// To be completed in simulation
	}

	/* Rolling counter */
	PROJ_Sim_Rollingcounter(MSG_CONFIG_TX_YAS_1, YAS_1);

	/* CheckSum */
	PROJ_Sim_Checksum(MSG_CONFIG_TX_YAS_1, YAS_1);

	/* DLC Check */
	YAS_1.DataLength = @Error_panel_vehicle::i_DLCError[MSG_CONFIG_TX_YAS_1]?1:DBLookup(YAS_1).dlc;

}

PROJ_CalcMsg_YAS_2()
{
	/* LongitudinalAcceleration */
	if(!@Vehicle_Signals::i_LongitudinalAcceleration_SIM)
	{
		if(@Vehicle_Signals::i_LongitudinalAcceleration_EN)
		{
			YAS_2.LongitudinalAcceleration = @Vehicle_Signals::i_LongitudinalAcceleration_Raw;
		}
		else
		{
			YAS_2.LongitudinalAcceleration.phys = @Vehicle_Signals::i_LongitudinalAcceleration;
		}
	}
	else
	{
		// To be completed in simulation
	}

	/* LongitudinalAccelerationSigValid */
	if(!@Vehicle_Signals::i_LongitudinalAccelerationSigValid_SIM)
	{
		if(@Vehicle_Signals::i_LongitudinalAccelerationSigValid_EN)
		{
			YAS_2.LongitudinalAccelerationSigValid = @Vehicle_Signals::i_LongitudinalAccelerationSigValid_Raw;
		}
		else
		{
			YAS_2.LongitudinalAccelerationSigValid.phys = @Vehicle_Signals::i_LongitudinalAccelerationSigValid;
		}
	}
	else
	{
		// To be completed in simulation
	}

	/* Rolling counter */
	PROJ_Sim_Rollingcounter(MSG_CONFIG_TX_YAS_2, YAS_2);

	/* CheckSum */
	PROJ_Sim_Checksum(MSG_CONFIG_TX_YAS_2, YAS_2);

	/* DLC Check */
	YAS_2.DataLength = @Error_panel_vehicle::i_DLCError[MSG_CONFIG_TX_YAS_2]?1:DBLookup(YAS_2).dlc;

}

PROJ_CalcMsg_Z_EPB_State_R()
{
	/* EPBStatus */
	if(!@Vehicle_Signals::i_EPBStatus_SIM)
	{
		if(@Vehicle_Signals::i_EPBStatus_EN)
		{
			Z_EPB_State_R.EPBStatus = @Vehicle_Signals::i_EPBStatus_Raw;
		}
		else
		{
			Z_EPB_State_R.EPBStatus.phys = @Vehicle_Signals::i_EPBStatus;
		}
	}
	else
	{
		// To be completed in simulation
	}

	/* EPB_FltLvl */
	if(!@Vehicle_Signals::i_EPB_FltLvl_SIM)
	{
		if(@Vehicle_Signals::i_EPB_FltLvl_EN)
		{
			Z_EPB_State_R.EPB_FltLvl = @Vehicle_Signals::i_EPB_FltLvl_Raw;
		}
		else
		{
			Z_EPB_State_R.EPB_FltLvl.phys = @Vehicle_Signals::i_EPB_FltLvl;
		}
	}
	else
	{
		// To be completed in simulation
	}

	/* Rolling counter */
	PROJ_Sim_Rollingcounter(MSG_CONFIG_TX_Z_EPB_State_R, Z_EPB_State_R);

	/* CheckSum */
	PROJ_Sim_Checksum(MSG_CONFIG_TX_Z_EPB_State_R, Z_EPB_State_R);

	/* DLC Check */
	Z_EPB_State_R.DataLength = @Error_panel_vehicle::i_DLCError[MSG_CONFIG_TX_Z_EPB_State_R]?1:DBLookup(Z_EPB_State_R).dlc;

}

PROJ_CalcMsg_Z_FCM_FRM_6()
{
	/* FCM_FRM_6_ACCMode */
	if(!@Vehicle_Signals::i_FCM_FRM_6_ACCMode_SIM)
	{
		if(@Vehicle_Signals::i_FCM_FRM_6_ACCMode_EN)
		{
			Z_FCM_FRM_6.FCM_FRM_6_ACCMode = @Vehicle_Signals::i_FCM_FRM_6_ACCMode_Raw;
		}
		else
		{
			Z_FCM_FRM_6.FCM_FRM_6_ACCMode.phys = @Vehicle_Signals::i_FCM_FRM_6_ACCMode;
		}
	}
	else
	{
		// To be completed in simulation
	}

	/* FCM_FRM_6_AEBDecCtrlRequest */
	if(!@Vehicle_Signals::i_FCM_FRM_6_AEBDecCtrlRequest_SIM)
	{
		if(@Vehicle_Signals::i_FCM_FRM_6_AEBDecCtrlRequest_EN)
		{
			Z_FCM_FRM_6.FCM_FRM_6_AEBDecCtrlRequest = @Vehicle_Signals::i_FCM_FRM_6_AEBDecCtrlRequest_Raw;
		}
		else
		{
			Z_FCM_FRM_6.FCM_FRM_6_AEBDecCtrlRequest.phys = @Vehicle_Signals::i_FCM_FRM_6_AEBDecCtrlRequest;
		}
	}
	else
	{
		// To be completed in simulation
	}

	/* FCM_FRM_6_AEBMode */
	if(!@Vehicle_Signals::i_FCM_FRM_6_AEBMode_SIM)
	{
		if(@Vehicle_Signals::i_FCM_FRM_6_AEBMode_EN)
		{
			Z_FCM_FRM_6.FCM_FRM_6_AEBMode = @Vehicle_Signals::i_FCM_FRM_6_AEBMode_Raw;
		}
		else
		{
			Z_FCM_FRM_6.FCM_FRM_6_AEBMode.phys = @Vehicle_Signals::i_FCM_FRM_6_AEBMode;
		}
	}
	else
	{
		// To be completed in simulation
	}

	/* FCM_FRM_6_DistanceWarning */
	if(!@Vehicle_Signals::i_FCM_FRM_6_DistanceWarning_SIM)
	{
		if(@Vehicle_Signals::i_FCM_FRM_6_DistanceWarning_EN)
		{
			Z_FCM_FRM_6.FCM_FRM_6_DistanceWarning = @Vehicle_Signals::i_FCM_FRM_6_DistanceWarning_Raw;
		}
		else
		{
			Z_FCM_FRM_6.FCM_FRM_6_DistanceWarning.phys = @Vehicle_Signals::i_FCM_FRM_6_DistanceWarning;
		}
	}
	else
	{
		// To be completed in simulation
	}

	/* FCM_FRM_6_DrvrCfmSCFDispFb */
	if(!@Vehicle_Signals::i_FCM_FRM_6_DrvrCfmSCFDispFb_SIM)
	{
		if(@Vehicle_Signals::i_FCM_FRM_6_DrvrCfmSCFDispFb_EN)
		{
			Z_FCM_FRM_6.FCM_FRM_6_DrvrCfmSCFDispFb = @Vehicle_Signals::i_FCM_FRM_6_DrvrCfmSCFDispFb_Raw;
		}
		else
		{
			Z_FCM_FRM_6.FCM_FRM_6_DrvrCfmSCFDispFb.phys = @Vehicle_Signals::i_FCM_FRM_6_DrvrCfmSCFDispFb;
		}
	}
	else
	{
		// To be completed in simulation
	}

	/* FCM_FRM_6_FCWMode */
	if(!@Vehicle_Signals::i_FCM_FRM_6_FCWMode_SIM)
	{
		if(@Vehicle_Signals::i_FCM_FRM_6_FCWMode_EN)
		{
			Z_FCM_FRM_6.FCM_FRM_6_FCWMode = @Vehicle_Signals::i_FCM_FRM_6_FCWMode_Raw;
		}
		else
		{
			Z_FCM_FRM_6.FCM_FRM_6_FCWMode.phys = @Vehicle_Signals::i_FCM_FRM_6_FCWMode;
		}
	}
	else
	{
		// To be completed in simulation
	}

	/* FCM_FRM_6_FCW_preWarning */
	if(!@Vehicle_Signals::i_FCM_FRM_6_FCW_preWarning_SIM)
	{
		if(@Vehicle_Signals::i_FCM_FRM_6_FCW_preWarning_EN)
		{
			Z_FCM_FRM_6.FCM_FRM_6_FCW_preWarning = @Vehicle_Signals::i_FCM_FRM_6_FCW_preWarning_Raw;
		}
		else
		{
			Z_FCM_FRM_6.FCM_FRM_6_FCW_preWarning.phys = @Vehicle_Signals::i_FCM_FRM_6_FCW_preWarning;
		}
	}
	else
	{
		// To be completed in simulation
	}

	/* FCM_FRM_6_HMI_Indicator */
	if(!@Vehicle_Signals::i_FCM_FRM_6_HMI_Indicator_SIM)
	{
		if(@Vehicle_Signals::i_FCM_FRM_6_HMI_Indicator_EN)
		{
			Z_FCM_FRM_6.FCM_FRM_6_HMI_Indicator = @Vehicle_Signals::i_FCM_FRM_6_HMI_Indicator_Raw;
		}
		else
		{
			Z_FCM_FRM_6.FCM_FRM_6_HMI_Indicator.phys = @Vehicle_Signals::i_FCM_FRM_6_HMI_Indicator;
		}
	}
	else
	{
		// To be completed in simulation
	}

	/* FCM_FRM_6_Resd_1 */
	if(!@Vehicle_Signals::i_FCM_FRM_6_Resd_1_SIM)
	{
		if(@Vehicle_Signals::i_FCM_FRM_6_Resd_1_EN)
		{
			Z_FCM_FRM_6.FCM_FRM_6_Resd_1 = @Vehicle_Signals::i_FCM_FRM_6_Resd_1_Raw;
		}
		else
		{
			Z_FCM_FRM_6.FCM_FRM_6_Resd_1.phys = @Vehicle_Signals::i_FCM_FRM_6_Resd_1;
		}
	}
	else
	{
		// To be completed in simulation
	}

	/* FCM_FRM_6_Resd_2 */
	if(!@Vehicle_Signals::i_FCM_FRM_6_Resd_2_SIM)
	{
		if(@Vehicle_Signals::i_FCM_FRM_6_Resd_2_EN)
		{
			Z_FCM_FRM_6.FCM_FRM_6_Resd_2 = @Vehicle_Signals::i_FCM_FRM_6_Resd_2_Raw;
		}
		else
		{
			Z_FCM_FRM_6.FCM_FRM_6_Resd_2.phys = @Vehicle_Signals::i_FCM_FRM_6_Resd_2;
		}
	}
	else
	{
		// To be completed in simulation
	}

	/* FCM_FRM_6_SCF_PopoverReq */
	if(!@Vehicle_Signals::i_FCM_FRM_6_SCF_PopoverReq_SIM)
	{
		if(@Vehicle_Signals::i_FCM_FRM_6_SCF_PopoverReq_EN)
		{
			Z_FCM_FRM_6.FCM_FRM_6_SCF_PopoverReq = @Vehicle_Signals::i_FCM_FRM_6_SCF_PopoverReq_Raw;
		}
		else
		{
			Z_FCM_FRM_6.FCM_FRM_6_SCF_PopoverReq.phys = @Vehicle_Signals::i_FCM_FRM_6_SCF_PopoverReq;
		}
	}
	else
	{
		// To be completed in simulation
	}

	/* FCM_FRM_6_SCF_SpdLimSts */
	if(!@Vehicle_Signals::i_FCM_FRM_6_SCF_SpdLimSts_SIM)
	{
		if(@Vehicle_Signals::i_FCM_FRM_6_SCF_SpdLimSts_EN)
		{
			Z_FCM_FRM_6.FCM_FRM_6_SCF_SpdLimSts = @Vehicle_Signals::i_FCM_FRM_6_SCF_SpdLimSts_Raw;
		}
		else
		{
			Z_FCM_FRM_6.FCM_FRM_6_SCF_SpdLimSts.phys = @Vehicle_Signals::i_FCM_FRM_6_SCF_SpdLimSts;
		}
	}
	else
	{
		// To be completed in simulation
	}

	/* FCM_FRM_6_SCF_SpdLimUnit */
	if(!@Vehicle_Signals::i_FCM_FRM_6_SCF_SpdLimUnit_SIM)
	{
		if(@Vehicle_Signals::i_FCM_FRM_6_SCF_SpdLimUnit_EN)
		{
			Z_FCM_FRM_6.FCM_FRM_6_SCF_SpdLimUnit = @Vehicle_Signals::i_FCM_FRM_6_SCF_SpdLimUnit_Raw;
		}
		else
		{
			Z_FCM_FRM_6.FCM_FRM_6_SCF_SpdLimUnit.phys = @Vehicle_Signals::i_FCM_FRM_6_SCF_SpdLimUnit;
		}
	}
	else
	{
		// To be completed in simulation
	}

	/* FCM_FRM_6_TakeOverReq */
	if(!@Vehicle_Signals::i_FCM_FRM_6_TakeOverReq_SIM)
	{
		if(@Vehicle_Signals::i_FCM_FRM_6_TakeOverReq_EN)
		{
			Z_FCM_FRM_6.FCM_FRM_6_TakeOverReq = @Vehicle_Signals::i_FCM_FRM_6_TakeOverReq_Raw;
		}
		else
		{
			Z_FCM_FRM_6.FCM_FRM_6_TakeOverReq.phys = @Vehicle_Signals::i_FCM_FRM_6_TakeOverReq;
		}
	}
	else
	{
		// To be completed in simulation
	}

	/* FCM_FRM_6_TextinfoWarn */
	if(!@Vehicle_Signals::i_FCM_FRM_6_TextinfoWarn_SIM)
	{
		if(@Vehicle_Signals::i_FCM_FRM_6_TextinfoWarn_EN)
		{
			Z_FCM_FRM_6.FCM_FRM_6_TextinfoWarn = @Vehicle_Signals::i_FCM_FRM_6_TextinfoWarn_Raw;
		}
		else
		{
			Z_FCM_FRM_6.FCM_FRM_6_TextinfoWarn.phys = @Vehicle_Signals::i_FCM_FRM_6_TextinfoWarn;
		}
	}
	else
	{
		// To be completed in simulation
	}

	/* FCM_FRM_6_Textinfo_Info */
	if(!@Vehicle_Signals::i_FCM_FRM_6_Textinfo_Info_SIM)
	{
		if(@Vehicle_Signals::i_FCM_FRM_6_Textinfo_Info_EN)
		{
			Z_FCM_FRM_6.FCM_FRM_6_Textinfo_Info = @Vehicle_Signals::i_FCM_FRM_6_Textinfo_Info_Raw;
		}
		else
		{
			Z_FCM_FRM_6.FCM_FRM_6_Textinfo_Info.phys = @Vehicle_Signals::i_FCM_FRM_6_Textinfo_Info;
		}
	}
	else
	{
		// To be completed in simulation
	}

	/* FCM_FRM_6_TimeGapSetICM */
	if(!@Vehicle_Signals::i_FCM_FRM_6_TimeGapSetICM_SIM)
	{
		if(@Vehicle_Signals::i_FCM_FRM_6_TimeGapSetICM_EN)
		{
			Z_FCM_FRM_6.FCM_FRM_6_TimeGapSetICM = @Vehicle_Signals::i_FCM_FRM_6_TimeGapSetICM_Raw;
		}
		else
		{
			Z_FCM_FRM_6.FCM_FRM_6_TimeGapSetICM.phys = @Vehicle_Signals::i_FCM_FRM_6_TimeGapSetICM;
		}
	}
	else
	{
		// To be completed in simulation
	}

	/* FCM_FRM_6_VSetDis */
	if(!@Vehicle_Signals::i_FCM_FRM_6_VSetDis_SIM)
	{
		if(@Vehicle_Signals::i_FCM_FRM_6_VSetDis_EN)
		{
			Z_FCM_FRM_6.FCM_FRM_6_VSetDis = @Vehicle_Signals::i_FCM_FRM_6_VSetDis_Raw;
		}
		else
		{
			Z_FCM_FRM_6.FCM_FRM_6_VSetDis.phys = @Vehicle_Signals::i_FCM_FRM_6_VSetDis;
		}
	}
	else
	{
		// To be completed in simulation
	}

	/* Rolling counter */
	PROJ_Sim_Rollingcounter(MSG_CONFIG_TX_Z_FCM_FRM_6, Z_FCM_FRM_6);

	/* CheckSum */
	PROJ_Sim_Checksum(MSG_CONFIG_TX_Z_FCM_FRM_6, Z_FCM_FRM_6);

	/* DLC Check */
	Z_FCM_FRM_6.DataLength = @Error_panel_vehicle::i_DLCError[MSG_CONFIG_TX_Z_FCM_FRM_6]?1:DBLookup(Z_FCM_FRM_6).dlc;

}

